AUTOSAR XML (schema 4-2-1)
package /Pack_sw_Types
  range dc_tJMI_sint16: raw -32768..32767
  12 x impl type, all with category=VALUE:
    tBILOG: base-type=uint8, range raw 0..3
    tTabDWORDOneDim: base-type=uint8, range raw 0..255
    t_TabOfStrResVSM: base-type=uint8, range raw 0..255
    tBYTE: base-type=uint8, range raw 0..255
    tDWORD: base-type=uint32, range raw 0..4294967295
    tFLOAT: base-type=float32, range raw 1.4e-45..3.4028235E38
    tLOG: base-type=uint8, range raw 0..1
    tQUARTET: base-type=uint8, range raw 0..15
    tSBYTE: base-type=sint8, range raw -128..127
    tSDWORD: base-type=sint32, range raw -2147483648..2147483647
    tSWORD: base-type=sint16, range raw -32768..32767
    tWORD: base-type=uint16, range raw 0..65535
