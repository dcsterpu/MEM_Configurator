AUTOSAR XML (schema 4-2-2)
standard types defined: float32, float64, sint16, sint16_least, sint32, sint32_least, sint8, sint8_least, uint16, uint16_least, uint32, uint32_least, uint8, uint8_least, boolean, void
package /AUTOSAR_Platform/CompuMethods
  compu method boolean_Literals: 0=FALSE, 1=TRUE
package /AUTOSAR_Platform/ImplementationDataTypes
  6 x impl type:
    ConstVoidPtr: category=DATA_REFERENCE, sw-pointer-target-props={target-category=VALUE, base-type=void, sw-impl-policy=CONST}, type-emitter=BSW
    NvM_BlockIdType: implementation-data-type=uint16
    NvM_DstPtrType: category=DATA_REFERENCE, sw-pointer-target-props={target-category=VALUE, base-type=void}
    NvM_RequestResultType: implementation-data-type=uint8
    NvM_SrcPtrType: category=DATA_REFERENCE, sw-pointer-target-props={target-category=VALUE, base-type=void, sw-impl-policy=CONST}
    VoidPtr: category=DATA_REFERENCE, sw-pointer-target-props={target-category=VALUE, base-type=void}, type-emitter=BSW
