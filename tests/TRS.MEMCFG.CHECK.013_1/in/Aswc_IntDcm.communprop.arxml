AUTOSAR XML (schema 4-2-1)
package /RootP_DiagDesc
  diagnostic contribution set DiagContributionSet: category=DIAGNOSTICS_ECU_EXTRACT, ecu-instance=VSM
    common-properties aging-requires-tested-cycle=false, clear-dtc-limitation=CLEAR-ALL-DTCS, default-endianness=little-endian, dtc-status-availability-mask=0x09, event-displacement-strategy=FULL, max-number-of-request-correctly-received-response-pending=0, memory-entry-storage-trigger=CONFIRMED, occurrence-counter-processing=CONFIRMED-DTC-BIT, security-delay-time-on-boot=0.0, status-bit-handling-test-failed-since-last-clear=STATUS-BIT-NORMAL, type-of-freeze-frame-record-numeration=CALCULATED:
      413 x diagnostic debounce algorithm props:
        ALGO_AdcClcFailureNotification: debounce-behavior=FREEZE
          debounce-algorithm:
            diag event debounce time based ALGO_DEBOUNCE_AdcClcFailureNotification: time-failed-threshold=2.0, time-passed-threshold=2.0
        ALGO_AdcConvStopTimeNotification: debounce-behavior=FREEZE
          debounce-algorithm:
            diag event debounce time based ALGO_DEBOUNCE_AdcConvStopTimeNotification: time-failed-threshold=2.0, time-passed-threshold=2.0
        ALGO_CANSM_E_BUS_OFF_0: debounce-behavior=FREEZE
          debounce-algorithm:
            diag event debounce time based ALGO_DEBOUNCE_CANSM_E_BUS_OFF_0: time-failed-threshold=2.0, time-passed-threshold=2.0
        ALGO_CANSM_E_BUS_OFF_1: debounce-behavior=FREEZE
          debounce-algorithm:
            diag event debounce time based ALGO_DEBOUNCE_CANSM_E_BUS_OFF_1: time-failed-threshold=2.0, time-passed-threshold=2.0
        ALGO_CANSM_E_BUS_OFF_10: debounce-behavior=FREEZE
          debounce-algorithm:
            diag event debounce time based ALGO_DEBOUNCE_CANSM_E_BUS_OFF_10: time-failed-threshold=2.0, time-passed-threshold=2.0
        ALGO_CANSM_E_BUS_OFF_11: debounce-behavior=FREEZE
          debounce-algorithm:
            diag event debounce time based ALGO_DEBOUNCE_CANSM_E_BUS_OFF_11: time-failed-threshold=2.0, time-passed-threshold=2.0
        ALGO_CANSM_E_BUS_OFF_12: debounce-behavior=FREEZE
          debounce-algorithm:
            diag event debounce time based ALGO_DEBOUNCE_CANSM_E_BUS_OFF_12: time-failed-threshold=2.0, time-passed-threshold=2.0
        ALGO_CANSM_E_BUS_OFF_13: debounce-behavior=FREEZE
          debounce-algorithm:
            diag event debounce time based ALGO_DEBOUNCE_CANSM_E_BUS_OFF_13: time-failed-threshold=2.0, time-passed-threshold=2.0
        ALGO_CANSM_E_BUS_OFF_14: debounce-behavior=FREEZE
          debounce-algorithm:
            diag event debounce time based ALGO_DEBOUNCE_CANSM_E_BUS_OFF_14: time-failed-threshold=2.0, time-passed-threshold=2.0
        ALGO_CANSM_E_BUS_OFF_15: debounce-behavior=FREEZE
          debounce-algorithm:
            diag event debounce time based ALGO_DEBOUNCE_CANSM_E_BUS_OFF_15: time-failed-threshold=2.0, time-passed-threshold=2.0
        ALGO_CANSM_E_BUS_OFF_2: debounce-behavior=FREEZE
          debounce-algorithm:
            diag event debounce time based ALGO_DEBOUNCE_CANSM_E_BUS_OFF_2: time-failed-threshold=2.0, time-passed-threshold=2.0
        ALGO_CANSM_E_BUS_OFF_3: debounce-behavior=FREEZE
          debounce-algorithm:
            diag event debounce time based ALGO_DEBOUNCE_CANSM_E_BUS_OFF_3: time-failed-threshold=2.0, time-passed-threshold=2.0
        ALGO_CANSM_E_BUS_OFF_4: debounce-behavior=FREEZE
          debounce-algorithm:
            diag event debounce time based ALGO_DEBOUNCE_CANSM_E_BUS_OFF_4: time-failed-threshold=2.0, time-passed-threshold=2.0
        ALGO_CANSM_E_BUS_OFF_5: debounce-behavior=FREEZE
          debounce-algorithm:
            diag event debounce time based ALGO_DEBOUNCE_CANSM_E_BUS_OFF_5: time-failed-threshold=2.0, time-passed-threshold=2.0
        ALGO_CANSM_E_BUS_OFF_6: debounce-behavior=FREEZE
          debounce-algorithm:
            diag event debounce time based ALGO_DEBOUNCE_CANSM_E_BUS_OFF_6: time-failed-threshold=2.0, time-passed-threshold=2.0
        ALGO_CANSM_E_BUS_OFF_7: debounce-behavior=FREEZE
          debounce-algorithm:
            diag event debounce time based ALGO_DEBOUNCE_CANSM_E_BUS_OFF_7: time-failed-threshold=2.0, time-passed-threshold=2.0
        ALGO_CANSM_E_BUS_OFF_8: debounce-behavior=FREEZE
          debounce-algorithm:
            diag event debounce time based ALGO_DEBOUNCE_CANSM_E_BUS_OFF_8: time-failed-threshold=2.0, time-passed-threshold=2.0
        ALGO_CANSM_E_BUS_OFF_9: debounce-behavior=FREEZE
          debounce-algorithm:
            diag event debounce time based ALGO_DEBOUNCE_CANSM_E_BUS_OFF_9: time-failed-threshold=2.0, time-passed-threshold=2.0
        ALGO_CAN_E_TIMEOUT: debounce-behavior=FREEZE
          debounce-algorithm:
            diag event debounce time based ALGO_DEBOUNCE_CAN_E_TIMEOUT: time-failed-threshold=2.0, time-passed-threshold=2.0
        ALGO_ECUM_E_RAM_CHECK_FAILED: debounce-behavior=FREEZE
          debounce-algorithm:
            diag event debounce time based ALGO_DEBOUNCE_ECUM_E_RAM_CHECK_FAILED: time-failed-threshold=2.0, time-passed-threshold=2.0
        ALGO_ETH_E_ACCESS: debounce-behavior=FREEZE
          debounce-algorithm:
            diag event debounce time based ALGO_DEBOUNCE_ETH_E_ACCESS: time-failed-threshold=2.0, time-passed-threshold=2.0
        ALGO_ETH_E_ALIGNMENT: debounce-behavior=FREEZE
          debounce-algorithm:
            diag event debounce time based ALGO_DEBOUNCE_ETH_E_ALIGNMENT: time-failed-threshold=2.0, time-passed-threshold=2.0
        ALGO_ETH_E_CRC: debounce-behavior=FREEZE
          debounce-algorithm:
            diag event debounce time based ALGO_DEBOUNCE_ETH_E_CRC: time-failed-threshold=2.0, time-passed-threshold=2.0
        ALGO_ETH_E_FRAMESEQ: debounce-behavior=FREEZE
          debounce-algorithm:
            diag event debounce time based ALGO_DEBOUNCE_ETH_E_FRAMESEQ: time-failed-threshold=2.0, time-passed-threshold=2.0
        ALGO_ETH_E_LATECOLLISION: debounce-behavior=FREEZE
          debounce-algorithm:
            diag event debounce time based ALGO_DEBOUNCE_ETH_E_LATECOLLISION: time-failed-threshold=2.0, time-passed-threshold=2.0
        ALGO_ETH_E_MULTIPLECOLLISION: debounce-behavior=FREEZE
          debounce-algorithm:
            diag event debounce time based ALGO_DEBOUNCE_ETH_E_MULTIPLECOLLISION: time-failed-threshold=2.0, time-passed-threshold=2.0
        ALGO_ETH_E_OVERSIZEFRAME: debounce-behavior=FREEZE
          debounce-algorithm:
            diag event debounce time based ALGO_DEBOUNCE_ETH_E_OVERSIZEFRAME: time-failed-threshold=2.0, time-passed-threshold=2.0
        ALGO_ETH_E_RX_FRAMES_LOST: debounce-behavior=FREEZE
          debounce-algorithm:
            diag event debounce time based ALGO_DEBOUNCE_ETH_E_RX_FRAMES_LOST: time-failed-threshold=2.0, time-passed-threshold=2.0
        ALGO_ETH_E_SINGLECOLLISION: debounce-behavior=FREEZE
          debounce-algorithm:
            diag event debounce time based ALGO_DEBOUNCE_ETH_E_SINGLECOLLISION: time-failed-threshold=2.0, time-passed-threshold=2.0
        ALGO_ETH_E_TIMEOUT: debounce-behavior=FREEZE
          debounce-algorithm:
            diag event debounce time based ALGO_DEBOUNCE_ETH_E_TIMEOUT: time-failed-threshold=2.0, time-passed-threshold=2.0
        ALGO_ETH_E_UNDERSIZEFRAME: debounce-behavior=FREEZE
          debounce-algorithm:
            diag event debounce time based ALGO_DEBOUNCE_ETH_E_UNDERSIZEFRAME: time-failed-threshold=2.0, time-passed-threshold=2.0
        ALGO_FEE_E_GC_ERASE: debounce-behavior=FREEZE
          debounce-algorithm:
            diag event debounce time based ALGO_DEBOUNCE_FEE_E_GC_ERASE: time-failed-threshold=2.0, time-passed-threshold=2.0
        ALGO_FEE_E_GC_INIT: debounce-behavior=FREEZE
          debounce-algorithm:
            diag event debounce time based ALGO_DEBOUNCE_FEE_E_GC_INIT: time-failed-threshold=2.0, time-passed-threshold=2.0
        ALGO_FEE_E_GC_READ: debounce-behavior=FREEZE
          debounce-algorithm:
            diag event debounce time based ALGO_DEBOUNCE_FEE_E_GC_READ: time-failed-threshold=2.0, time-passed-threshold=2.0
        ALGO_FEE_E_GC_TRIG: debounce-behavior=FREEZE
          debounce-algorithm:
            diag event debounce time based ALGO_DEBOUNCE_FEE_E_GC_TRIG: time-failed-threshold=2.0, time-passed-threshold=2.0
        ALGO_FEE_E_GC_WRITE: debounce-behavior=FREEZE
          debounce-algorithm:
            diag event debounce time based ALGO_DEBOUNCE_FEE_E_GC_WRITE: time-failed-threshold=2.0, time-passed-threshold=2.0
        ALGO_FEE_E_INVALIDATE: debounce-behavior=FREEZE
          debounce-algorithm:
            diag event debounce time based ALGO_DEBOUNCE_FEE_E_INVALIDATE: time-failed-threshold=2.0, time-passed-threshold=2.0
        ALGO_FEE_E_READ: debounce-behavior=FREEZE
          debounce-algorithm:
            diag event debounce time based ALGO_DEBOUNCE_FEE_E_READ: time-failed-threshold=2.0, time-passed-threshold=2.0
        ALGO_FEE_E_UNCONFIG_BLK_EXCEEDED: debounce-behavior=FREEZE
          debounce-algorithm:
            diag event debounce time based ALGO_DEBOUNCE_FEE_E_UNCONFIG_BLK_EXCEEDED: time-failed-threshold=2.0, time-passed-threshold=2.0
        ALGO_FEE_E_WRITE: debounce-behavior=FREEZE
          debounce-algorithm:
            diag event debounce time based ALGO_DEBOUNCE_FEE_E_WRITE: time-failed-threshold=2.0, time-passed-threshold=2.0
        ALGO_FEE_E_WRITE_CYCLES_EXHAUSTED: debounce-behavior=FREEZE
          debounce-algorithm:
            diag event debounce time based ALGO_DEBOUNCE_FEE_E_WRITE_CYCLES_EXHAUSTED: time-failed-threshold=2.0, time-passed-threshold=2.0
        ALGO_FLS_E_COMPARE_FAILED: debounce-behavior=FREEZE
          debounce-algorithm:
            diag event debounce time based ALGO_DEBOUNCE_FLS_E_COMPARE_FAILED: time-failed-threshold=2.0, time-passed-threshold=2.0
        ALGO_FLS_E_ERASE_FAILED: debounce-behavior=FREEZE
          debounce-algorithm:
            diag event debounce time based ALGO_DEBOUNCE_FLS_E_ERASE_FAILED: time-failed-threshold=2.0, time-passed-threshold=2.0
        ALGO_FLS_E_READ_FAILED: debounce-behavior=FREEZE
          debounce-algorithm:
            diag event debounce time based ALGO_DEBOUNCE_FLS_E_READ_FAILED: time-failed-threshold=2.0, time-passed-threshold=2.0
        ALGO_FLS_E_UNEXPECTED_FLASH_ID: debounce-behavior=FREEZE
          debounce-algorithm:
            diag event debounce time based ALGO_DEBOUNCE_FLS_E_UNEXPECTED_FLASH_ID: time-failed-threshold=2.0, time-passed-threshold=2.0
        ALGO_FLS_E_WRITE_FAILED: debounce-behavior=FREEZE
          debounce-algorithm:
            diag event debounce time based ALGO_DEBOUNCE_FLS_E_WRITE_FAILED: time-failed-threshold=2.0, time-passed-threshold=2.0
        ALGO_LIN_E_TIMEOUT: debounce-behavior=FREEZE
          debounce-algorithm:
            diag event debounce time based ALGO_DEBOUNCE_LIN_E_TIMEOUT: time-failed-threshold=2.0, time-passed-threshold=2.0
        ALGO_MCU_E_CCU6_CLC_DISABLE_ERR: debounce-behavior=FREEZE
          debounce-algorithm:
            diag event debounce time based ALGO_DEBOUNCE_MCU_E_CCU6_CLC_DISABLE_ERR: time-failed-threshold=2.0, time-passed-threshold=2.0
        ALGO_MCU_E_CCU6_CLC_ENABLE_ERR: debounce-behavior=FREEZE
          debounce-algorithm:
            diag event debounce time based ALGO_DEBOUNCE_MCU_E_CCU6_CLC_ENABLE_ERR: time-failed-threshold=2.0, time-passed-threshold=2.0
        ALGO_MCU_E_CCUCON_UPDATE_ERR: debounce-behavior=FREEZE
          debounce-algorithm:
            diag event debounce time based ALGO_DEBOUNCE_MCU_E_CCUCON_UPDATE_ERR: time-failed-threshold=2.0, time-passed-threshold=2.0
        ALGO_MCU_E_CLOCK_FAILURE: debounce-behavior=FREEZE
          debounce-algorithm:
            diag event debounce time based ALGO_DEBOUNCE_MCU_E_CLOCK_FAILURE: time-failed-threshold=2.0, time-passed-threshold=2.0
        ALGO_MCU_E_CONVCTRL_CLC_DISABLE_ERR: debounce-behavior=FREEZE
          debounce-algorithm:
            diag event debounce time based ALGO_DEBOUNCE_MCU_E_CONVCTRL_CLC_DISABLE_ERR: time-failed-threshold=2.0, time-passed-threshold=2.0
        ALGO_MCU_E_CONVCTRL_CLC_ENABLE_ERR: debounce-behavior=FREEZE
          debounce-algorithm:
            diag event debounce time based ALGO_DEBOUNCE_MCU_E_CONVCTRL_CLC_ENABLE_ERR: time-failed-threshold=2.0, time-passed-threshold=2.0
        ALGO_MCU_E_GPT12_CLC_DISABLE_ERR: debounce-behavior=FREEZE
          debounce-algorithm:
            diag event debounce time based ALGO_DEBOUNCE_MCU_E_GPT12_CLC_DISABLE_ERR: time-failed-threshold=2.0, time-passed-threshold=2.0
        ALGO_MCU_E_GPT12_CLC_ENABLE_ERR: debounce-behavior=FREEZE
          debounce-algorithm:
            diag event debounce time based ALGO_DEBOUNCE_MCU_E_GPT12_CLC_ENABLE_ERR: time-failed-threshold=2.0, time-passed-threshold=2.0
        ALGO_MCU_E_GTM_CLC_DISABLE_ERR: debounce-behavior=FREEZE
          debounce-algorithm:
            diag event debounce time based ALGO_DEBOUNCE_MCU_E_GTM_CLC_DISABLE_ERR: time-failed-threshold=2.0, time-passed-threshold=2.0
        ALGO_MCU_E_GTM_CLC_ENABLE_ERR: debounce-behavior=FREEZE
          debounce-algorithm:
            diag event debounce time based ALGO_DEBOUNCE_MCU_E_GTM_CLC_ENABLE_ERR: time-failed-threshold=2.0, time-passed-threshold=2.0
        ALGO_MCU_E_OSC_FAILURE: debounce-behavior=FREEZE
          debounce-algorithm:
            diag event debounce time based ALGO_DEBOUNCE_MCU_E_OSC_FAILURE: time-failed-threshold=2.0, time-passed-threshold=2.0
        ALGO_MCU_E_PERIPHERAL_PLL_LOCK_LOSS: debounce-behavior=FREEZE
          debounce-algorithm:
            diag event debounce time based ALGO_DEBOUNCE_MCU_E_PERIPHERAL_PLL_LOCK_LOSS: time-failed-threshold=2.0, time-passed-threshold=2.0
        ALGO_MCU_E_PERIPHERAL_PLL_TIMEOUT_ERR: debounce-behavior=FREEZE
          debounce-algorithm:
            diag event debounce time based ALGO_DEBOUNCE_MCU_E_PERIPHERAL_PLL_TIMEOUT_ERR: time-failed-threshold=2.0, time-passed-threshold=2.0
        ALGO_MCU_E_PMSWCR_UPDATE_ERR: debounce-behavior=FREEZE
          debounce-algorithm:
            diag event debounce time based ALGO_DEBOUNCE_MCU_E_PMSWCR_UPDATE_ERR: time-failed-threshold=2.0, time-passed-threshold=2.0
        ALGO_MCU_E_SYSTEM_PLL_LOCK_LOSS: debounce-behavior=FREEZE
          debounce-algorithm:
            diag event debounce time based ALGO_DEBOUNCE_MCU_E_SYSTEM_PLL_LOCK_LOSS: time-failed-threshold=2.0, time-passed-threshold=2.0
        ALGO_MCU_E_SYSTEM_PLL_TIMEOUT_ERR: debounce-behavior=FREEZE
          debounce-algorithm:
            diag event debounce time based ALGO_DEBOUNCE_MCU_E_SYSTEM_PLL_TIMEOUT_ERR: time-failed-threshold=2.0, time-passed-threshold=2.0
        ALGO_SPI_E_HARDWARE_ERROR: debounce-behavior=FREEZE
          debounce-algorithm:
            diag event debounce time based ALGO_DEBOUNCE_SPI_E_HARDWARE_ERROR: time-failed-threshold=2.0, time-passed-threshold=2.0
        ALGO_WDGM_E_DATA_CORRUPTION: debounce-behavior=FREEZE
          debounce-algorithm:
            diag event debounce time based ALGO_DEBOUNCE_WDGM_E_DATA_CORRUPTION: time-failed-threshold=2.0, time-passed-threshold=2.0
        ALGO_WDGM_E_MONITORING: debounce-behavior=FREEZE
          debounce-algorithm:
            diag event debounce time based ALGO_DEBOUNCE_WDGM_E_MONITORING: time-failed-threshold=2.0, time-passed-threshold=2.0
        ALGO_WDGM_E_SET_MODE: debounce-behavior=FREEZE
          debounce-algorithm:
            diag event debounce time based ALGO_DEBOUNCE_WDGM_E_SET_MODE: time-failed-threshold=2.0, time-passed-threshold=2.0
        ALGO_DefN_SORTIES_BSI_INHIBEES_Mode_96: debounce-behavior=FREEZE
          debounce-algorithm:
            diag event debounce time based ALGO_DEBOUNCE_DefN_SORTIES_BSI_INHIBEES_Mode_96: time-failed-threshold=2, time-passed-threshold=2
        ALGO_DefN_SORTIES_BSI_INHIBEES_TEMPOR_Mode_96: debounce-behavior=FREEZE
          debounce-algorithm:
            diag event debounce time based ALGO_DEBOUNCE_DefN_SORTIES_BSI_INHIBEES_TEMPOR_Mode_96: time-failed-threshold=2, time-passed-threshold=2
        ALGO_DefN_PUSH_HADC_Mode_00: debounce-behavior=FREEZE
          debounce-algorithm:
            diag event debounce time based ALGO_DEBOUNCE_DefN_PUSH_HADC_Mode_00: time-failed-threshold=2, time-passed-threshold=2
        ALGO_DefN_MONITORING_DAGMP_KEY_Mode_62: debounce-behavior=FREEZE
          debounce-algorithm:
            diag event debounce time based ALGO_DEBOUNCE_DefN_MONITORING_DAGMP_KEY_Mode_62: time-failed-threshold=2, time-passed-threshold=2
        ALGO_DefN_MONITORING_DAGMP_PUSH_Mode_62: debounce-behavior=FREEZE
          debounce-algorithm:
            diag event debounce time based ALGO_DEBOUNCE_DefN_MONITORING_DAGMP_PUSH_Mode_62: time-failed-threshold=2, time-passed-threshold=2
        ALGO_DefN_COM_ANORMALE_AVE_Mode_67: debounce-behavior=FREEZE
          debounce-algorithm:
            diag event debounce time based ALGO_DEBOUNCE_DefN_COM_ANORMALE_AVE_Mode_67: time-failed-threshold=2, time-passed-threshold=2
        ALGO_DefN_APPUI_PUSH_EN_ROULANT_Mode_00: debounce-behavior=FREEZE
          debounce-algorithm:
            diag event debounce time based ALGO_DEBOUNCE_DefN_APPUI_PUSH_EN_ROULANT_Mode_00: time-failed-threshold=2, time-passed-threshold=2
        ALGO_DefN_COHERENCE_PUSH_DEM_Mode_62: debounce-behavior=FREEZE
          debounce-algorithm:
            diag event debounce time based ALGO_DEBOUNCE_DefN_COHERENCE_PUSH_DEM_Mode_62: time-failed-threshold=2, time-passed-threshold=2
        ALGO_DefN_INCO_TELECODAGE_AVE_Mode_00: debounce-behavior=FREEZE
          debounce-algorithm:
            diag event debounce time based ALGO_DEBOUNCE_DefN_INCO_TELECODAGE_AVE_Mode_00: time-failed-threshold=2, time-passed-threshold=2
        ALGO_DefN_PUSH_DEM_COINCE_Mode_12: debounce-behavior=FREEZE
          debounce-algorithm:
            diag event debounce time based ALGO_DEBOUNCE_DefN_PUSH_DEM_COINCE_Mode_12: time-failed-threshold=2, time-passed-threshold=2
        ALGO_DefN_RELECTURE_APC_Mode_62: debounce-behavior=FREEZE
          debounce-algorithm:
            diag event debounce time based ALGO_DEBOUNCE_DefN_RELECTURE_APC_Mode_62: time-failed-threshold=2, time-passed-threshold=2
        ALGO_DefN_DEMARREUR_Mode_62: debounce-behavior=FREEZE
          debounce-algorithm:
            diag event debounce time based ALGO_DEBOUNCE_DefN_DEMARREUR_Mode_62: time-failed-threshold=2, time-passed-threshold=2
        ALGO_DefN_CLE_DEM_SANS_APC_Mode_62: debounce-behavior=FREEZE
          debounce-algorithm:
            diag event debounce time based ALGO_DEBOUNCE_DefN_CLE_DEM_SANS_APC_Mode_62: time-failed-threshold=2, time-passed-threshold=2
        ALGO_DefN_INFO_BOITIER_HY_Mode_87: debounce-behavior=FREEZE
          debounce-algorithm:
            diag event debounce time based ALGO_DEBOUNCE_DefN_INFO_BOITIER_HY_Mode_87: time-failed-threshold=2, time-passed-threshold=2
        ALGO_DefN_INFO_CHAINE_TRACT_AUTOR_DEM_Mode_87: debounce-behavior=FREEZE
          debounce-algorithm:
            diag event debounce time based ALGO_DEBOUNCE_DefN_INFO_CHAINE_TRACT_AUTOR_DEM_Mode_87: time-failed-threshold=2, time-passed-threshold=2
        ALGO_DefN_LIGNE_DEMARRAGE_Mode_62: debounce-behavior=FREEZE
          debounce-algorithm:
            diag event debounce time based ALGO_DEBOUNCE_DefN_LIGNE_DEMARRAGE_Mode_62: time-failed-threshold=2, time-passed-threshold=2
        ALGO_DefN_MOTEUR_COUPE_ROULANT_Mode_62: debounce-behavior=FREEZE
          debounce-algorithm:
            diag event debounce time based ALGO_DEBOUNCE_DefN_MOTEUR_COUPE_ROULANT_Mode_62: time-failed-threshold=2, time-passed-threshold=2
        ALGO_DefN_RELAIS_R1_DEFAUT_Mode_62: debounce-behavior=FREEZE
          debounce-algorithm:
            diag event debounce time based ALGO_DEBOUNCE_DefN_RELAIS_R1_DEFAUT_Mode_62: time-failed-threshold=2, time-passed-threshold=2
        ALGO_DefN_RELAIS_R2_DEFAUT_Mode_62: debounce-behavior=FREEZE
          debounce-algorithm:
            diag event debounce time based ALGO_DEBOUNCE_DefN_RELAIS_R2_DEFAUT_Mode_62: time-failed-threshold=2, time-passed-threshold=2
        ALGO_DefN_RETOUR_E1_DEFAUT_Mode_62: debounce-behavior=FREEZE
          debounce-algorithm:
            diag event debounce time based ALGO_DEBOUNCE_DefN_RETOUR_E1_DEFAUT_Mode_62: time-failed-threshold=2, time-passed-threshold=2
        ALGO_DefN_RETOUR_E2_DEFAUT_Mode_62: debounce-behavior=FREEZE
          debounce-algorithm:
            diag event debounce time based ALGO_DEBOUNCE_DefN_RETOUR_E2_DEFAUT_Mode_62: time-failed-threshold=2, time-passed-threshold=2
        ALGO_DefN_START_COMPT_RELAY_DEFAULT_Mode_00: debounce-behavior=FREEZE
          debounce-algorithm:
            diag event debounce time based ALGO_DEBOUNCE_DefN_START_COMPT_RELAY_DEFAULT_Mode_00: time-failed-threshold=2, time-passed-threshold=2
        ALGO_DefN_PUSH_DYN_GLOBAL_Mode_00: debounce-behavior=FREEZE
          debounce-algorithm:
            diag event debounce time based ALGO_DEBOUNCE_DefN_PUSH_DYN_GLOBAL_Mode_00: time-failed-threshold=2, time-passed-threshold=2
        ALGO_DefN_PUSH_DYN_PARTIEL_Mode_00: debounce-behavior=FREEZE
          debounce-algorithm:
            diag event debounce time based ALGO_DEBOUNCE_DefN_PUSH_DYN_PARTIEL_Mode_00: time-failed-threshold=2, time-passed-threshold=2
        ALGO_DefN_BATT_HT_HY_INVALIDE_Mode_00: debounce-behavior=FREEZE
          debounce-algorithm:
            diag event debounce time based ALGO_DEBOUNCE_DefN_BATT_HT_HY_INVALIDE_Mode_00: time-failed-threshold=2, time-passed-threshold=2
        ALGO_DefN_MEL_AR_HY_INVALIDE_Mode_00: debounce-behavior=FREEZE
          debounce-algorithm:
            diag event debounce time based ALGO_DEBOUNCE_DefN_MEL_AR_HY_INVALIDE_Mode_00: time-failed-threshold=2, time-passed-threshold=2
        ALGO_DefN_MEL_AV_HY_INVALIDE_Mode_00: debounce-behavior=FREEZE
          debounce-algorithm:
            diag event debounce time based ALGO_DEBOUNCE_DefN_MEL_AV_HY_INVALIDE_Mode_00: time-failed-threshold=2, time-passed-threshold=2
        ALGO_DefN_PTRAC_HY_INVALIDE_Mode_00: debounce-behavior=FREEZE
          debounce-algorithm:
            diag event debounce time based ALGO_DEBOUNCE_DefN_PTRAC_HY_INVALIDE_Mode_00: time-failed-threshold=2, time-passed-threshold=2
        ALGO_DefN_RECHARGE_HY_INVALIDE_Mode_00: debounce-behavior=FREEZE
          debounce-algorithm:
            diag event debounce time based ALGO_DEBOUNCE_DefN_RECHARGE_HY_INVALIDE_Mode_00: time-failed-threshold=2, time-passed-threshold=2
        ALGO_DefN_DEPASSEMENT_MAINTENANCE_Mode_00: debounce-behavior=FREEZE
          debounce-algorithm:
            diag event debounce time based ALGO_DEBOUNCE_DefN_DEPASSEMENT_MAINTENANCE_Mode_00: time-failed-threshold=2, time-passed-threshold=2
        ALGO_DefN_INFO_DDE_CHGT_RAPP_PALETTE_Mode_62: debounce-behavior=FREEZE
          debounce-algorithm:
            diag event debounce time based ALGO_DEBOUNCE_DefN_INFO_DDE_CHGT_RAPP_PALETTE_Mode_62: time-failed-threshold=2, time-passed-threshold=2
        ALGO_DefN_PALETTE_MOINS_BLOQ_Mode_12: debounce-behavior=FREEZE
          debounce-algorithm:
            diag event debounce time based ALGO_DEBOUNCE_DefN_PALETTE_MOINS_BLOQ_Mode_12: time-failed-threshold=2, time-passed-threshold=2
        ALGO_DefN_PALETTE_PLUS_BLOQ_Mode_12: debounce-behavior=FREEZE
          debounce-algorithm:
            diag event debounce time based ALGO_DEBOUNCE_DefN_PALETTE_PLUS_BLOQ_Mode_12: time-failed-threshold=2, time-passed-threshold=2
        ALGO_DefN_C_INTERN_RED_BRAKE_LAMP_Mode_62: debounce-behavior=FREEZE
          debounce-algorithm:
            diag event debounce time based ALGO_DEBOUNCE_DefN_C_INTERN_RED_BRAKE_LAMP_Mode_62: time-failed-threshold=2, time-passed-threshold=2
        ALGO_DefN_CTC_FREIN1_HS_APPUYE_Mode_62: debounce-behavior=FREEZE
          debounce-algorithm:
            diag event debounce time based ALGO_DEBOUNCE_DefN_CTC_FREIN1_HS_APPUYE_Mode_62: time-failed-threshold=2, time-passed-threshold=2
        ALGO_DefN_CTC_FREIN1_HS_RELACHE_Mode_62: debounce-behavior=FREEZE
          debounce-algorithm:
            diag event debounce time based ALGO_DEBOUNCE_DefN_CTC_FREIN1_HS_RELACHE_Mode_62: time-failed-threshold=2, time-passed-threshold=2
        ALGO_DefN_CTC_FREIN2_HS_APPUYE_Mode_62: debounce-behavior=FREEZE
          debounce-algorithm:
            diag event debounce time based ALGO_DEBOUNCE_DefN_CTC_FREIN2_HS_APPUYE_Mode_62: time-failed-threshold=2, time-passed-threshold=2
        ALGO_DefN_CTC_FREIN2_HS_RELACHE_Mode_62: debounce-behavior=FREEZE
          debounce-algorithm:
            diag event debounce time based ALGO_DEBOUNCE_DefN_CTC_FREIN2_HS_RELACHE_Mode_62: time-failed-threshold=2, time-passed-threshold=2
        ALGO_DefN_CAPTEUR_LIQUIDE_FREIN_Mode_93: debounce-behavior=FREEZE
          debounce-algorithm:
            diag event debounce time based ALGO_DEBOUNCE_DefN_CAPTEUR_LIQUIDE_FREIN_Mode_93: time-failed-threshold=2, time-passed-threshold=2
        ALGO_DefN_E_CONTACT_FREIN_Mode_62: debounce-behavior=FREEZE
          debounce-algorithm:
            diag event debounce time based ALGO_DEBOUNCE_DefN_E_CONTACT_FREIN_Mode_62: time-failed-threshold=2, time-passed-threshold=2
        ALGO_DefN_E_CPPF_ABS_APP_Mode_62: debounce-behavior=FREEZE
          debounce-algorithm:
            diag event debounce time based ALGO_DEBOUNCE_DefN_E_CPPF_ABS_APP_Mode_62: time-failed-threshold=2, time-passed-threshold=2
        ALGO_DefN_E_CPPF_APP_PERM_Mode_62: debounce-behavior=FREEZE
          debounce-algorithm:
            diag event debounce time based ALGO_DEBOUNCE_DefN_E_CPPF_APP_PERM_Mode_62: time-failed-threshold=2, time-passed-threshold=2
        ALGO_DefN_E_CPPF_DOUBLE_DEF_Mode_62: debounce-behavior=FREEZE
          debounce-algorithm:
            diag event debounce time based ALGO_DEBOUNCE_DefN_E_CPPF_DOUBLE_DEF_Mode_62: time-failed-threshold=2, time-passed-threshold=2
        ALGO_DefN_COHER_CONSIGN_XVV_TACTIL_Mode_62: debounce-behavior=FREEZE
          debounce-algorithm:
            diag event debounce time based ALGO_DEBOUNCE_DefN_COHER_CONSIGN_XVV_TACTIL_Mode_62: time-failed-threshold=2, time-passed-threshold=2
        ALGO_DefN_COHERENCE_CMM_LVV_RVV_Mode_62: debounce-behavior=FREEZE
          debounce-algorithm:
            diag event debounce time based ALGO_DEBOUNCE_DefN_COHERENCE_CMM_LVV_RVV_Mode_62: time-failed-threshold=2, time-passed-threshold=2
        ALGO_DefN_ACC_INCOHERENCE_CHKCPT_Mode_62: debounce-behavior=FREEZE
          debounce-algorithm:
            diag event debounce time based ALGO_DEBOUNCE_DefN_ACC_INCOHERENCE_CHKCPT_Mode_62: time-failed-threshold=2, time-passed-threshold=2
        ALGO_DefN_ACC_VAL_NON_AUTORISE_Mode_62: debounce-behavior=FREEZE
          debounce-algorithm:
            diag event debounce time based ALGO_DEBOUNCE_DefN_ACC_VAL_NON_AUTORISE_Mode_62: time-failed-threshold=2, time-passed-threshold=2
        ALGO_DefN_COHERENCE_BSI_ACC_Mode_62: debounce-behavior=FREEZE
          debounce-algorithm:
            diag event debounce time based ALGO_DEBOUNCE_DefN_COHERENCE_BSI_ACC_Mode_62: time-failed-threshold=2, time-passed-threshold=2
        ALGO_DefN_UCF_INCOHERENCE_CHKCPT_Mode_62: debounce-behavior=FREEZE
          debounce-algorithm:
            diag event debounce time based ALGO_DEBOUNCE_DefN_UCF_INCOHERENCE_CHKCPT_Mode_62: time-failed-threshold=2, time-passed-threshold=2
        ALGO_DefN_DEFAUT_RVVI_CHOC_Mode_00: debounce-behavior=FREEZE
          debounce-algorithm:
            diag event debounce time based ALGO_DEBOUNCE_DefN_DEFAUT_RVVI_CHOC_Mode_00: time-failed-threshold=2, time-passed-threshold=2
        ALGO_DefN_CMB_DEFAILLANT_Mode_62: debounce-behavior=FREEZE
          debounce-algorithm:
            diag event debounce time based ALGO_DEBOUNCE_DefN_CMB_DEFAILLANT_Mode_62: time-failed-threshold=2, time-passed-threshold=2
        ALGO_DefN_HDC_DEFAILLANT_Mode_62: debounce-behavior=FREEZE
          debounce-algorithm:
            diag event debounce time based ALGO_DEBOUNCE_DefN_HDC_DEFAILLANT_Mode_62: time-failed-threshold=2, time-passed-threshold=2
        ALGO_DefN_MATT_DEFAILLANT_Mode_62: debounce-behavior=FREEZE
          debounce-algorithm:
            diag event debounce time based ALGO_DEBOUNCE_DefN_MATT_DEFAILLANT_Mode_62: time-failed-threshold=2, time-passed-threshold=2
        ALGO_DefN_PUSH_LVV_RVV_COINCE_Mode_29: debounce-behavior=FREEZE
          debounce-algorithm:
            diag event debounce time based ALGO_DEBOUNCE_DefN_PUSH_LVV_RVV_COINCE_Mode_29: time-failed-threshold=2, time-passed-threshold=2
        ALGO_DefN_VTH_DEFAILLANT_Mode_62: debounce-behavior=FREEZE
          debounce-algorithm:
            diag event debounce time based ALGO_DEBOUNCE_DefN_VTH_DEFAILLANT_Mode_62: time-failed-threshold=2, time-passed-threshold=2
        ALGO_DefN_CMPT_REDEM_CMM_Mode_11: debounce-behavior=FREEZE
          debounce-algorithm:
            diag event debounce time based ALGO_DEBOUNCE_DefN_CMPT_REDEM_CMM_Mode_11: time-failed-threshold=2, time-passed-threshold=2
        ALGO_DefN_PUSH_STT_COINCE_Mode_11: debounce-behavior=FREEZE
          debounce-algorithm:
            diag event debounce time based ALGO_DEBOUNCE_DefN_PUSH_STT_COINCE_Mode_11: time-failed-threshold=2, time-passed-threshold=2
        ALGO_DefN_TELECODAGE_AAS_Mode_00: debounce-behavior=FREEZE
          debounce-algorithm:
            diag event debounce time based ALGO_DEBOUNCE_DefN_TELECODAGE_AAS_Mode_00: time-failed-threshold=2, time-passed-threshold=2
        ALGO_DefN_TELECODAGE_SAM_Mode_00: debounce-behavior=FREEZE
          debounce-algorithm:
            diag event debounce time based ALGO_DEBOUNCE_DefN_TELECODAGE_SAM_Mode_00: time-failed-threshold=2, time-passed-threshold=2
        ALGO_DefN_POMPE_ADDITIVATION_Mode_96: debounce-behavior=FREEZE
          debounce-algorithm:
            diag event debounce time based ALGO_DEBOUNCE_DefN_POMPE_ADDITIVATION_Mode_96: time-failed-threshold=2, time-passed-threshold=2
        ALGO_DefN_PUSH_MODE_GPL_Mode_11: debounce-behavior=FREEZE
          debounce-algorithm:
            diag event debounce time based ALGO_DEBOUNCE_DefN_PUSH_MODE_GPL_Mode_11: time-failed-threshold=2, time-passed-threshold=2
        ALGO_DefN_CAPTEUR_PRESENCE_BOUCHON_Mode_1B: debounce-behavior=FREEZE
          debounce-algorithm:
            diag event debounce time based ALGO_DEBOUNCE_DefN_CAPTEUR_PRESENCE_BOUCHON_Mode_1B: time-failed-threshold=2, time-passed-threshold=2
        ALGO_DefN_CAPTEUR_PRESENCE_BOUCHON_Mode_1E: debounce-behavior=FREEZE
          debounce-algorithm:
            diag event debounce time based ALGO_DEBOUNCE_DefN_CAPTEUR_PRESENCE_BOUCHON_Mode_1E: time-failed-threshold=2, time-passed-threshold=2
        ALGO_DefN_CAPTEUR_PRESENCE_BOUCHON_Mode_76: debounce-behavior=FREEZE
          debounce-algorithm:
            diag event debounce time based ALGO_DEBOUNCE_DefN_CAPTEUR_PRESENCE_BOUCHON_Mode_76: time-failed-threshold=2, time-passed-threshold=2
        ALGO_DefN_JAUGE_CARBURANT_Mode_1A: debounce-behavior=FREEZE
          debounce-algorithm:
            diag event debounce time based ALGO_DEBOUNCE_DefN_JAUGE_CARBURANT_Mode_1A: time-failed-threshold=2, time-passed-threshold=2
        ALGO_DefN_JAUGE_CARBURANT_Mode_1B: debounce-behavior=FREEZE
          debounce-algorithm:
            diag event debounce time based ALGO_DEBOUNCE_DefN_JAUGE_CARBURANT_Mode_1B: time-failed-threshold=2, time-passed-threshold=2
        ALGO_DefN_PUSH_COFFRE_HAB_Mode_11: debounce-behavior=FREEZE
          debounce-algorithm:
            diag event debounce time based ALGO_DEBOUNCE_DefN_PUSH_COFFRE_HAB_Mode_11: time-failed-threshold=2, time-passed-threshold=2
        ALGO_DefN_PUSH_CONDA_CHARGE_Mode_11: debounce-behavior=FREEZE
          debounce-algorithm:
            diag event debounce time based ALGO_DEBOUNCE_DefN_PUSH_CONDA_CHARGE_Mode_11: time-failed-threshold=2, time-passed-threshold=2
        ALGO_DefN_PUSH_CONDA_Mode_11: debounce-behavior=FREEZE
          debounce-algorithm:
            diag event debounce time based ALGO_DEBOUNCE_DefN_PUSH_CONDA_Mode_11: time-failed-threshold=2, time-passed-threshold=2
        ALGO_DefN_HF_REMOTE_CONTROL_KEY_DESYNC_Mode_62: debounce-behavior=FREEZE
          debounce-algorithm:
            diag event debounce time based ALGO_DEBOUNCE_DefN_HF_REMOTE_CONTROL_KEY_DESYNC_Mode_62: time-failed-threshold=2, time-passed-threshold=2
        ALGO_DefN_CONFIG_SECU_ENFANT_Mode_62: debounce-behavior=FREEZE
          debounce-algorithm:
            diag event debounce time based ALGO_DEBOUNCE_DefN_CONFIG_SECU_ENFANT_Mode_62: time-failed-threshold=2, time-passed-threshold=2
        ALGO_DefN_LED_SECU_ENFANT_Mode_12: debounce-behavior=FREEZE
          debounce-algorithm:
            diag event debounce time based ALGO_DEBOUNCE_DefN_LED_SECU_ENFANT_Mode_12: time-failed-threshold=2, time-passed-threshold=2
        ALGO_DefN_LED_SECU_ENFANT_Mode_13: debounce-behavior=FREEZE
          debounce-algorithm:
            diag event debounce time based ALGO_DEBOUNCE_DefN_LED_SECU_ENFANT_Mode_13: time-failed-threshold=2, time-passed-threshold=2
        ALGO_DefN_LED_SECU_ENFANT_Mode_14: debounce-behavior=FREEZE
          debounce-algorithm:
            diag event debounce time based ALGO_DEBOUNCE_DefN_LED_SECU_ENFANT_Mode_14: time-failed-threshold=2, time-passed-threshold=2
        ALGO_DefN_LED_SECU_ENFANT_Mode_15: debounce-behavior=FREEZE
          debounce-algorithm:
            diag event debounce time based ALGO_DEBOUNCE_DefN_LED_SECU_ENFANT_Mode_15: time-failed-threshold=2, time-passed-threshold=2
        ALGO_DefN_PUSH_SECU_ENFANT_Mode_11: debounce-behavior=FREEZE
          debounce-algorithm:
            diag event debounce time based ALGO_DEBOUNCE_DefN_PUSH_SECU_ENFANT_Mode_11: time-failed-threshold=2, time-passed-threshold=2
        ALGO_DefN_SECU_ENFANT_Mode_62: debounce-behavior=FREEZE
          debounce-algorithm:
            diag event debounce time based ALGO_DEBOUNCE_DefN_SECU_ENFANT_Mode_62: time-failed-threshold=2, time-passed-threshold=2
        ALGO_DefN_TSE_SERR_ARD_Mode_62: debounce-behavior=FREEZE
          debounce-algorithm:
            diag event debounce time based ALGO_DEBOUNCE_DefN_TSE_SERR_ARD_Mode_62: time-failed-threshold=2, time-passed-threshold=2
        ALGO_DefN_TSE_SERR_ARG_Mode_62: debounce-behavior=FREEZE
          debounce-algorithm:
            diag event debounce time based ALGO_DEBOUNCE_DefN_TSE_SERR_ARG_Mode_62: time-failed-threshold=2, time-passed-threshold=2
        ALGO_DefN_TSE_SERR_PB_Mode_62: debounce-behavior=FREEZE
          debounce-algorithm:
            diag event debounce time based ALGO_DEBOUNCE_DefN_TSE_SERR_PB_Mode_62: time-failed-threshold=2, time-passed-threshold=2
        ALGO_DefN_CAV_SERR_AVD_Mode_11: debounce-behavior=FREEZE
          debounce-algorithm:
            diag event debounce time based ALGO_DEBOUNCE_DefN_CAV_SERR_AVD_Mode_11: time-failed-threshold=2, time-passed-threshold=2
        ALGO_DefN_CAV_SERR_AVG_Mode_11: debounce-behavior=FREEZE
          debounce-algorithm:
            diag event debounce time based ALGO_DEBOUNCE_DefN_CAV_SERR_AVG_Mode_11: time-failed-threshold=2, time-passed-threshold=2
        ALGO_DefN_CAV_SERR_PB_Mode_11: debounce-behavior=FREEZE
          debounce-algorithm:
            diag event debounce time based ALGO_DEBOUNCE_DefN_CAV_SERR_PB_Mode_11: time-failed-threshold=2, time-passed-threshold=2
        ALGO_DefN_CEV_SERR_ARD_Mode_64: debounce-behavior=FREEZE
          debounce-algorithm:
            diag event debounce time based ALGO_DEBOUNCE_DefN_CEV_SERR_ARD_Mode_64: time-failed-threshold=2, time-passed-threshold=2
        ALGO_DefN_CEV_SERR_ARG_Mode_64: debounce-behavior=FREEZE
          debounce-algorithm:
            diag event debounce time based ALGO_DEBOUNCE_DefN_CEV_SERR_ARG_Mode_64: time-failed-threshold=2, time-passed-threshold=2
        ALGO_DefN_CEV_SERR_AVD_Mode_64: debounce-behavior=FREEZE
          debounce-algorithm:
            diag event debounce time based ALGO_DEBOUNCE_DefN_CEV_SERR_AVD_Mode_64: time-failed-threshold=2, time-passed-threshold=2
        ALGO_DefN_CEV_SERR_AVG_Mode_64: debounce-behavior=FREEZE
          debounce-algorithm:
            diag event debounce time based ALGO_DEBOUNCE_DefN_CEV_SERR_AVG_Mode_64: time-failed-threshold=2, time-passed-threshold=2
        ALGO_DefN_CEV_SERR_PB_Mode_64: debounce-behavior=FREEZE
          debounce-algorithm:
            diag event debounce time based ALGO_DEBOUNCE_DefN_CEV_SERR_PB_Mode_64: time-failed-threshold=2, time-passed-threshold=2
        ALGO_DefN_DEFAILLANCE_CPO_COND_Mode_96: debounce-behavior=FREEZE
          debounce-algorithm:
            diag event debounce time based ALGO_DEBOUNCE_DefN_DEFAILLANCE_CPO_COND_Mode_96: time-failed-threshold=2, time-passed-threshold=2
        ALGO_DefN_GEN_SERR_ARD_Mode_62: debounce-behavior=FREEZE
          debounce-algorithm:
            diag event debounce time based ALGO_DEBOUNCE_DefN_GEN_SERR_ARD_Mode_62: time-failed-threshold=2, time-passed-threshold=2
        ALGO_DefN_GEN_SERR_ARG_Mode_62: debounce-behavior=FREEZE
          debounce-algorithm:
            diag event debounce time based ALGO_DEBOUNCE_DefN_GEN_SERR_ARG_Mode_62: time-failed-threshold=2, time-passed-threshold=2
        ALGO_DefN_GEN_SERR_AVD_Mode_62: debounce-behavior=FREEZE
          debounce-algorithm:
            diag event debounce time based ALGO_DEBOUNCE_DefN_GEN_SERR_AVD_Mode_62: time-failed-threshold=2, time-passed-threshold=2
        ALGO_DefN_GEN_SERR_AVG_Mode_62: debounce-behavior=FREEZE
          debounce-algorithm:
            diag event debounce time based ALGO_DEBOUNCE_DefN_GEN_SERR_AVG_Mode_62: time-failed-threshold=2, time-passed-threshold=2
        ALGO_DefN_GEN_SERR_PB_Mode_62: debounce-behavior=FREEZE
          debounce-algorithm:
            diag event debounce time based ALGO_DEBOUNCE_DefN_GEN_SERR_PB_Mode_62: time-failed-threshold=2, time-passed-threshold=2
        ALGO_DefN_CAPT_COURANT_BECB_Mode_13: debounce-behavior=FREEZE
          debounce-algorithm:
            diag event debounce time based ALGO_DEBOUNCE_DefN_CAPT_COURANT_BECB_Mode_13: time-failed-threshold=2, time-passed-threshold=2
        ALGO_DefN_CAPT_COURANT_BECB_Mode_84: debounce-behavior=FREEZE
          debounce-algorithm:
            diag event debounce time based ALGO_DEBOUNCE_DefN_CAPT_COURANT_BECB_Mode_84: time-failed-threshold=2, time-passed-threshold=2
        ALGO_DefN_CAPT_COURANT_BECB_Mode_85: debounce-behavior=FREEZE
          debounce-algorithm:
            diag event debounce time based ALGO_DEBOUNCE_DefN_CAPT_COURANT_BECB_Mode_85: time-failed-threshold=2, time-passed-threshold=2
        ALGO_DefN_CAPT_TEMPERATURE_BECB_Mode_84: debounce-behavior=FREEZE
          debounce-algorithm:
            diag event debounce time based ALGO_DEBOUNCE_DefN_CAPT_TEMPERATURE_BECB_Mode_84: time-failed-threshold=2, time-passed-threshold=2
        ALGO_DefN_CAPT_TEMPERATURE_BECB_Mode_85: debounce-behavior=FREEZE
          debounce-algorithm:
            diag event debounce time based ALGO_DEBOUNCE_DefN_CAPT_TEMPERATURE_BECB_Mode_85: time-failed-threshold=2, time-passed-threshold=2
        ALGO_DefN_CAPT_TEMPERATURE_BECB_Mode_93: debounce-behavior=FREEZE
          debounce-algorithm:
            diag event debounce time based ALGO_DEBOUNCE_DefN_CAPT_TEMPERATURE_BECB_Mode_93: time-failed-threshold=2, time-passed-threshold=2
        ALGO_DefN_CAPT_TENSION_BECB_Mode_14: debounce-behavior=FREEZE
          debounce-algorithm:
            diag event debounce time based ALGO_DEBOUNCE_DefN_CAPT_TENSION_BECB_Mode_14: time-failed-threshold=2, time-passed-threshold=2
        ALGO_DefN_CAPT_TENSION_BECB_Mode_84: debounce-behavior=FREEZE
          debounce-algorithm:
            diag event debounce time based ALGO_DEBOUNCE_DefN_CAPT_TENSION_BECB_Mode_84: time-failed-threshold=2, time-passed-threshold=2
        ALGO_DefN_CAPT_TENSION_BECB_Mode_85: debounce-behavior=FREEZE
          debounce-algorithm:
            diag event debounce time based ALGO_DEBOUNCE_DefN_CAPT_TENSION_BECB_Mode_85: time-failed-threshold=2, time-passed-threshold=2
        ALGO_DefN_MEMOIRE_BECB_Mode_44: debounce-behavior=FREEZE
          debounce-algorithm:
            diag event debounce time based ALGO_DEBOUNCE_DefN_MEMOIRE_BECB_Mode_44: time-failed-threshold=2, time-passed-threshold=2
        ALGO_DefN_MEMOIRE_BECB_Mode_45: debounce-behavior=FREEZE
          debounce-algorithm:
            diag event debounce time based ALGO_DEBOUNCE_DefN_MEMOIRE_BECB_Mode_45: time-failed-threshold=2, time-passed-threshold=2
        ALGO_DefN_RESET_BECB_Mode_47: debounce-behavior=FREEZE
          debounce-algorithm:
            diag event debounce time based ALGO_DEBOUNCE_DefN_RESET_BECB_Mode_47: time-failed-threshold=2, time-passed-threshold=2
        ALGO_DefN_TELECODAGE_BECB_Mode_81: debounce-behavior=FREEZE
          debounce-algorithm:
            diag event debounce time based ALGO_DEBOUNCE_DefN_TELECODAGE_BECB_Mode_81: time-failed-threshold=2, time-passed-threshold=2
        ALGO_DefN_ALIM_RELAIS_PRINCIPAL_Mode_12: debounce-behavior=FREEZE
          debounce-algorithm:
            diag event debounce time based ALGO_DEBOUNCE_DefN_ALIM_RELAIS_PRINCIPAL_Mode_12: time-failed-threshold=2, time-passed-threshold=2
        ALGO_DefN_ALIM_RELAIS_PRINCIPAL_Mode_14: debounce-behavior=FREEZE
          debounce-algorithm:
            diag event debounce time based ALGO_DEBOUNCE_DefN_ALIM_RELAIS_PRINCIPAL_Mode_14: time-failed-threshold=2, time-passed-threshold=2
        ALGO_DefN_RELAIS_PLUS_ACC_Mode_12: debounce-behavior=FREEZE
          debounce-algorithm:
            diag event debounce time based ALGO_DEBOUNCE_DefN_RELAIS_PLUS_ACC_Mode_12: time-failed-threshold=2, time-passed-threshold=2
        ALGO_DefN_RELAIS_PLUS_ACC_Mode_14: debounce-behavior=FREEZE
          debounce-algorithm:
            diag event debounce time based ALGO_DEBOUNCE_DefN_RELAIS_PLUS_ACC_Mode_14: time-failed-threshold=2, time-passed-threshold=2
        ALGO_DefN_CONF_STT_BSI_CMM_Mode_00: debounce-behavior=FREEZE
          debounce-algorithm:
            diag event debounce time based ALGO_DEBOUNCE_DefN_CONF_STT_BSI_CMM_Mode_00: time-failed-threshold=2, time-passed-threshold=2
        ALGO_DefN_DEFAUT_DELESTAGE_CONFORT_Mode_11: debounce-behavior=FREEZE
          debounce-algorithm:
            diag event debounce time based ALGO_DEBOUNCE_DefN_DEFAUT_DELESTAGE_CONFORT_Mode_11: time-failed-threshold=2, time-passed-threshold=2
        ALGO_DefN_DEFAUT_DELESTAGE_CONFORT_Mode_15: debounce-behavior=FREEZE
          debounce-algorithm:
            diag event debounce time based ALGO_DEBOUNCE_DefN_DEFAUT_DELESTAGE_CONFORT_Mode_15: time-failed-threshold=2, time-passed-threshold=2
        ALGO_DefN_DEFAUT_GENERATEUR_Mode_16: debounce-behavior=FREEZE
          debounce-algorithm:
            diag event debounce time based ALGO_DEBOUNCE_DefN_DEFAUT_GENERATEUR_Mode_16: time-failed-threshold=2, time-passed-threshold=2
        ALGO_DefN_DEFAUT_GENERATEUR_Mode_17: debounce-behavior=FREEZE
          debounce-algorithm:
            diag event debounce time based ALGO_DEBOUNCE_DefN_DEFAUT_GENERATEUR_Mode_17: time-failed-threshold=2, time-passed-threshold=2
        ALGO_DefN_DEFAUT_GENERATEUR_Mode_62: debounce-behavior=FREEZE
          debounce-algorithm:
            diag event debounce time based ALGO_DEBOUNCE_DefN_DEFAUT_GENERATEUR_Mode_62: time-failed-threshold=2, time-passed-threshold=2
        ALGO_DefN_DEFAUT_PERTE_COM_DMTR_Mode_00: debounce-behavior=FREEZE
          debounce-algorithm:
            diag event debounce time based ALGO_DEBOUNCE_DefN_DEFAUT_PERTE_COM_DMTR_Mode_00: time-failed-threshold=2, time-passed-threshold=2
        ALGO_DefN_PRODUCTION_ALTERNATEUR_Mode_1C: debounce-behavior=FREEZE
          debounce-algorithm:
            diag event debounce time based ALGO_DEBOUNCE_DefN_PRODUCTION_ALTERNATEUR_Mode_1C: time-failed-threshold=2, time-passed-threshold=2
        ALGO_DefN_RETROECLAIRAGE_PUSHS_Mode_11: debounce-behavior=FREEZE
          debounce-algorithm:
            diag event debounce time based ALGO_DEBOUNCE_DefN_RETROECLAIRAGE_PUSHS_Mode_11: time-failed-threshold=2, time-passed-threshold=2
        ALGO_DefN_RETROECLAIRAGE_PUSHS_Mode_12: debounce-behavior=FREEZE
          debounce-algorithm:
            diag event debounce time based ALGO_DEBOUNCE_DefN_RETROECLAIRAGE_PUSHS_Mode_12: time-failed-threshold=2, time-passed-threshold=2
        ALGO_DefN_RETROECLAIRAGE_PUSHS_Mode_15: debounce-behavior=FREEZE
          debounce-algorithm:
            diag event debounce time based ALGO_DEBOUNCE_DefN_RETROECLAIRAGE_PUSHS_Mode_15: time-failed-threshold=2, time-passed-threshold=2
        ALGO_Defn_CNB_PRES_CONDUCTEUR_Mode_00: debounce-behavior=FREEZE
          debounce-algorithm:
            diag event debounce time based ALGO_DEBOUNCE_Defn_CNB_PRES_CONDUCTEUR_Mode_00: time-failed-threshold=2, time-passed-threshold=2
        ALGO_DefN_CPO_PRES_CONDUCTEUR_Mode_00: debounce-behavior=FREEZE
          debounce-algorithm:
            diag event debounce time based ALGO_DEBOUNCE_DefN_CPO_PRES_CONDUCTEUR_Mode_00: time-failed-threshold=2, time-passed-threshold=2
        ALGO_DefN_AUTOR_MASSAGE_TWINZONE_Mode_11: debounce-behavior=FREEZE
          debounce-algorithm:
            diag event debounce time based ALGO_DEBOUNCE_DefN_AUTOR_MASSAGE_TWINZONE_Mode_11: time-failed-threshold=2, time-passed-threshold=2
        ALGO_DefN_AUTOR_MASSAGE_TWINZONE_Mode_13: debounce-behavior=FREEZE
          debounce-algorithm:
            diag event debounce time based ALGO_DEBOUNCE_DefN_AUTOR_MASSAGE_TWINZONE_Mode_13: time-failed-threshold=2, time-passed-threshold=2
        ALGO_DefN_AUTOR_REGLAGE_LOMBAIRE_Mode_11: debounce-behavior=FREEZE
          debounce-algorithm:
            diag event debounce time based ALGO_DEBOUNCE_DefN_AUTOR_REGLAGE_LOMBAIRE_Mode_11: time-failed-threshold=2, time-passed-threshold=2
        ALGO_DefN_AUTOR_REGLAGE_LOMBAIRE_Mode_13: debounce-behavior=FREEZE
          debounce-algorithm:
            diag event debounce time based ALGO_DEBOUNCE_DefN_AUTOR_REGLAGE_LOMBAIRE_Mode_13: time-failed-threshold=2, time-passed-threshold=2
        ALGO_DefN_AUTOR_REGL_SIEGE_COND_ELEC_Mode_11: debounce-behavior=FREEZE
          debounce-algorithm:
            diag event debounce time based ALGO_DEBOUNCE_DefN_AUTOR_REGL_SIEGE_COND_ELEC_Mode_11: time-failed-threshold=2, time-passed-threshold=2
        ALGO_DefN_AUTOR_REGL_SIEGE_COND_ELEC_Mode_13: debounce-behavior=FREEZE
          debounce-algorithm:
            diag event debounce time based ALGO_DEBOUNCE_DefN_AUTOR_REGL_SIEGE_COND_ELEC_Mode_13: time-failed-threshold=2, time-passed-threshold=2
        ALGO_DefN_AUTOR_REGL_SIEGE_PASS_ELEC_Mode_11: debounce-behavior=FREEZE
          debounce-algorithm:
            diag event debounce time based ALGO_DEBOUNCE_DefN_AUTOR_REGL_SIEGE_PASS_ELEC_Mode_11: time-failed-threshold=2, time-passed-threshold=2
        ALGO_DefN_AUTOR_REGL_SIEGE_PASS_ELEC_Mode_13: debounce-behavior=FREEZE
          debounce-algorithm:
            diag event debounce time based ALGO_DEBOUNCE_DefN_AUTOR_REGL_SIEGE_PASS_ELEC_Mode_13: time-failed-threshold=2, time-passed-threshold=2
        ALGO_DefN_NAPPE_CHAUFFANTE_SIEGE_ARD_Mode_11: debounce-behavior=FREEZE
          debounce-algorithm:
            diag event debounce time based ALGO_DEBOUNCE_DefN_NAPPE_CHAUFFANTE_SIEGE_ARD_Mode_11: time-failed-threshold=2, time-passed-threshold=2
        ALGO_DefN_NAPPE_CHAUFFANTE_SIEGE_ARD_Mode_12: debounce-behavior=FREEZE
          debounce-algorithm:
            diag event debounce time based ALGO_DEBOUNCE_DefN_NAPPE_CHAUFFANTE_SIEGE_ARD_Mode_12: time-failed-threshold=2, time-passed-threshold=2
        ALGO_DefN_NAPPE_CHAUFFANTE_SIEGE_ARD_Mode_13: debounce-behavior=FREEZE
          debounce-algorithm:
            diag event debounce time based ALGO_DEBOUNCE_DefN_NAPPE_CHAUFFANTE_SIEGE_ARD_Mode_13: time-failed-threshold=2, time-passed-threshold=2
        ALGO_DefN_NAPPE_CHAUFFANTE_SIEGE_ARG_Mode_11: debounce-behavior=FREEZE
          debounce-algorithm:
            diag event debounce time based ALGO_DEBOUNCE_DefN_NAPPE_CHAUFFANTE_SIEGE_ARG_Mode_11: time-failed-threshold=2, time-passed-threshold=2
        ALGO_DefN_NAPPE_CHAUFFANTE_SIEGE_ARG_Mode_12: debounce-behavior=FREEZE
          debounce-algorithm:
            diag event debounce time based ALGO_DEBOUNCE_DefN_NAPPE_CHAUFFANTE_SIEGE_ARG_Mode_12: time-failed-threshold=2, time-passed-threshold=2
        ALGO_DefN_NAPPE_CHAUFFANTE_SIEGE_ARG_Mode_13: debounce-behavior=FREEZE
          debounce-algorithm:
            diag event debounce time based ALGO_DEBOUNCE_DefN_NAPPE_CHAUFFANTE_SIEGE_ARG_Mode_13: time-failed-threshold=2, time-passed-threshold=2
        ALGO_DefN_NAPPE_CHAUFFANTE_SIEGE_AVD_Mode_11: debounce-behavior=FREEZE
          debounce-algorithm:
            diag event debounce time based ALGO_DEBOUNCE_DefN_NAPPE_CHAUFFANTE_SIEGE_AVD_Mode_11: time-failed-threshold=2, time-passed-threshold=2
        ALGO_DefN_NAPPE_CHAUFFANTE_SIEGE_AVD_Mode_12: debounce-behavior=FREEZE
          debounce-algorithm:
            diag event debounce time based ALGO_DEBOUNCE_DefN_NAPPE_CHAUFFANTE_SIEGE_AVD_Mode_12: time-failed-threshold=2, time-passed-threshold=2
        ALGO_DefN_NAPPE_CHAUFFANTE_SIEGE_AVD_Mode_13: debounce-behavior=FREEZE
          debounce-algorithm:
            diag event debounce time based ALGO_DEBOUNCE_DefN_NAPPE_CHAUFFANTE_SIEGE_AVD_Mode_13: time-failed-threshold=2, time-passed-threshold=2
        ALGO_DefN_NAPPE_CHAUFFANTE_SIEGE_AVG_Mode_11: debounce-behavior=FREEZE
          debounce-algorithm:
            diag event debounce time based ALGO_DEBOUNCE_DefN_NAPPE_CHAUFFANTE_SIEGE_AVG_Mode_11: time-failed-threshold=2, time-passed-threshold=2
        ALGO_DefN_NAPPE_CHAUFFANTE_SIEGE_AVG_Mode_12: debounce-behavior=FREEZE
          debounce-algorithm:
            diag event debounce time based ALGO_DEBOUNCE_DefN_NAPPE_CHAUFFANTE_SIEGE_AVG_Mode_12: time-failed-threshold=2, time-passed-threshold=2
        ALGO_DefN_NAPPE_CHAUFFANTE_SIEGE_AVG_Mode_13: debounce-behavior=FREEZE
          debounce-algorithm:
            diag event debounce time based ALGO_DEBOUNCE_DefN_NAPPE_CHAUFFANTE_SIEGE_AVG_Mode_13: time-failed-threshold=2, time-passed-threshold=2
        ALGO_DefN_PULSEUR_SIEGE_ARD_Mode_11: debounce-behavior=FREEZE
          debounce-algorithm:
            diag event debounce time based ALGO_DEBOUNCE_DefN_PULSEUR_SIEGE_ARD_Mode_11: time-failed-threshold=2, time-passed-threshold=2
        ALGO_DefN_PULSEUR_SIEGE_ARD_Mode_12: debounce-behavior=FREEZE
          debounce-algorithm:
            diag event debounce time based ALGO_DEBOUNCE_DefN_PULSEUR_SIEGE_ARD_Mode_12: time-failed-threshold=2, time-passed-threshold=2
        ALGO_DefN_PULSEUR_SIEGE_ARD_Mode_13: debounce-behavior=FREEZE
          debounce-algorithm:
            diag event debounce time based ALGO_DEBOUNCE_DefN_PULSEUR_SIEGE_ARD_Mode_13: time-failed-threshold=2, time-passed-threshold=2
        ALGO_DefN_PULSEUR_SIEGE_ARG_Mode_11: debounce-behavior=FREEZE
          debounce-algorithm:
            diag event debounce time based ALGO_DEBOUNCE_DefN_PULSEUR_SIEGE_ARG_Mode_11: time-failed-threshold=2, time-passed-threshold=2
        ALGO_DefN_PULSEUR_SIEGE_ARG_Mode_12: debounce-behavior=FREEZE
          debounce-algorithm:
            diag event debounce time based ALGO_DEBOUNCE_DefN_PULSEUR_SIEGE_ARG_Mode_12: time-failed-threshold=2, time-passed-threshold=2
        ALGO_DefN_PULSEUR_SIEGE_ARG_Mode_13: debounce-behavior=FREEZE
          debounce-algorithm:
            diag event debounce time based ALGO_DEBOUNCE_DefN_PULSEUR_SIEGE_ARG_Mode_13: time-failed-threshold=2, time-passed-threshold=2
        ALGO_DefN_PULSEUR_SIEGE_AVD_Mode_11: debounce-behavior=FREEZE
          debounce-algorithm:
            diag event debounce time based ALGO_DEBOUNCE_DefN_PULSEUR_SIEGE_AVD_Mode_11: time-failed-threshold=2, time-passed-threshold=2
        ALGO_DefN_PULSEUR_SIEGE_AVD_Mode_12: debounce-behavior=FREEZE
          debounce-algorithm:
            diag event debounce time based ALGO_DEBOUNCE_DefN_PULSEUR_SIEGE_AVD_Mode_12: time-failed-threshold=2, time-passed-threshold=2
        ALGO_DefN_PULSEUR_SIEGE_AVD_Mode_13: debounce-behavior=FREEZE
          debounce-algorithm:
            diag event debounce time based ALGO_DEBOUNCE_DefN_PULSEUR_SIEGE_AVD_Mode_13: time-failed-threshold=2, time-passed-threshold=2
        ALGO_DefN_PULSEUR_SIEGE_AVG_Mode_11: debounce-behavior=FREEZE
          debounce-algorithm:
            diag event debounce time based ALGO_DEBOUNCE_DefN_PULSEUR_SIEGE_AVG_Mode_11: time-failed-threshold=2, time-passed-threshold=2
        ALGO_DefN_PULSEUR_SIEGE_AVG_Mode_12: debounce-behavior=FREEZE
          debounce-algorithm:
            diag event debounce time based ALGO_DEBOUNCE_DefN_PULSEUR_SIEGE_AVG_Mode_12: time-failed-threshold=2, time-passed-threshold=2
        ALGO_DefN_PULSEUR_SIEGE_AVG_Mode_13: debounce-behavior=FREEZE
          debounce-algorithm:
            diag event debounce time based ALGO_DEBOUNCE_DefN_PULSEUR_SIEGE_AVG_Mode_13: time-failed-threshold=2, time-passed-threshold=2
        ALGO_DefN_SONDE_TEMP_SIEGE_ARD_Mode_11: debounce-behavior=FREEZE
          debounce-algorithm:
            diag event debounce time based ALGO_DEBOUNCE_DefN_SONDE_TEMP_SIEGE_ARD_Mode_11: time-failed-threshold=2, time-passed-threshold=2
        ALGO_DefN_SONDE_TEMP_SIEGE_ARD_Mode_12: debounce-behavior=FREEZE
          debounce-algorithm:
            diag event debounce time based ALGO_DEBOUNCE_DefN_SONDE_TEMP_SIEGE_ARD_Mode_12: time-failed-threshold=2, time-passed-threshold=2
        ALGO_DefN_SONDE_TEMP_SIEGE_ARD_Mode_13: debounce-behavior=FREEZE
          debounce-algorithm:
            diag event debounce time based ALGO_DEBOUNCE_DefN_SONDE_TEMP_SIEGE_ARD_Mode_13: time-failed-threshold=2, time-passed-threshold=2
        ALGO_DefN_SONDE_TEMP_SIEGE_ARG_Mode_11: debounce-behavior=FREEZE
          debounce-algorithm:
            diag event debounce time based ALGO_DEBOUNCE_DefN_SONDE_TEMP_SIEGE_ARG_Mode_11: time-failed-threshold=2, time-passed-threshold=2
        ALGO_DefN_SONDE_TEMP_SIEGE_ARG_Mode_12: debounce-behavior=FREEZE
          debounce-algorithm:
            diag event debounce time based ALGO_DEBOUNCE_DefN_SONDE_TEMP_SIEGE_ARG_Mode_12: time-failed-threshold=2, time-passed-threshold=2
        ALGO_DefN_SONDE_TEMP_SIEGE_ARG_Mode_13: debounce-behavior=FREEZE
          debounce-algorithm:
            diag event debounce time based ALGO_DEBOUNCE_DefN_SONDE_TEMP_SIEGE_ARG_Mode_13: time-failed-threshold=2, time-passed-threshold=2
        ALGO_DefN_SONDE_TEMP_SIEGE_AVD_Mode_11: debounce-behavior=FREEZE
          debounce-algorithm:
            diag event debounce time based ALGO_DEBOUNCE_DefN_SONDE_TEMP_SIEGE_AVD_Mode_11: time-failed-threshold=2, time-passed-threshold=2
        ALGO_DefN_SONDE_TEMP_SIEGE_AVD_Mode_12: debounce-behavior=FREEZE
          debounce-algorithm:
            diag event debounce time based ALGO_DEBOUNCE_DefN_SONDE_TEMP_SIEGE_AVD_Mode_12: time-failed-threshold=2, time-passed-threshold=2
        ALGO_DefN_SONDE_TEMP_SIEGE_AVD_Mode_13: debounce-behavior=FREEZE
          debounce-algorithm:
            diag event debounce time based ALGO_DEBOUNCE_DefN_SONDE_TEMP_SIEGE_AVD_Mode_13: time-failed-threshold=2, time-passed-threshold=2
        ALGO_DefN_SONDE_TEMP_SIEGE_AVG_Mode_11: debounce-behavior=FREEZE
          debounce-algorithm:
            diag event debounce time based ALGO_DEBOUNCE_DefN_SONDE_TEMP_SIEGE_AVG_Mode_11: time-failed-threshold=2, time-passed-threshold=2
        ALGO_DefN_SONDE_TEMP_SIEGE_AVG_Mode_12: debounce-behavior=FREEZE
          debounce-algorithm:
            diag event debounce time based ALGO_DEBOUNCE_DefN_SONDE_TEMP_SIEGE_AVG_Mode_12: time-failed-threshold=2, time-passed-threshold=2
        ALGO_DefN_SONDE_TEMP_SIEGE_AVG_Mode_13: debounce-behavior=FREEZE
          debounce-algorithm:
            diag event debounce time based ALGO_DEBOUNCE_DefN_SONDE_TEMP_SIEGE_AVG_Mode_13: time-failed-threshold=2, time-passed-threshold=2
        ALGO_DefN_CMD_PBC_Z1_Mode_11: debounce-behavior=FREEZE
          debounce-algorithm:
            diag event debounce time based ALGO_DEBOUNCE_DefN_CMD_PBC_Z1_Mode_11: time-failed-threshold=2, time-passed-threshold=2
        ALGO_DefN_CMD_PBC_Z1_Mode_12: debounce-behavior=FREEZE
          debounce-algorithm:
            diag event debounce time based ALGO_DEBOUNCE_DefN_CMD_PBC_Z1_Mode_12: time-failed-threshold=2, time-passed-threshold=2
        ALGO_DefN_CMD_PBC_Z1_Mode_13: debounce-behavior=FREEZE
          debounce-algorithm:
            diag event debounce time based ALGO_DEBOUNCE_DefN_CMD_PBC_Z1_Mode_13: time-failed-threshold=2, time-passed-threshold=2
        ALGO_DefN_CMD_PBC_Z1_Mode_14: debounce-behavior=FREEZE
          debounce-algorithm:
            diag event debounce time based ALGO_DEBOUNCE_DefN_CMD_PBC_Z1_Mode_14: time-failed-threshold=2, time-passed-threshold=2
        ALGO_DefN_CMD_PBC_Z1_Mode_15: debounce-behavior=FREEZE
          debounce-algorithm:
            diag event debounce time based ALGO_DEBOUNCE_DefN_CMD_PBC_Z1_Mode_15: time-failed-threshold=2, time-passed-threshold=2
        ALGO_DefN_CMD_PBC_Z2_Mode_11: debounce-behavior=FREEZE
          debounce-algorithm:
            diag event debounce time based ALGO_DEBOUNCE_DefN_CMD_PBC_Z2_Mode_11: time-failed-threshold=2, time-passed-threshold=2
        ALGO_DefN_CMD_PBC_Z2_Mode_12: debounce-behavior=FREEZE
          debounce-algorithm:
            diag event debounce time based ALGO_DEBOUNCE_DefN_CMD_PBC_Z2_Mode_12: time-failed-threshold=2, time-passed-threshold=2
        ALGO_DefN_CMD_PBC_Z2_Mode_14: debounce-behavior=FREEZE
          debounce-algorithm:
            diag event debounce time based ALGO_DEBOUNCE_DefN_CMD_PBC_Z2_Mode_14: time-failed-threshold=2, time-passed-threshold=2
        ALGO_DefN_CMD_PBC_Z2_Mode_15: debounce-behavior=FREEZE
          debounce-algorithm:
            diag event debounce time based ALGO_DEBOUNCE_DefN_CMD_PBC_Z2_Mode_15: time-failed-threshold=2, time-passed-threshold=2
        ALGO_DefN_PUSH_PB_CHAUFFANT_Mode_12: debounce-behavior=FREEZE
          debounce-algorithm:
            diag event debounce time based ALGO_DEBOUNCE_DefN_PUSH_PB_CHAUFFANT_Mode_12: time-failed-threshold=2, time-passed-threshold=2
        ALGO_DefN_COMMANDE_DEGIVRAGE_Mode_11: debounce-behavior=FREEZE
          debounce-algorithm:
            diag event debounce time based ALGO_DEBOUNCE_DefN_COMMANDE_DEGIVRAGE_Mode_11: time-failed-threshold=2, time-passed-threshold=2
        ALGO_DefN_COMMANDE_DEGIVRAGE_Mode_12: debounce-behavior=FREEZE
          debounce-algorithm:
            diag event debounce time based ALGO_DEBOUNCE_DefN_COMMANDE_DEGIVRAGE_Mode_12: time-failed-threshold=2, time-passed-threshold=2
        ALGO_DefN_COMMANDE_DEGIVRAGE_Mode_13: debounce-behavior=FREEZE
          debounce-algorithm:
            diag event debounce time based ALGO_DEBOUNCE_DefN_COMMANDE_DEGIVRAGE_Mode_13: time-failed-threshold=2, time-passed-threshold=2
        ALGO_DefN_COMMANDE_DEGIVRAGE_Mode_15: debounce-behavior=FREEZE
          debounce-algorithm:
            diag event debounce time based ALGO_DEBOUNCE_DefN_COMMANDE_DEGIVRAGE_Mode_15: time-failed-threshold=2, time-passed-threshold=2
        ALGO_DefN_BFRM_PILOTAGE_EV_AV_Mode_11: debounce-behavior=FREEZE
          debounce-algorithm:
            diag event debounce time based ALGO_DEBOUNCE_DefN_BFRM_PILOTAGE_EV_AV_Mode_11: time-failed-threshold=2, time-passed-threshold=2
        ALGO_DefN_BFRM_PILOTAGE_EV_AV_Mode_15: debounce-behavior=FREEZE
          debounce-algorithm:
            diag event debounce time based ALGO_DEBOUNCE_DefN_BFRM_PILOTAGE_EV_AV_Mode_15: time-failed-threshold=2, time-passed-threshold=2
        ALGO_DefN_BFRM_PV_GV_EV_AV_Mode_11: debounce-behavior=FREEZE
          debounce-algorithm:
            diag event debounce time based ALGO_DEBOUNCE_DefN_BFRM_PV_GV_EV_AV_Mode_11: time-failed-threshold=2, time-passed-threshold=2
        ALGO_DefN_BFRM_PV_GV_EV_AV_Mode_15: debounce-behavior=FREEZE
          debounce-algorithm:
            diag event debounce time based ALGO_DEBOUNCE_DefN_BFRM_PV_GV_EV_AV_Mode_15: time-failed-threshold=2, time-passed-threshold=2
        ALGO_DefN_ESV_AR_BLOQUE_Mode_62: debounce-behavior=FREEZE
          debounce-algorithm:
            diag event debounce time based ALGO_DEBOUNCE_DefN_ESV_AR_BLOQUE_Mode_62: time-failed-threshold=2, time-passed-threshold=2
        ALGO_DefN_ESV_AV_BLOQUE_Mode_62: debounce-behavior=FREEZE
          debounce-algorithm:
            diag event debounce time based ALGO_DEBOUNCE_DefN_ESV_AV_BLOQUE_Mode_62: time-failed-threshold=2, time-passed-threshold=2
        ALGO_DefN_EVAR_Mode_11: debounce-behavior=FREEZE
          debounce-algorithm:
            diag event debounce time based ALGO_DEBOUNCE_DefN_EVAR_Mode_11: time-failed-threshold=2, time-passed-threshold=2
        ALGO_DefN_EVAR_Mode_12: debounce-behavior=FREEZE
          debounce-algorithm:
            diag event debounce time based ALGO_DEBOUNCE_DefN_EVAR_Mode_12: time-failed-threshold=2, time-passed-threshold=2
        ALGO_DefN_EVAR_Mode_15: debounce-behavior=FREEZE
          debounce-algorithm:
            diag event debounce time based ALGO_DEBOUNCE_DefN_EVAR_Mode_15: time-failed-threshold=2, time-passed-threshold=2
        ALGO_DefN_POMPE_LAV_PAREBRISE_AR_Mode_11: debounce-behavior=FREEZE
          debounce-algorithm:
            diag event debounce time based ALGO_DEBOUNCE_DefN_POMPE_LAV_PAREBRISE_AR_Mode_11: time-failed-threshold=2, time-passed-threshold=2
        ALGO_DefN_POMPE_LAV_PAREBRISE_AR_Mode_12: debounce-behavior=FREEZE
          debounce-algorithm:
            diag event debounce time based ALGO_DEBOUNCE_DefN_POMPE_LAV_PAREBRISE_AR_Mode_12: time-failed-threshold=2, time-passed-threshold=2
        ALGO_DefN_POMPE_LAV_PAREBRISE_AR_Mode_15: debounce-behavior=FREEZE
          debounce-algorithm:
            diag event debounce time based ALGO_DEBOUNCE_DefN_POMPE_LAV_PAREBRISE_AR_Mode_15: time-failed-threshold=2, time-passed-threshold=2
        ALGO_DefN_POMPE_LAV_PAREBRISE_AV_Mode_11: debounce-behavior=FREEZE
          debounce-algorithm:
            diag event debounce time based ALGO_DEBOUNCE_DefN_POMPE_LAV_PAREBRISE_AV_Mode_11: time-failed-threshold=2, time-passed-threshold=2
        ALGO_DefN_POMPE_LAV_PAREBRISE_AV_Mode_12: debounce-behavior=FREEZE
          debounce-algorithm:
            diag event debounce time based ALGO_DEBOUNCE_DefN_POMPE_LAV_PAREBRISE_AV_Mode_12: time-failed-threshold=2, time-passed-threshold=2
        ALGO_DefN_POMPE_LAV_PAREBRISE_AV_Mode_15: debounce-behavior=FREEZE
          debounce-algorithm:
            diag event debounce time based ALGO_DEBOUNCE_DefN_POMPE_LAV_PAREBRISE_AV_Mode_15: time-failed-threshold=2, time-passed-threshold=2
        ALGO_DefN_ABS_SAVE_CPT_TEMPOREL_Mode_00: debounce-behavior=FREEZE
          debounce-algorithm:
            diag event debounce time based ALGO_DEBOUNCE_DefN_ABS_SAVE_CPT_TEMPOREL_Mode_00: time-failed-threshold=2, time-passed-threshold=2
        ALGO_DefN_HORLOGE_INVALIDE_Mode_00: debounce-behavior=FREEZE
          debounce-algorithm:
            diag event debounce time based ALGO_DEBOUNCE_DefN_HORLOGE_INVALIDE_Mode_00: time-failed-threshold=2, time-passed-threshold=2
        ALGO_DefN_INFO_VITESSE_VHL_Mode_65: debounce-behavior=FREEZE
          debounce-algorithm:
            diag event debounce time based ALGO_DEBOUNCE_DefN_INFO_VITESSE_VHL_Mode_65: time-failed-threshold=2, time-passed-threshold=2
        ALGO_DefN_INFO_VITESSE_VHL_Mode_86: debounce-behavior=FREEZE
          debounce-algorithm:
            diag event debounce time based ALGO_DEBOUNCE_DefN_INFO_VITESSE_VHL_Mode_86: time-failed-threshold=2, time-passed-threshold=2
        ALGO_DefN_SONDE_TEMPERATURE_EXTERIEUR_Mode_1A: debounce-behavior=FREEZE
          debounce-algorithm:
            diag event debounce time based ALGO_DEBOUNCE_DefN_SONDE_TEMPERATURE_EXTERIEUR_Mode_1A: time-failed-threshold=2, time-passed-threshold=2
        ALGO_DefN_SONDE_TEMPERATURE_EXTERIEUR_Mode_1B: debounce-behavior=FREEZE
          debounce-algorithm:
            diag event debounce time based ALGO_DEBOUNCE_DefN_SONDE_TEMPERATURE_EXTERIEUR_Mode_1B: time-failed-threshold=2, time-passed-threshold=2
        ALGO_DefN_PUSH_ON_OFF_RADIO_Mode_11: debounce-behavior=FREEZE
          debounce-algorithm:
            diag event debounce time based ALGO_DEBOUNCE_DefN_PUSH_ON_OFF_RADIO_Mode_11: time-failed-threshold=2, time-passed-threshold=2
        ALGO_DefN_DDE_DEVERROU_HY_Mode_87: debounce-behavior=FREEZE
          debounce-algorithm:
            diag event debounce time based ALGO_DEBOUNCE_DefN_DDE_DEVERROU_HY_Mode_87: time-failed-threshold=2, time-passed-threshold=2
        ALGO_DefN_DDE_DEVERROU_BVP_Mode_87: debounce-behavior=FREEZE
          debounce-algorithm:
            diag event debounce time based ALGO_DEBOUNCE_DefN_DDE_DEVERROU_BVP_Mode_87: time-failed-threshold=2, time-passed-threshold=2
        ALGO_DefN_DIAG_TRANSPONDEUR_Mode_01: debounce-behavior=FREEZE
          debounce-algorithm:
            diag event debounce time based ALGO_DEBOUNCE_DefN_DIAG_TRANSPONDEUR_Mode_01: time-failed-threshold=2, time-passed-threshold=2
        ALGO_DefN_DIAG_TRANSPONDEUR_Mode_13: debounce-behavior=FREEZE
          debounce-algorithm:
            diag event debounce time based ALGO_DEBOUNCE_DefN_DIAG_TRANSPONDEUR_Mode_13: time-failed-threshold=2, time-passed-threshold=2
        ALGO_DefN_DIAG_TRANSPONDEUR_Mode_1C: debounce-behavior=FREEZE
          debounce-algorithm:
            diag event debounce time based ALGO_DEBOUNCE_DefN_DIAG_TRANSPONDEUR_Mode_1C: time-failed-threshold=2, time-passed-threshold=2
        ALGO_DefN_DIAG_TRANSPONDEUR_Mode_49: debounce-behavior=FREEZE
          debounce-algorithm:
            diag event debounce time based ALGO_DEBOUNCE_DefN_DIAG_TRANSPONDEUR_Mode_49: time-failed-threshold=2, time-passed-threshold=2
        ALGO_DefN_DDE_DEVERROU_CMM_Mode_87: debounce-behavior=FREEZE
          debounce-algorithm:
            diag event debounce time based ALGO_DEBOUNCE_DefN_DDE_DEVERROU_CMM_Mode_87: time-failed-threshold=2, time-passed-threshold=2
        ALGO_DefN_REPONSE_AVE_Mode_86: debounce-behavior=FREEZE
          debounce-algorithm:
            diag event debounce time based ALGO_DEBOUNCE_DefN_REPONSE_AVE_Mode_86: time-failed-threshold=2, time-passed-threshold=2
        ALGO_DefN_REPONSE_AVE_Mode_87: debounce-behavior=FREEZE
          debounce-algorithm:
            diag event debounce time based ALGO_DEBOUNCE_DefN_REPONSE_AVE_Mode_87: time-failed-threshold=2, time-passed-threshold=2
        ALGO_DefN_ABSENCE_REP_AUTHENT_Mode_87: debounce-behavior=FREEZE
          debounce-algorithm:
            diag event debounce time based ALGO_DEBOUNCE_DefN_ABSENCE_REP_AUTHENT_Mode_87: time-failed-threshold=2, time-passed-threshold=2
        ALGO_DefN_AUTHENTIFICATION_Mode_86: debounce-behavior=FREEZE
          debounce-algorithm:
            diag event debounce time based ALGO_DEBOUNCE_DefN_AUTHENTIFICATION_Mode_86: time-failed-threshold=2, time-passed-threshold=2
        ALGO_DefN_AUTHENTIFICATION_Mode_87: debounce-behavior=FREEZE
          debounce-algorithm:
            diag event debounce time based ALGO_DEBOUNCE_DefN_AUTHENTIFICATION_Mode_87: time-failed-threshold=2, time-passed-threshold=2
        ALGO_DefN_IDENTIFICATION_NOK_Mode_86: debounce-behavior=FREEZE
          debounce-algorithm:
            diag event debounce time based ALGO_DEBOUNCE_DefN_IDENTIFICATION_NOK_Mode_86: time-failed-threshold=2, time-passed-threshold=2
        ALGO_DefN_PUSH_ALARME_Mode_11: debounce-behavior=FREEZE
          debounce-algorithm:
            diag event debounce time based ALGO_DEBOUNCE_DefN_PUSH_ALARME_Mode_11: time-failed-threshold=2, time-passed-threshold=2
        ALGO_DefN_SUP_LIN_VSM_5_AIR_CDT_GEARED_MOTOR_DISTRIB_F: debounce-behavior=FREEZE
          debounce-algorithm:
            diag event debounce time based ALGO_DEBOUNCE_DefN_SUP_LIN_VSM_5_AIR_CDT_GEARED_MOTOR_DISTRIB_F: time-failed-threshold=2, time-passed-threshold=2
        ALGO_DefN_SUP_LIN_VSM_5_AIR_CDT_GEARED_MOTOR_MIX_FL: debounce-behavior=FREEZE
          debounce-algorithm:
            diag event debounce time based ALGO_DEBOUNCE_DefN_SUP_LIN_VSM_5_AIR_CDT_GEARED_MOTOR_MIX_FL: time-failed-threshold=2, time-passed-threshold=2
        ALGO_DefN_SUP_LIN_VSM_5_AIR_CDT_GEARED_MOTOR_MIX_FR: debounce-behavior=FREEZE
          debounce-algorithm:
            diag event debounce time based ALGO_DEBOUNCE_DefN_SUP_LIN_VSM_5_AIR_CDT_GEARED_MOTOR_MIX_FR: time-failed-threshold=2, time-passed-threshold=2
        ALGO_DefN_SUP_HS2_ARTIV: debounce-behavior=FREEZE
          debounce-algorithm:
            diag event debounce time based ALGO_DEBOUNCE_DefN_SUP_HS2_ARTIV: time-failed-threshold=2, time-passed-threshold=2
        ALGO_DefN_SUP_HS4_AUTO_GEARBOX_SWITCH: debounce-behavior=FREEZE
          debounce-algorithm:
            diag event debounce time based ALGO_DEBOUNCE_DefN_SUP_HS4_AUTO_GEARBOX_SWITCH: time-failed-threshold=2, time-passed-threshold=2
        ALGO_DefN_SUP_HS2_AVAS: debounce-behavior=FREEZE
          debounce-algorithm:
            diag event debounce time based ALGO_DEBOUNCE_DefN_SUP_HS2_AVAS: time-failed-threshold=2, time-passed-threshold=2
        ALGO_DefN_SUP_HS5_AVE: debounce-behavior=FREEZE
          debounce-algorithm:
            diag event debounce time based ALGO_DEBOUNCE_DefN_SUP_HS5_AVE: time-failed-threshold=2, time-passed-threshold=2
        ALGO_DefN_SUP_LIN_VSM_3_BAAS_L: debounce-behavior=FREEZE
          debounce-algorithm:
            diag event debounce time based ALGO_DEBOUNCE_DefN_SUP_LIN_VSM_3_BAAS_L: time-failed-threshold=2, time-passed-threshold=2
        ALGO_DefN_SUP_LIN_VSM_3_BAAS_TR: debounce-behavior=FREEZE
          debounce-algorithm:
            diag event debounce time based ALGO_DEBOUNCE_DefN_SUP_LIN_VSM_3_BAAS_TR: time-failed-threshold=2, time-passed-threshold=2
        ALGO_DefN_SUP_LIN_VSM_2_BATTERY_CONTROL_UNIT_12V: debounce-behavior=FREEZE
          debounce-algorithm:
            diag event debounce time based ALGO_DEBOUNCE_DefN_SUP_LIN_VSM_2_BATTERY_CONTROL_UNIT_12V: time-failed-threshold=2, time-passed-threshold=2
        ALGO_DefN_SUP_HS2_BCLVR: debounce-behavior=FREEZE
          debounce-algorithm:
            diag event debounce time based ALGO_DEBOUNCE_DefN_SUP_HS2_BCLVR: time-failed-threshold=2, time-passed-threshold=2
        ALGO_DefN_SUP_HS5_BCM: debounce-behavior=FREEZE
          debounce-algorithm:
            diag event debounce time based ALGO_DEBOUNCE_DefN_SUP_HS5_BCM: time-failed-threshold=2, time-passed-threshold=2
        ALGO_DefN_SUP_LIN_VSM_4_BRNCV_FL: debounce-behavior=FREEZE
          debounce-algorithm:
            diag event debounce time based ALGO_DEBOUNCE_DefN_SUP_LIN_VSM_4_BRNCV_FL: time-failed-threshold=2, time-passed-threshold=2
        ALGO_DefN_SUP_LIN_VSM_4_BRNCV_FR: debounce-behavior=FREEZE
          debounce-algorithm:
            diag event debounce time based ALGO_DEBOUNCE_DefN_SUP_LIN_VSM_4_BRNCV_FR: time-failed-threshold=2, time-passed-threshold=2
        ALGO_DefN_SUP_LIN_VSM_4_BRNCV_RL: debounce-behavior=FREEZE
          debounce-algorithm:
            diag event debounce time based ALGO_DEBOUNCE_DefN_SUP_LIN_VSM_4_BRNCV_RL: time-failed-threshold=2, time-passed-threshold=2
        ALGO_DefN_SUP_LIN_VSM_4_BRNCV_RR: debounce-behavior=FREEZE
          debounce-algorithm:
            diag event debounce time based ALGO_DEBOUNCE_DefN_SUP_LIN_VSM_4_BRNCV_RR: time-failed-threshold=2, time-passed-threshold=2
        ALGO_DefN_SUP_HS7_BSRF: debounce-behavior=FREEZE
          debounce-algorithm:
            diag event debounce time based ALGO_DEBOUNCE_DefN_SUP_HS7_BSRF: time-failed-threshold=2, time-passed-threshold=2
        ALGO_DefN_SUP_HS2_BV: debounce-behavior=FREEZE
          debounce-algorithm:
            diag event debounce time based ALGO_DEBOUNCE_DefN_SUP_HS2_BV: time-failed-threshold=2, time-passed-threshold=2
        ALGO_DefN_SUP_HS2_BVN: debounce-behavior=FREEZE
          debounce-algorithm:
            diag event debounce time based ALGO_DEBOUNCE_DefN_SUP_HS2_BVN: time-failed-threshold=2, time-passed-threshold=2
        ALGO_DefN_SUP_LIN_VSM_5_CABIN_FINE_PARTICLES_SENSOR: debounce-behavior=FREEZE
          debounce-algorithm:
            diag event debounce time based ALGO_DEBOUNCE_DefN_SUP_LIN_VSM_5_CABIN_FINE_PARTICLES_SENSOR: time-failed-threshold=2, time-passed-threshold=2
        ALGO_DefN_SUP_HS4_CMB: debounce-behavior=FREEZE
          debounce-algorithm:
            diag event debounce time based ALGO_DEBOUNCE_DefN_SUP_HS4_CMB: time-failed-threshold=2, time-passed-threshold=2
        ALGO_DefN_SUP_HS1_CMF: debounce-behavior=FREEZE
          debounce-algorithm:
            diag event debounce time based ALGO_DEBOUNCE_DefN_SUP_HS1_CMF: time-failed-threshold=2, time-passed-threshold=2
        ALGO_DefN_SUP_HS1_CMM: debounce-behavior=FREEZE
          debounce-algorithm:
            diag event debounce time based ALGO_DEBOUNCE_DefN_SUP_HS1_CMM: time-failed-threshold=2, time-passed-threshold=2
        ALGO_DefN_SUP_LIN_VSM_2_CONTROLLED_AIR_INLET_MODULE: debounce-behavior=FREEZE
          debounce-algorithm:
            diag event debounce time based ALGO_DEBOUNCE_DefN_SUP_LIN_VSM_2_CONTROLLED_AIR_INLET_MODULE: time-failed-threshold=2, time-passed-threshold=2
        ALGO_DefN_SUP_HS1_CSS: debounce-behavior=FREEZE
          debounce-algorithm:
            diag event debounce time based ALGO_DEBOUNCE_DefN_SUP_HS1_CSS: time-failed-threshold=2, time-passed-threshold=2
        ALGO_DefN_SUP_HS5_DCU_FD: debounce-behavior=FREEZE
          debounce-algorithm:
            diag event debounce time based ALGO_DEBOUNCE_DefN_SUP_HS5_DCU_FD: time-failed-threshold=2, time-passed-threshold=2
        ALGO_DefN_SUP_HS5_DCU_FP: debounce-behavior=FREEZE
          debounce-algorithm:
            diag event debounce time based ALGO_DEBOUNCE_DefN_SUP_HS5_DCU_FP: time-failed-threshold=2, time-passed-threshold=2
        ALGO_DefN_SUP_HS5_DCU_RL: debounce-behavior=FREEZE
          debounce-algorithm:
            diag event debounce time based ALGO_DEBOUNCE_DefN_SUP_HS5_DCU_RL: time-failed-threshold=2, time-passed-threshold=2
        ALGO_DefN_SUP_HS5_DCU_RR: debounce-behavior=FREEZE
          debounce-algorithm:
            diag event debounce time based ALGO_DEBOUNCE_DefN_SUP_HS5_DCU_RR: time-failed-threshold=2, time-passed-threshold=2
        ALGO_DefN_SUP_HS1_DMTR: debounce-behavior=FREEZE
          debounce-algorithm:
            diag event debounce time based ALGO_DEBOUNCE_DefN_SUP_HS1_DMTR: time-failed-threshold=2, time-passed-threshold=2
        ALGO_DefN_SUP_HS6_DRIVER_LED_L_F: debounce-behavior=FREEZE
          debounce-algorithm:
            diag event debounce time based ALGO_DEBOUNCE_DefN_SUP_HS6_DRIVER_LED_L_F: time-failed-threshold=2, time-passed-threshold=2
        ALGO_DefN_SUP_HS6_DRIVER_LED_R_F: debounce-behavior=FREEZE
          debounce-algorithm:
            diag event debounce time based ALGO_DEBOUNCE_DefN_SUP_HS6_DRIVER_LED_R_F: time-failed-threshold=2, time-passed-threshold=2
        ALGO_DefN_SUP_HS2_EBB: debounce-behavior=FREEZE
          debounce-algorithm:
            diag event debounce time based ALGO_DEBOUNCE_DefN_SUP_HS2_EBB: time-failed-threshold=2, time-passed-threshold=2
        ALGO_DefN_SUP_HS1_E_VCU: debounce-behavior=FREEZE
          debounce-algorithm:
            diag event debounce time based ALGO_DEBOUNCE_DefN_SUP_HS1_E_VCU: time-failed-threshold=2, time-passed-threshold=2
        ALGO_DefN_SUP_HS4_FMUX: debounce-behavior=FREEZE
          debounce-algorithm:
            diag event debounce time based ALGO_DEBOUNCE_DefN_SUP_HS4_FMUX: time-failed-threshold=2, time-passed-threshold=2
        ALGO_DefN_SUP_FD3_FRONT_CAMERA: debounce-behavior=FREEZE
          debounce-algorithm:
            diag event debounce time based ALGO_DEBOUNCE_DefN_SUP_FD3_FRONT_CAMERA: time-failed-threshold=2, time-passed-threshold=2
        ALGO_DefN_SUP_FD3_FRONT_RADAR: debounce-behavior=FREEZE
          debounce-algorithm:
            diag event debounce time based ALGO_DEBOUNCE_DefN_SUP_FD3_FRONT_RADAR: time-failed-threshold=2, time-passed-threshold=2
        ALGO_DefN_SUP_LIN_VSM_1_FRONT_WIPING: debounce-behavior=FREEZE
          debounce-algorithm:
            diag event debounce time based ALGO_DEBOUNCE_DefN_SUP_LIN_VSM_1_FRONT_WIPING: time-failed-threshold=2, time-passed-threshold=2
        ALGO_DefN_SUP_LIN_VSM_2_FUEL_ADDITIVE_SUPPLY_UNIT: debounce-behavior=FREEZE
          debounce-algorithm:
            diag event debounce time based ALGO_DEBOUNCE_DefN_SUP_LIN_VSM_2_FUEL_ADDITIVE_SUPPLY_UNIT: time-failed-threshold=2, time-passed-threshold=2
        ALGO_DefN_SUP_LIN_VSM_5_HV_ELECTRICAL_COMPRESSOR: debounce-behavior=FREEZE
          debounce-algorithm:
            diag event debounce time based ALGO_DEBOUNCE_DefN_SUP_LIN_VSM_5_HV_ELECTRICAL_COMPRESSOR: time-failed-threshold=2, time-passed-threshold=2
        ALGO_DefN_SUP_HS4_IDB: debounce-behavior=FREEZE
          debounce-algorithm:
            diag event debounce time based ALGO_DEBOUNCE_DefN_SUP_HS4_IDB: time-failed-threshold=2, time-passed-threshold=2
        ALGO_DefN_SUP_FD3_IVC_D: debounce-behavior=FREEZE
          debounce-algorithm:
            diag event debounce time based ALGO_DEBOUNCE_DefN_SUP_FD3_IVC_D: time-failed-threshold=2, time-passed-threshold=2
        ALGO_DefN_SUP_HS7_IVI: debounce-behavior=FREEZE
          debounce-algorithm:
            diag event debounce time based ALGO_DEBOUNCE_DefN_SUP_HS7_IVI: time-failed-threshold=2, time-passed-threshold=2
        ALGO_DefN_SUP_HS5_MAE: debounce-behavior=FREEZE
          debounce-algorithm:
            diag event debounce time based ALGO_DEBOUNCE_DefN_SUP_HS5_MAE: time-failed-threshold=2, time-passed-threshold=2
        ALGO_DefN_SUP_LIN_VSM_4_MASSAGE_AND_LUMBER_DEVICES_D: debounce-behavior=FREEZE
          debounce-algorithm:
            diag event debounce time based ALGO_DEBOUNCE_DefN_SUP_LIN_VSM_4_MASSAGE_AND_LUMBER_DEVICES_D: time-failed-threshold=2, time-passed-threshold=2
        ALGO_DefN_SUP_LIN_VSM_4_MASSAGE_AND_LUMBER_DEVICES_P: debounce-behavior=FREEZE
          debounce-algorithm:
            diag event debounce time based ALGO_DEBOUNCE_DefN_SUP_LIN_VSM_4_MASSAGE_AND_LUMBER_DEVICES_P: time-failed-threshold=2, time-passed-threshold=2
        ALGO_DefN_SUP_LIN_VSM_1_MUS: debounce-behavior=FREEZE
          debounce-algorithm:
            diag event debounce time based ALGO_DEBOUNCE_DefN_SUP_LIN_VSM_1_MUS: time-failed-threshold=2, time-passed-threshold=2
        ALGO_DefN_SUP_LIN_VSM_3_OCS: debounce-behavior=FREEZE
          debounce-algorithm:
            diag event debounce time based ALGO_DEBOUNCE_DefN_SUP_LIN_VSM_3_OCS: time-failed-threshold=2, time-passed-threshold=2
        ALGO_DefN_SUP_HS1_PROJ: debounce-behavior=FREEZE
          debounce-algorithm:
            diag event debounce time based ALGO_DEBOUNCE_DefN_SUP_HS1_PROJ: time-failed-threshold=2, time-passed-threshold=2
        ALGO_DefN_SUP_FD3_PVS: debounce-behavior=FREEZE
          debounce-algorithm:
            diag event debounce time based ALGO_DEBOUNCE_DefN_SUP_FD3_PVS: time-failed-threshold=2, time-passed-threshold=2
        ALGO_DefN_SUP_LIN_VSM_1_RAIN_LIGHT_SENSOR: debounce-behavior=FREEZE
          debounce-algorithm:
            diag event debounce time based ALGO_DEBOUNCE_DefN_SUP_LIN_VSM_1_RAIN_LIGHT_SENSOR: time-failed-threshold=2, time-passed-threshold=2
        ALGO_DefN_SUP_HS1_RBG: debounce-behavior=FREEZE
          debounce-algorithm:
            diag event debounce time based ALGO_DEBOUNCE_DefN_SUP_HS1_RBG: time-failed-threshold=2, time-passed-threshold=2
        ALGO_DefN_SUP_HS1_SBW: debounce-behavior=FREEZE
          debounce-algorithm:
            diag event debounce time based ALGO_DEBOUNCE_DefN_SUP_HS1_SBW: time-failed-threshold=2, time-passed-threshold=2
        ALGO_DefN_SUP_LIN_VSM_4_SCB_D: debounce-behavior=FREEZE
          debounce-algorithm:
            diag event debounce time based ALGO_DEBOUNCE_DefN_SUP_LIN_VSM_4_SCB_D: time-failed-threshold=2, time-passed-threshold=2
        ALGO_DefN_SUP_HS7_SDCM: debounce-behavior=FREEZE
          debounce-algorithm:
            diag event debounce time based ALGO_DEBOUNCE_DefN_SUP_HS7_SDCM: time-failed-threshold=2, time-passed-threshold=2
        ALGO_DefN_SUP_LIN_VSM_1_SIR: debounce-behavior=FREEZE
          debounce-algorithm:
            diag event debounce time based ALGO_DEBOUNCE_DefN_SUP_LIN_VSM_1_SIR: time-failed-threshold=2, time-passed-threshold=2
        ALGO_DefN_SUP_LIN_VSM_3_SUNROOF: debounce-behavior=FREEZE
          debounce-algorithm:
            diag event debounce time based ALGO_DEBOUNCE_DefN_SUP_LIN_VSM_3_SUNROOF: time-failed-threshold=2, time-passed-threshold=2
        ALGO_DefN_SUP_HS5_TCM: debounce-behavior=FREEZE
          debounce-algorithm:
            diag event debounce time based ALGO_DEBOUNCE_DefN_SUP_HS5_TCM: time-failed-threshold=2, time-passed-threshold=2
        ALGO_DefN_SUP_LIN_VSM_1_TNB: debounce-behavior=FREEZE
          debounce-algorithm:
            diag event debounce time based ALGO_DEBOUNCE_DefN_SUP_LIN_VSM_1_TNB: time-failed-threshold=2, time-passed-threshold=2
        ALGO_DefN_SUP_HS1_UC_DIRA: debounce-behavior=FREEZE
          debounce-algorithm:
            diag event debounce time based ALGO_DEBOUNCE_DefN_SUP_HS1_UC_DIRA: time-failed-threshold=2, time-passed-threshold=2
        ALGO_DefN_SUP_HS1_UC_FREIN: debounce-behavior=FREEZE
          debounce-algorithm:
            diag event debounce time based ALGO_DEBOUNCE_DefN_SUP_HS1_UC_FREIN: time-failed-threshold=2, time-passed-threshold=2
        ALGO_DefN_SUP_FD3_USS: debounce-behavior=FREEZE
          debounce-algorithm:
            diag event debounce time based ALGO_DEBOUNCE_DefN_SUP_FD3_USS: time-failed-threshold=2, time-passed-threshold=2
        ALGO_DefN_SUP_LIN_VSM_5_WATER_GLOW_BOILER_ELEC_CARD: debounce-behavior=FREEZE
          debounce-algorithm:
            diag event debounce time based ALGO_DEBOUNCE_DefN_SUP_LIN_VSM_5_WATER_GLOW_BOILER_ELEC_CARD: time-failed-threshold=2, time-passed-threshold=2
        ALGO_DefN_SUP_LIN_VSM_5_AIR_CDT_GEARED_MOTOR_DISTRIB_F_FONC: debounce-behavior=RESET
          debounce-algorithm:
            diag event debounce time based ALGO_DEBOUNCE_DefN_SUP_LIN_VSM_5_AIR_CDT_GEARED_MOTOR_DISTRIB_F_FONC: time-failed-threshold=2, time-passed-threshold=2
        ALGO_DefN_SUP_LIN_VSM_5_AIR_CDT_GEARED_MOTOR_MIX_FL_FONC: debounce-behavior=RESET
          debounce-algorithm:
            diag event debounce time based ALGO_DEBOUNCE_DefN_SUP_LIN_VSM_5_AIR_CDT_GEARED_MOTOR_MIX_FL_FONC: time-failed-threshold=2, time-passed-threshold=2
        ALGO_DefN_SUP_LIN_VSM_5_AIR_CDT_GEARED_MOTOR_MIX_FR_FONC: debounce-behavior=RESET
          debounce-algorithm:
            diag event debounce time based ALGO_DEBOUNCE_DefN_SUP_LIN_VSM_5_AIR_CDT_GEARED_MOTOR_MIX_FR_FONC: time-failed-threshold=2, time-passed-threshold=2
        ALGO_DefN_SUP_HS2_ARTIV_FONC: debounce-behavior=RESET
          debounce-algorithm:
            diag event debounce time based ALGO_DEBOUNCE_DefN_SUP_HS2_ARTIV_FONC: time-failed-threshold=2, time-passed-threshold=2
        ALGO_DefN_SUP_HS4_AUTO_GEARBOX_SWITCH_FONC: debounce-behavior=RESET
          debounce-algorithm:
            diag event debounce time based ALGO_DEBOUNCE_DefN_SUP_HS4_AUTO_GEARBOX_SWITCH_FONC: time-failed-threshold=2, time-passed-threshold=2
        ALGO_DefN_SUP_HS2_AVAS_FONC: debounce-behavior=RESET
          debounce-algorithm:
            diag event debounce time based ALGO_DEBOUNCE_DefN_SUP_HS2_AVAS_FONC: time-failed-threshold=2, time-passed-threshold=2
        ALGO_DefN_SUP_HS5_AVE_FONC: debounce-behavior=RESET
          debounce-algorithm:
            diag event debounce time based ALGO_DEBOUNCE_DefN_SUP_HS5_AVE_FONC: time-failed-threshold=2, time-passed-threshold=2
        ALGO_DefN_SUP_LIN_VSM_3_BAAS_L_FONC: debounce-behavior=RESET
          debounce-algorithm:
            diag event debounce time based ALGO_DEBOUNCE_DefN_SUP_LIN_VSM_3_BAAS_L_FONC: time-failed-threshold=2, time-passed-threshold=2
        ALGO_DefN_SUP_LIN_VSM_3_BAAS_TR_FONC: debounce-behavior=RESET
          debounce-algorithm:
            diag event debounce time based ALGO_DEBOUNCE_DefN_SUP_LIN_VSM_3_BAAS_TR_FONC: time-failed-threshold=2, time-passed-threshold=2
        ALGO_DefN_SUP_LIN_VSM_2_BATTERY_CONTROL_UNIT_12V_FONC: debounce-behavior=RESET
          debounce-algorithm:
            diag event debounce time based ALGO_DEBOUNCE_DefN_SUP_LIN_VSM_2_BATTERY_CONTROL_UNIT_12V_FONC: time-failed-threshold=2, time-passed-threshold=2
        ALGO_DefN_SUP_HS2_BCLVR_FONC: debounce-behavior=RESET
          debounce-algorithm:
            diag event debounce time based ALGO_DEBOUNCE_DefN_SUP_HS2_BCLVR_FONC: time-failed-threshold=2, time-passed-threshold=2
        ALGO_DefN_SUP_HS5_BCM_FONC: debounce-behavior=RESET
          debounce-algorithm:
            diag event debounce time based ALGO_DEBOUNCE_DefN_SUP_HS5_BCM_FONC: time-failed-threshold=2, time-passed-threshold=2
        ALGO_DefN_SUP_LIN_VSM_4_BRNCV_FL_FONC: debounce-behavior=RESET
          debounce-algorithm:
            diag event debounce time based ALGO_DEBOUNCE_DefN_SUP_LIN_VSM_4_BRNCV_FL_FONC: time-failed-threshold=2, time-passed-threshold=2
        ALGO_DefN_SUP_LIN_VSM_4_BRNCV_FR_FONC: debounce-behavior=RESET
          debounce-algorithm:
            diag event debounce time based ALGO_DEBOUNCE_DefN_SUP_LIN_VSM_4_BRNCV_FR_FONC: time-failed-threshold=2, time-passed-threshold=2
        ALGO_DefN_SUP_LIN_VSM_4_BRNCV_RL_FONC: debounce-behavior=RESET
          debounce-algorithm:
            diag event debounce time based ALGO_DEBOUNCE_DefN_SUP_LIN_VSM_4_BRNCV_RL_FONC: time-failed-threshold=2, time-passed-threshold=2
        ALGO_DefN_SUP_LIN_VSM_4_BRNCV_RR_FONC: debounce-behavior=RESET
          debounce-algorithm:
            diag event debounce time based ALGO_DEBOUNCE_DefN_SUP_LIN_VSM_4_BRNCV_RR_FONC: time-failed-threshold=2, time-passed-threshold=2
        ALGO_DefN_SUP_HS7_BSRF_FONC: debounce-behavior=RESET
          debounce-algorithm:
            diag event debounce time based ALGO_DEBOUNCE_DefN_SUP_HS7_BSRF_FONC: time-failed-threshold=2, time-passed-threshold=2
        ALGO_DefN_SUP_HS2_BV_FONC: debounce-behavior=RESET
          debounce-algorithm:
            diag event debounce time based ALGO_DEBOUNCE_DefN_SUP_HS2_BV_FONC: time-failed-threshold=2, time-passed-threshold=2
        ALGO_DefN_SUP_HS2_BVN_FONC: debounce-behavior=RESET
          debounce-algorithm:
            diag event debounce time based ALGO_DEBOUNCE_DefN_SUP_HS2_BVN_FONC: time-failed-threshold=2, time-passed-threshold=2
        ALGO_DefN_SUP_LIN_VSM_5_CABIN_FINE_PARTICLES_SENSOR_FONC: debounce-behavior=RESET
          debounce-algorithm:
            diag event debounce time based ALGO_DEBOUNCE_DefN_SUP_LIN_VSM_5_CABIN_FINE_PARTICLES_SENSOR_FONC: time-failed-threshold=2, time-passed-threshold=2
        ALGO_DefN_SUP_HS4_CMB_FONC: debounce-behavior=RESET
          debounce-algorithm:
            diag event debounce time based ALGO_DEBOUNCE_DefN_SUP_HS4_CMB_FONC: time-failed-threshold=2, time-passed-threshold=2
        ALGO_DefN_SUP_HS1_CMF_FONC: debounce-behavior=RESET
          debounce-algorithm:
            diag event debounce time based ALGO_DEBOUNCE_DefN_SUP_HS1_CMF_FONC: time-failed-threshold=2, time-passed-threshold=2
        ALGO_DefN_SUP_HS1_CMM_FONC: debounce-behavior=RESET
          debounce-algorithm:
            diag event debounce time based ALGO_DEBOUNCE_DefN_SUP_HS1_CMM_FONC: time-failed-threshold=2, time-passed-threshold=2
        ALGO_DefN_SUP_LIN_VSM_2_CONTROLLED_AIR_INLET_MODULE_FONC: debounce-behavior=RESET
          debounce-algorithm:
            diag event debounce time based ALGO_DEBOUNCE_DefN_SUP_LIN_VSM_2_CONTROLLED_AIR_INLET_MODULE_FONC: time-failed-threshold=2, time-passed-threshold=2
        ALGO_DefN_SUP_HS1_CSS_FONC: debounce-behavior=RESET
          debounce-algorithm:
            diag event debounce time based ALGO_DEBOUNCE_DefN_SUP_HS1_CSS_FONC: time-failed-threshold=2, time-passed-threshold=2
        ALGO_DefN_SUP_HS5_DCU_FD_FONC: debounce-behavior=RESET
          debounce-algorithm:
            diag event debounce time based ALGO_DEBOUNCE_DefN_SUP_HS5_DCU_FD_FONC: time-failed-threshold=2, time-passed-threshold=2
        ALGO_DefN_SUP_HS5_DCU_FP_FONC: debounce-behavior=RESET
          debounce-algorithm:
            diag event debounce time based ALGO_DEBOUNCE_DefN_SUP_HS5_DCU_FP_FONC: time-failed-threshold=2, time-passed-threshold=2
        ALGO_DefN_SUP_HS5_DCU_RL_FONC: debounce-behavior=RESET
          debounce-algorithm:
            diag event debounce time based ALGO_DEBOUNCE_DefN_SUP_HS5_DCU_RL_FONC: time-failed-threshold=2, time-passed-threshold=2
        ALGO_DefN_SUP_HS5_DCU_RR_FONC: debounce-behavior=RESET
          debounce-algorithm:
            diag event debounce time based ALGO_DEBOUNCE_DefN_SUP_HS5_DCU_RR_FONC: time-failed-threshold=2, time-passed-threshold=2
        ALGO_DefN_SUP_HS1_DMTR_FONC: debounce-behavior=RESET
          debounce-algorithm:
            diag event debounce time based ALGO_DEBOUNCE_DefN_SUP_HS1_DMTR_FONC: time-failed-threshold=2, time-passed-threshold=2
        ALGO_DefN_SUP_HS6_DRIVER_LED_L_F_FONC: debounce-behavior=RESET
          debounce-algorithm:
            diag event debounce time based ALGO_DEBOUNCE_DefN_SUP_HS6_DRIVER_LED_L_F_FONC: time-failed-threshold=2, time-passed-threshold=2
        ALGO_DefN_SUP_HS6_DRIVER_LED_R_F_FONC: debounce-behavior=RESET
          debounce-algorithm:
            diag event debounce time based ALGO_DEBOUNCE_DefN_SUP_HS6_DRIVER_LED_R_F_FONC: time-failed-threshold=2, time-passed-threshold=2
        ALGO_DefN_SUP_HS2_EBB_FONC: debounce-behavior=RESET
          debounce-algorithm:
            diag event debounce time based ALGO_DEBOUNCE_DefN_SUP_HS2_EBB_FONC: time-failed-threshold=2, time-passed-threshold=2
        ALGO_DefN_SUP_HS1_E_VCU_FONC: debounce-behavior=RESET
          debounce-algorithm:
            diag event debounce time based ALGO_DEBOUNCE_DefN_SUP_HS1_E_VCU_FONC: time-failed-threshold=2, time-passed-threshold=2
        ALGO_DefN_SUP_HS4_FMUX_FONC: debounce-behavior=RESET
          debounce-algorithm:
            diag event debounce time based ALGO_DEBOUNCE_DefN_SUP_HS4_FMUX_FONC: time-failed-threshold=2, time-passed-threshold=2
        ALGO_DefN_SUP_FD3_FRONT_CAMERA_FONC: debounce-behavior=RESET
          debounce-algorithm:
            diag event debounce time based ALGO_DEBOUNCE_DefN_SUP_FD3_FRONT_CAMERA_FONC: time-failed-threshold=2, time-passed-threshold=2
        ALGO_DefN_SUP_FD3_FRONT_RADAR_FONC: debounce-behavior=RESET
          debounce-algorithm:
            diag event debounce time based ALGO_DEBOUNCE_DefN_SUP_FD3_FRONT_RADAR_FONC: time-failed-threshold=2, time-passed-threshold=2
        ALGO_DefN_SUP_LIN_VSM_1_FRONT_WIPING_FONC: debounce-behavior=RESET
          debounce-algorithm:
            diag event debounce time based ALGO_DEBOUNCE_DefN_SUP_LIN_VSM_1_FRONT_WIPING_FONC: time-failed-threshold=2, time-passed-threshold=2
        ALGO_DefN_SUP_LIN_VSM_2_FUEL_ADDITIVE_SUPPLY_UNIT_FONC: debounce-behavior=RESET
          debounce-algorithm:
            diag event debounce time based ALGO_DEBOUNCE_DefN_SUP_LIN_VSM_2_FUEL_ADDITIVE_SUPPLY_UNIT_FONC: time-failed-threshold=2, time-passed-threshold=2
        ALGO_DefN_SUP_LIN_VSM_5_HV_ELECTRICAL_COMPRESSOR_FONC: debounce-behavior=RESET
          debounce-algorithm:
            diag event debounce time based ALGO_DEBOUNCE_DefN_SUP_LIN_VSM_5_HV_ELECTRICAL_COMPRESSOR_FONC: time-failed-threshold=2, time-passed-threshold=2
        ALGO_DefN_SUP_HS4_IDB_FONC: debounce-behavior=RESET
          debounce-algorithm:
            diag event debounce time based ALGO_DEBOUNCE_DefN_SUP_HS4_IDB_FONC: time-failed-threshold=2, time-passed-threshold=2
        ALGO_DefN_SUP_FD3_IVC_D_FONC: debounce-behavior=RESET
          debounce-algorithm:
            diag event debounce time based ALGO_DEBOUNCE_DefN_SUP_FD3_IVC_D_FONC: time-failed-threshold=2, time-passed-threshold=2
        ALGO_DefN_SUP_HS7_IVI_FONC: debounce-behavior=RESET
          debounce-algorithm:
            diag event debounce time based ALGO_DEBOUNCE_DefN_SUP_HS7_IVI_FONC: time-failed-threshold=2, time-passed-threshold=2
        ALGO_DefN_SUP_HS5_MAE_FONC: debounce-behavior=RESET
          debounce-algorithm:
            diag event debounce time based ALGO_DEBOUNCE_DefN_SUP_HS5_MAE_FONC: time-failed-threshold=2, time-passed-threshold=2
        ALGO_DefN_SUP_LIN_VSM_4_MASSAGE_AND_LUMBER_DEVICES_D_FONC: debounce-behavior=RESET
          debounce-algorithm:
            diag event debounce time based ALGO_DEBOUNCE_DefN_SUP_LIN_VSM_4_MASSAGE_AND_LUMBER_DEVICES_D_FONC: time-failed-threshold=2, time-passed-threshold=2
        ALGO_DefN_SUP_LIN_VSM_4_MASSAGE_AND_LUMBER_DEVICES_P_FONC: debounce-behavior=RESET
          debounce-algorithm:
            diag event debounce time based ALGO_DEBOUNCE_DefN_SUP_LIN_VSM_4_MASSAGE_AND_LUMBER_DEVICES_P_FONC: time-failed-threshold=2, time-passed-threshold=2
        ALGO_DefN_SUP_LIN_VSM_1_MUS_FONC: debounce-behavior=RESET
          debounce-algorithm:
            diag event debounce time based ALGO_DEBOUNCE_DefN_SUP_LIN_VSM_1_MUS_FONC: time-failed-threshold=2, time-passed-threshold=2
        ALGO_DefN_SUP_LIN_VSM_3_OCS_FONC: debounce-behavior=RESET
          debounce-algorithm:
            diag event debounce time based ALGO_DEBOUNCE_DefN_SUP_LIN_VSM_3_OCS_FONC: time-failed-threshold=2, time-passed-threshold=2
        ALGO_DefN_SUP_HS1_PROJ_FONC: debounce-behavior=RESET
          debounce-algorithm:
            diag event debounce time based ALGO_DEBOUNCE_DefN_SUP_HS1_PROJ_FONC: time-failed-threshold=2, time-passed-threshold=2
        ALGO_DefN_SUP_FD3_PVS_FONC: debounce-behavior=RESET
          debounce-algorithm:
            diag event debounce time based ALGO_DEBOUNCE_DefN_SUP_FD3_PVS_FONC: time-failed-threshold=2, time-passed-threshold=2
        ALGO_DefN_SUP_LIN_VSM_1_RAIN_LIGHT_SENSOR_FONC: debounce-behavior=RESET
          debounce-algorithm:
            diag event debounce time based ALGO_DEBOUNCE_DefN_SUP_LIN_VSM_1_RAIN_LIGHT_SENSOR_FONC: time-failed-threshold=2, time-passed-threshold=2
        ALGO_DefN_SUP_HS1_RBG_FONC: debounce-behavior=RESET
          debounce-algorithm:
            diag event debounce time based ALGO_DEBOUNCE_DefN_SUP_HS1_RBG_FONC: time-failed-threshold=2, time-passed-threshold=2
        ALGO_DefN_SUP_HS1_SBW_FONC: debounce-behavior=RESET
          debounce-algorithm:
            diag event debounce time based ALGO_DEBOUNCE_DefN_SUP_HS1_SBW_FONC: time-failed-threshold=2, time-passed-threshold=2
        ALGO_DefN_SUP_LIN_VSM_4_SCB_D_FONC: debounce-behavior=RESET
          debounce-algorithm:
            diag event debounce time based ALGO_DEBOUNCE_DefN_SUP_LIN_VSM_4_SCB_D_FONC: time-failed-threshold=2, time-passed-threshold=2
        ALGO_DefN_SUP_HS7_SDCM_FONC: debounce-behavior=RESET
          debounce-algorithm:
            diag event debounce time based ALGO_DEBOUNCE_DefN_SUP_HS7_SDCM_FONC: time-failed-threshold=2, time-passed-threshold=2
        ALGO_DefN_SUP_LIN_VSM_1_SIR_FONC: debounce-behavior=RESET
          debounce-algorithm:
            diag event debounce time based ALGO_DEBOUNCE_DefN_SUP_LIN_VSM_1_SIR_FONC: time-failed-threshold=2, time-passed-threshold=2
        ALGO_DefN_SUP_LIN_VSM_3_SUNROOF_FONC: debounce-behavior=RESET
          debounce-algorithm:
            diag event debounce time based ALGO_DEBOUNCE_DefN_SUP_LIN_VSM_3_SUNROOF_FONC: time-failed-threshold=2, time-passed-threshold=2
        ALGO_DefN_SUP_HS5_TCM_FONC: debounce-behavior=RESET
          debounce-algorithm:
            diag event debounce time based ALGO_DEBOUNCE_DefN_SUP_HS5_TCM_FONC: time-failed-threshold=2, time-passed-threshold=2
        ALGO_DefN_SUP_LIN_VSM_1_TNB_FONC: debounce-behavior=RESET
          debounce-algorithm:
            diag event debounce time based ALGO_DEBOUNCE_DefN_SUP_LIN_VSM_1_TNB_FONC: time-failed-threshold=2, time-passed-threshold=2
        ALGO_DefN_SUP_HS1_UC_DIRA_FONC: debounce-behavior=RESET
          debounce-algorithm:
            diag event debounce time based ALGO_DEBOUNCE_DefN_SUP_HS1_UC_DIRA_FONC: time-failed-threshold=2, time-passed-threshold=2
        ALGO_DefN_SUP_HS1_UC_FREIN_FONC: debounce-behavior=RESET
          debounce-algorithm:
            diag event debounce time based ALGO_DEBOUNCE_DefN_SUP_HS1_UC_FREIN_FONC: time-failed-threshold=2, time-passed-threshold=2
        ALGO_DefN_SUP_FD3_USS_FONC: debounce-behavior=RESET
          debounce-algorithm:
            diag event debounce time based ALGO_DEBOUNCE_DefN_SUP_FD3_USS_FONC: time-failed-threshold=2, time-passed-threshold=2
        ALGO_DefN_SUP_LIN_VSM_5_WATER_GLOW_BOILER_ELEC_CARD_FONC: debounce-behavior=RESET
          debounce-algorithm:
            diag event debounce time based ALGO_DEBOUNCE_DefN_SUP_LIN_VSM_5_WATER_GLOW_BOILER_ELEC_CARD_FONC: time-failed-threshold=2, time-passed-threshold=2
        ALGO_DefN_MUTUAL_AUTHENT_IMPOSSIBLE_Mode_00: debounce-behavior=FREEZE
          debounce-algorithm:
            diag event debounce time based ALGO_DEBOUNCE_DefN_MUTUAL_AUTHENT_IMPOSSIBLE_Mode_00: time-failed-threshold=2, time-passed-threshold=2
        ALGO_DefN_NO_ACK_FRAME_SDCM_Mode_08: debounce-behavior=FREEZE
          debounce-algorithm:
            diag event debounce time based ALGO_DEBOUNCE_DefN_NO_ACK_FRAME_SDCM_Mode_08: time-failed-threshold=2, time-passed-threshold=2
