AUTOSAR XML (schema 4-2-2)
package /RootP_DemDesc
  5 x diagnostic enable condition group:
    DemEnableConditionGroup_CORE0_MonitoringASILB: enable-conditions=DemEnableCondition_CORE0_MonitoringASILB
    DemEnableConditionGroup_CORE1_AppASILA: enable-conditions=DemEnableCondition_CORE1_APPASILA
    DemEnableConditionGroup_CORE1_AppASILB: enable-conditions=DemEnableCondition_CORE1_APPASILB
    DemEnableConditionGroup_CORE1_MonitoringASILB: enable-conditions=DemEnableCondition_CORE1_MonitoringASILB
    DemEnableConditionGroup_MASTER: enable-conditions=DemEnableCondition_MASTER
  5 x diagnostic enable condition, all with init-value=true:
    DemEnableCondition_CORE0_MonitoringASILB
    DemEnableCondition_CORE1_APPASILA
    DemEnableCondition_CORE1_APPASILB
    DemEnableCondition_CORE1_MonitoringASILB
    DemEnableCondition_MASTER
  5 x diagnostic storage condition group:
    DemStorageConditionGroup_CORE0_MonitoringASILB: storage-conditions=DemStorageCondition_CORE0_MonitoringASILB
    DemStorageConditionGroup_CORE1_APPASILA: storage-conditions=DemStorageCondition_CORE1_APPASILA
    DemStorageConditionGroup_CORE1_APPASILB: storage-conditions=DemStorageCondition_CORE1_APPASILB
    DemStorageConditionGroup_CORE1_MonitoringASILB: storage-conditions=DemStorageCondition_CORE1_MonitoringASILB
    DemStorageConditionGroup_MASTER: storage-conditions=DemStorageCondition_MASTER
  5 x diagnostic storage condition, all with init-value=true:
    DemStorageCondition_CORE0_MonitoringASILB
    DemStorageCondition_CORE1_APPASILA
    DemStorageCondition_CORE1_APPASILB
    DemStorageCondition_CORE1_MonitoringASILB
    DemStorageCondition_MASTER
package /RootP_DiagDesc
  diagnostic event AdcClcFailureNotification: aging-allowed=false, event-kind=BSW, prestorage-freeze-frame=false
    diagnostic connected indicator DiagConnectedIndicatorAdcClcFailureNotification: behavior=CONTINUOUS-ON-MODE, healing-cycle=DEM_OPCYC_POWER, indicator=DiagIndicator
  diagnostic event to enable condition group mapping AdcClcFailureNotificationToEnableCondGroupMapping: diagnostic-event=AdcClcFailureNotification, enable-condition-group=DemEnableConditionGroup_MASTER
  diagnostic event to operation cycle mapping AdcClcFailureNotificationToOpCycleMapping: diagnostic-event=AdcClcFailureNotification, operation-cycle=DEM_OPCYC_POWER
  diagnostic event to storage condition group mapping AdcClcFailureNotificationToStorageCondGroupMapping: diagnostic-event=AdcClcFailureNotification, storage-condition-group=DemStorageConditionGroup_MASTER
  diagnostic event AdcConvStopTimeNotification: aging-allowed=false, event-kind=BSW, prestorage-freeze-frame=false
    diagnostic connected indicator DiagConnectedIndicatorAdcConvStopTimeNotification: behavior=CONTINUOUS-ON-MODE, healing-cycle=DEM_OPCYC_POWER, indicator=DiagIndicator
  diagnostic event to enable condition group mapping AdcConvStopTimeNotificationToEnableCondGroupMapping: diagnostic-event=AdcConvStopTimeNotification, enable-condition-group=DemEnableConditionGroup_MASTER
  diagnostic event to operation cycle mapping AdcConvStopTimeNotificationToOpCycleMapping: diagnostic-event=AdcConvStopTimeNotification, operation-cycle=DEM_OPCYC_POWER
  diagnostic event to storage condition group mapping AdcConvStopTimeNotificationToStorageCondGroupMapping: diagnostic-event=AdcConvStopTimeNotification, storage-condition-group=DemStorageConditionGroup_MASTER
  diagnostic event CANSM_E_BUS_OFF_0: aging-allowed=false, event-kind=BSW, prestorage-freeze-frame=false
    diagnostic connected indicator DiagConnectedIndicatorCANSM_E_BUS_OFF_0: behavior=CONTINUOUS-ON-MODE, healing-cycle=DEM_OPCYC_POWER, indicator=DiagIndicator
  diagnostic event to enable condition group mapping CANSM_E_BUS_OFF_0ToEnableCondGroupMapping: diagnostic-event=CANSM_E_BUS_OFF_0, enable-condition-group=DemEnableConditionGroup_MASTER
  diagnostic event to operation cycle mapping CANSM_E_BUS_OFF_0ToOpCycleMapping: diagnostic-event=CANSM_E_BUS_OFF_0, operation-cycle=DEM_OPCYC_POWER
  diagnostic event to storage condition group mapping CANSM_E_BUS_OFF_0ToStorageCondGroupMapping: diagnostic-event=CANSM_E_BUS_OFF_0, storage-condition-group=DemStorageConditionGroup_MASTER
  diagnostic event CANSM_E_BUS_OFF_1: aging-allowed=false, event-kind=BSW, prestorage-freeze-frame=false
    diagnostic connected indicator DiagConnectedIndicatorCANSM_E_BUS_OFF_1: behavior=CONTINUOUS-ON-MODE, healing-cycle=DEM_OPCYC_POWER, indicator=DiagIndicator
  diagnostic event CANSM_E_BUS_OFF_10: aging-allowed=false, event-kind=BSW, prestorage-freeze-frame=false
    diagnostic connected indicator DiagConnectedIndicatorCANSM_E_BUS_OFF_10: behavior=CONTINUOUS-ON-MODE, healing-cycle=DEM_OPCYC_POWER, indicator=DiagIndicator
  diagnostic event to enable condition group mapping CANSM_E_BUS_OFF_10ToEnableCondGroupMapping: diagnostic-event=CANSM_E_BUS_OFF_10, enable-condition-group=DemEnableConditionGroup_MASTER
  diagnostic event to operation cycle mapping CANSM_E_BUS_OFF_10ToOpCycleMapping: diagnostic-event=CANSM_E_BUS_OFF_10, operation-cycle=DEM_OPCYC_POWER
  diagnostic event to storage condition group mapping CANSM_E_BUS_OFF_10ToStorageCondGroupMapping: diagnostic-event=CANSM_E_BUS_OFF_10, storage-condition-group=DemStorageConditionGroup_MASTER
  diagnostic event CANSM_E_BUS_OFF_11: aging-allowed=false, event-kind=BSW, prestorage-freeze-frame=false
    diagnostic connected indicator DiagConnectedIndicatorCANSM_E_BUS_OFF_11: behavior=CONTINUOUS-ON-MODE, healing-cycle=DEM_OPCYC_POWER, indicator=DiagIndicator
  diagnostic event to enable condition group mapping CANSM_E_BUS_OFF_11ToEnableCondGroupMapping: diagnostic-event=CANSM_E_BUS_OFF_11, enable-condition-group=DemEnableConditionGroup_MASTER
  diagnostic event to operation cycle mapping CANSM_E_BUS_OFF_11ToOpCycleMapping: diagnostic-event=CANSM_E_BUS_OFF_11, operation-cycle=DEM_OPCYC_POWER
  diagnostic event to storage condition group mapping CANSM_E_BUS_OFF_11ToStorageCondGroupMapping: diagnostic-event=CANSM_E_BUS_OFF_11, storage-condition-group=DemStorageConditionGroup_MASTER
  diagnostic event CANSM_E_BUS_OFF_12: aging-allowed=false, event-kind=BSW, prestorage-freeze-frame=false
    diagnostic connected indicator DiagConnectedIndicatorCANSM_E_BUS_OFF_12: behavior=CONTINUOUS-ON-MODE, healing-cycle=DEM_OPCYC_POWER, indicator=DiagIndicator
  diagnostic event to enable condition group mapping CANSM_E_BUS_OFF_12ToEnableCondGroupMapping: diagnostic-event=CANSM_E_BUS_OFF_12, enable-condition-group=DemEnableConditionGroup_MASTER
  diagnostic event to operation cycle mapping CANSM_E_BUS_OFF_12ToOpCycleMapping: diagnostic-event=CANSM_E_BUS_OFF_12, operation-cycle=DEM_OPCYC_POWER
  diagnostic event to storage condition group mapping CANSM_E_BUS_OFF_12ToStorageCondGroupMapping: diagnostic-event=CANSM_E_BUS_OFF_12, storage-condition-group=DemStorageConditionGroup_MASTER
  diagnostic event CANSM_E_BUS_OFF_13: aging-allowed=false, event-kind=BSW, prestorage-freeze-frame=false
    diagnostic connected indicator DiagConnectedIndicatorCANSM_E_BUS_OFF_13: behavior=CONTINUOUS-ON-MODE, healing-cycle=DEM_OPCYC_POWER, indicator=DiagIndicator
  diagnostic event to enable condition group mapping CANSM_E_BUS_OFF_13ToEnableCondGroupMapping: diagnostic-event=CANSM_E_BUS_OFF_13, enable-condition-group=DemEnableConditionGroup_MASTER
  diagnostic event to operation cycle mapping CANSM_E_BUS_OFF_13ToOpCycleMapping: diagnostic-event=CANSM_E_BUS_OFF_13, operation-cycle=DEM_OPCYC_POWER
  diagnostic event to storage condition group mapping CANSM_E_BUS_OFF_13ToStorageCondGroupMapping: diagnostic-event=CANSM_E_BUS_OFF_13, storage-condition-group=DemStorageConditionGroup_MASTER
  diagnostic event CANSM_E_BUS_OFF_14: aging-allowed=false, event-kind=BSW, prestorage-freeze-frame=false
    diagnostic connected indicator DiagConnectedIndicatorCANSM_E_BUS_OFF_14: behavior=CONTINUOUS-ON-MODE, healing-cycle=DEM_OPCYC_POWER, indicator=DiagIndicator
  diagnostic event to enable condition group mapping CANSM_E_BUS_OFF_14ToEnableCondGroupMapping: diagnostic-event=CANSM_E_BUS_OFF_14, enable-condition-group=DemEnableConditionGroup_MASTER
  diagnostic event to operation cycle mapping CANSM_E_BUS_OFF_14ToOpCycleMapping: diagnostic-event=CANSM_E_BUS_OFF_14, operation-cycle=DEM_OPCYC_POWER
  diagnostic event to storage condition group mapping CANSM_E_BUS_OFF_14ToStorageCondGroupMapping: diagnostic-event=CANSM_E_BUS_OFF_14, storage-condition-group=DemStorageConditionGroup_MASTER
  diagnostic event CANSM_E_BUS_OFF_15: aging-allowed=false, event-kind=BSW, prestorage-freeze-frame=false
    diagnostic connected indicator DiagConnectedIndicatorCANSM_E_BUS_OFF_15: behavior=CONTINUOUS-ON-MODE, healing-cycle=DEM_OPCYC_POWER, indicator=DiagIndicator
  diagnostic event to enable condition group mapping CANSM_E_BUS_OFF_15ToEnableCondGroupMapping: diagnostic-event=CANSM_E_BUS_OFF_15, enable-condition-group=DemEnableConditionGroup_MASTER
  diagnostic event to operation cycle mapping CANSM_E_BUS_OFF_15ToOpCycleMapping: diagnostic-event=CANSM_E_BUS_OFF_15, operation-cycle=DEM_OPCYC_POWER
  diagnostic event to storage condition group mapping CANSM_E_BUS_OFF_15ToStorageCondGroupMapping: diagnostic-event=CANSM_E_BUS_OFF_15, storage-condition-group=DemStorageConditionGroup_MASTER
  diagnostic event to enable condition group mapping CANSM_E_BUS_OFF_1ToEnableCondGroupMapping: diagnostic-event=CANSM_E_BUS_OFF_1, enable-condition-group=DemEnableConditionGroup_MASTER
  diagnostic event to operation cycle mapping CANSM_E_BUS_OFF_1ToOpCycleMapping: diagnostic-event=CANSM_E_BUS_OFF_1, operation-cycle=DEM_OPCYC_POWER
  diagnostic event to storage condition group mapping CANSM_E_BUS_OFF_1ToStorageCondGroupMapping: diagnostic-event=CANSM_E_BUS_OFF_1, storage-condition-group=DemStorageConditionGroup_MASTER
  diagnostic event CANSM_E_BUS_OFF_2: aging-allowed=false, event-kind=BSW, prestorage-freeze-frame=false
    diagnostic connected indicator DiagConnectedIndicatorCANSM_E_BUS_OFF_2: behavior=CONTINUOUS-ON-MODE, healing-cycle=DEM_OPCYC_POWER, indicator=DiagIndicator
  diagnostic event to enable condition group mapping CANSM_E_BUS_OFF_2ToEnableCondGroupMapping: diagnostic-event=CANSM_E_BUS_OFF_2, enable-condition-group=DemEnableConditionGroup_MASTER
  diagnostic event to operation cycle mapping CANSM_E_BUS_OFF_2ToOpCycleMapping: diagnostic-event=CANSM_E_BUS_OFF_2, operation-cycle=DEM_OPCYC_POWER
  diagnostic event to storage condition group mapping CANSM_E_BUS_OFF_2ToStorageCondGroupMapping: diagnostic-event=CANSM_E_BUS_OFF_2, storage-condition-group=DemStorageConditionGroup_MASTER
  diagnostic event CANSM_E_BUS_OFF_3: aging-allowed=false, event-kind=BSW, prestorage-freeze-frame=false
    diagnostic connected indicator DiagConnectedIndicatorCANSM_E_BUS_OFF_3: behavior=CONTINUOUS-ON-MODE, healing-cycle=DEM_OPCYC_POWER, indicator=DiagIndicator
  diagnostic event to enable condition group mapping CANSM_E_BUS_OFF_3ToEnableCondGroupMapping: diagnostic-event=CANSM_E_BUS_OFF_3, enable-condition-group=DemEnableConditionGroup_MASTER
  diagnostic event to operation cycle mapping CANSM_E_BUS_OFF_3ToOpCycleMapping: diagnostic-event=CANSM_E_BUS_OFF_3, operation-cycle=DEM_OPCYC_POWER
  diagnostic event to storage condition group mapping CANSM_E_BUS_OFF_3ToStorageCondGroupMapping: diagnostic-event=CANSM_E_BUS_OFF_3, storage-condition-group=DemStorageConditionGroup_MASTER
  diagnostic event CANSM_E_BUS_OFF_4: aging-allowed=false, event-kind=BSW, prestorage-freeze-frame=false
    diagnostic connected indicator DiagConnectedIndicatorCANSM_E_BUS_OFF_4: behavior=CONTINUOUS-ON-MODE, healing-cycle=DEM_OPCYC_POWER, indicator=DiagIndicator
  diagnostic event to enable condition group mapping CANSM_E_BUS_OFF_4ToEnableCondGroupMapping: diagnostic-event=CANSM_E_BUS_OFF_4, enable-condition-group=DemEnableConditionGroup_MASTER
  diagnostic event to operation cycle mapping CANSM_E_BUS_OFF_4ToOpCycleMapping: diagnostic-event=CANSM_E_BUS_OFF_4, operation-cycle=DEM_OPCYC_POWER
  diagnostic event to storage condition group mapping CANSM_E_BUS_OFF_4ToStorageCondGroupMapping: diagnostic-event=CANSM_E_BUS_OFF_4, storage-condition-group=DemStorageConditionGroup_MASTER
  diagnostic event CANSM_E_BUS_OFF_5: aging-allowed=false, event-kind=BSW, prestorage-freeze-frame=false
    diagnostic connected indicator DiagConnectedIndicatorCANSM_E_BUS_OFF_5: behavior=CONTINUOUS-ON-MODE, healing-cycle=DEM_OPCYC_POWER, indicator=DiagIndicator
  diagnostic event to enable condition group mapping CANSM_E_BUS_OFF_5ToEnableCondGroupMapping: diagnostic-event=CANSM_E_BUS_OFF_5, enable-condition-group=DemEnableConditionGroup_MASTER
  diagnostic event to operation cycle mapping CANSM_E_BUS_OFF_5ToOpCycleMapping: diagnostic-event=CANSM_E_BUS_OFF_5, operation-cycle=DEM_OPCYC_POWER
  diagnostic event to storage condition group mapping CANSM_E_BUS_OFF_5ToStorageCondGroupMapping: diagnostic-event=CANSM_E_BUS_OFF_5, storage-condition-group=DemStorageConditionGroup_MASTER
  diagnostic event CANSM_E_BUS_OFF_6: aging-allowed=false, event-kind=BSW, prestorage-freeze-frame=false
    diagnostic connected indicator DiagConnectedIndicatorCANSM_E_BUS_OFF_6: behavior=CONTINUOUS-ON-MODE, healing-cycle=DEM_OPCYC_POWER, indicator=DiagIndicator
  diagnostic event to enable condition group mapping CANSM_E_BUS_OFF_6ToEnableCondGroupMapping: diagnostic-event=CANSM_E_BUS_OFF_6, enable-condition-group=DemEnableConditionGroup_MASTER
  diagnostic event to operation cycle mapping CANSM_E_BUS_OFF_6ToOpCycleMapping: diagnostic-event=CANSM_E_BUS_OFF_6, operation-cycle=DEM_OPCYC_POWER
  diagnostic event to storage condition group mapping CANSM_E_BUS_OFF_6ToStorageCondGroupMapping: diagnostic-event=CANSM_E_BUS_OFF_6, storage-condition-group=DemStorageConditionGroup_MASTER
  diagnostic event CANSM_E_BUS_OFF_7: aging-allowed=false, event-kind=BSW, prestorage-freeze-frame=false
    diagnostic connected indicator DiagConnectedIndicatorCANSM_E_BUS_OFF_7: behavior=CONTINUOUS-ON-MODE, healing-cycle=DEM_OPCYC_POWER, indicator=DiagIndicator
  diagnostic event to enable condition group mapping CANSM_E_BUS_OFF_7ToEnableCondGroupMapping: diagnostic-event=CANSM_E_BUS_OFF_7, enable-condition-group=DemEnableConditionGroup_MASTER
  diagnostic event to operation cycle mapping CANSM_E_BUS_OFF_7ToOpCycleMapping: diagnostic-event=CANSM_E_BUS_OFF_7, operation-cycle=DEM_OPCYC_POWER
  diagnostic event to storage condition group mapping CANSM_E_BUS_OFF_7ToStorageCondGroupMapping: diagnostic-event=CANSM_E_BUS_OFF_7, storage-condition-group=DemStorageConditionGroup_MASTER
  diagnostic event CANSM_E_BUS_OFF_8: aging-allowed=false, event-kind=BSW, prestorage-freeze-frame=false
    diagnostic connected indicator DiagConnectedIndicatorCANSM_E_BUS_OFF_8: behavior=CONTINUOUS-ON-MODE, healing-cycle=DEM_OPCYC_POWER, indicator=DiagIndicator
  diagnostic event to enable condition group mapping CANSM_E_BUS_OFF_8ToEnableCondGroupMapping: diagnostic-event=CANSM_E_BUS_OFF_8, enable-condition-group=DemEnableConditionGroup_MASTER
  diagnostic event to operation cycle mapping CANSM_E_BUS_OFF_8ToOpCycleMapping: diagnostic-event=CANSM_E_BUS_OFF_8, operation-cycle=DEM_OPCYC_POWER
  diagnostic event to storage condition group mapping CANSM_E_BUS_OFF_8ToStorageCondGroupMapping: diagnostic-event=CANSM_E_BUS_OFF_8, storage-condition-group=DemStorageConditionGroup_MASTER
  diagnostic event CANSM_E_BUS_OFF_9: aging-allowed=false, event-kind=BSW, prestorage-freeze-frame=false
    diagnostic connected indicator DiagConnectedIndicatorCANSM_E_BUS_OFF_9: behavior=CONTINUOUS-ON-MODE, healing-cycle=DEM_OPCYC_POWER, indicator=DiagIndicator
  diagnostic event to enable condition group mapping CANSM_E_BUS_OFF_9ToEnableCondGroupMapping: diagnostic-event=CANSM_E_BUS_OFF_9, enable-condition-group=DemEnableConditionGroup_MASTER
  diagnostic event to operation cycle mapping CANSM_E_BUS_OFF_9ToOpCycleMapping: diagnostic-event=CANSM_E_BUS_OFF_9, operation-cycle=DEM_OPCYC_POWER
  diagnostic event to storage condition group mapping CANSM_E_BUS_OFF_9ToStorageCondGroupMapping: diagnostic-event=CANSM_E_BUS_OFF_9, storage-condition-group=DemStorageConditionGroup_MASTER
  diagnostic event CAN_E_TIMEOUT: aging-allowed=false, event-kind=BSW, prestorage-freeze-frame=false
    diagnostic connected indicator DiagConnectedIndicatorCAN_E_TIMEOUT: behavior=CONTINUOUS-ON-MODE, healing-cycle=DEM_OPCYC_POWER, indicator=DiagIndicator
  diagnostic event to enable condition group mapping CAN_E_TIMEOUTToEnableCondGroupMapping: diagnostic-event=CAN_E_TIMEOUT, enable-condition-group=DemEnableConditionGroup_MASTER
  diagnostic event to operation cycle mapping CAN_E_TIMEOUTToOpCycleMapping: diagnostic-event=CAN_E_TIMEOUT, operation-cycle=DEM_OPCYC_POWER
  diagnostic event to storage condition group mapping CAN_E_TIMEOUTToStorageCondGroupMapping: diagnostic-event=CAN_E_TIMEOUT, storage-condition-group=DemStorageConditionGroup_MASTER
  diagnostic operation cycle DEM_OPCYC_POWER: automatic-end=false, cycle-autostart=false, cycle-status-storage=false, type=POWER
  67 x diagnostic event to debounce algorithm mapping:
    DTC_2_ALGO_AdcClcFailureNotification_Mapping: debounce-algorithm=ALGO_AdcClcFailureNotification, diagnostic-event=AdcClcFailureNotification
    DTC_2_ALGO_AdcConvStopTimeNotification_Mapping: debounce-algorithm=ALGO_AdcConvStopTimeNotification, diagnostic-event=AdcConvStopTimeNotification
    DTC_2_ALGO_CANSM_E_BUS_OFF_0_Mapping: debounce-algorithm=ALGO_CANSM_E_BUS_OFF_0, diagnostic-event=CANSM_E_BUS_OFF_0
    DTC_2_ALGO_CANSM_E_BUS_OFF_{10..15}_Mapping: debounce-algorithm=ALGO_CANSM_E_BUS_OFF_{10..15}, diagnostic-event=CANSM_E_BUS_OFF_{10..15}
    DTC_2_ALGO_CANSM_E_BUS_OFF_{1..9}_Mapping: debounce-algorithm=ALGO_CANSM_E_BUS_OFF_{1..9}, diagnostic-event=CANSM_E_BUS_OFF_{1..9}
    DTC_2_ALGO_CAN_E_TIMEOUT_Mapping: debounce-algorithm=ALGO_CAN_E_TIMEOUT, diagnostic-event=CAN_E_TIMEOUT
    DTC_2_ALGO_ECUM_E_RAM_CHECK_FAILED_Mapping: debounce-algorithm=ALGO_ECUM_E_RAM_CHECK_FAILED, diagnostic-event=ECUM_E_RAM_CHECK_FAILED
    DTC_2_ALGO_ETH_E_ACCESS_Mapping: debounce-algorithm=ALGO_ETH_E_ACCESS, diagnostic-event=ETH_E_ACCESS
    DTC_2_ALGO_ETH_E_ALIGNMENT_Mapping: debounce-algorithm=ALGO_ETH_E_ALIGNMENT, diagnostic-event=ETH_E_ALIGNMENT
    DTC_2_ALGO_ETH_E_CRC_Mapping: debounce-algorithm=ALGO_ETH_E_CRC, diagnostic-event=ETH_E_CRC
    DTC_2_ALGO_ETH_E_FRAMESEQ_Mapping: debounce-algorithm=ALGO_ETH_E_FRAMESEQ, diagnostic-event=ETH_E_FRAMESEQ
    DTC_2_ALGO_ETH_E_LATECOLLISION_Mapping: debounce-algorithm=ALGO_ETH_E_LATECOLLISION, diagnostic-event=ETH_E_LATECOLLISION
    DTC_2_ALGO_ETH_E_MULTIPLECOLLISION_Mapping: debounce-algorithm=ALGO_ETH_E_MULTIPLECOLLISION, diagnostic-event=ETH_E_MULTIPLECOLLISION
    DTC_2_ALGO_ETH_E_OVERSIZEFRAME_Mapping: debounce-algorithm=ALGO_ETH_E_OVERSIZEFRAME, diagnostic-event=ETH_E_OVERSIZEFRAME
    DTC_2_ALGO_ETH_E_RX_FRAMES_LOST_Mapping: debounce-algorithm=ALGO_ETH_E_RX_FRAMES_LOST, diagnostic-event=ETH_E_RX_FRAMES_LOST
    DTC_2_ALGO_ETH_E_SINGLECOLLISION_Mapping: debounce-algorithm=ALGO_ETH_E_SINGLECOLLISION, diagnostic-event=ETH_E_SINGLECOLLISION
    DTC_2_ALGO_ETH_E_TIMEOUT_Mapping: debounce-algorithm=ALGO_ETH_E_TIMEOUT, diagnostic-event=ETH_E_TIMEOUT
    DTC_2_ALGO_ETH_E_UNDERSIZEFRAME_Mapping: debounce-algorithm=ALGO_ETH_E_UNDERSIZEFRAME, diagnostic-event=ETH_E_UNDERSIZEFRAME
    DTC_2_ALGO_FEE_E_GC_ERASE_Mapping: debounce-algorithm=ALGO_FEE_E_GC_ERASE, diagnostic-event=FEE_E_GC_ERASE
    DTC_2_ALGO_FEE_E_GC_INIT_Mapping: debounce-algorithm=ALGO_FEE_E_GC_INIT, diagnostic-event=FEE_E_GC_INIT
    DTC_2_ALGO_FEE_E_GC_READ_Mapping: debounce-algorithm=ALGO_FEE_E_GC_READ, diagnostic-event=FEE_E_GC_READ
    DTC_2_ALGO_FEE_E_GC_TRIG_Mapping: debounce-algorithm=ALGO_FEE_E_GC_TRIG, diagnostic-event=FEE_E_GC_TRIG
    DTC_2_ALGO_FEE_E_GC_WRITE_Mapping: debounce-algorithm=ALGO_FEE_E_GC_WRITE, diagnostic-event=FEE_E_GC_WRITE
    DTC_2_ALGO_FEE_E_INVALIDATE_Mapping: debounce-algorithm=ALGO_FEE_E_INVALIDATE, diagnostic-event=FEE_E_INVALIDATE
    DTC_2_ALGO_FEE_E_READ_Mapping: debounce-algorithm=ALGO_FEE_E_READ, diagnostic-event=FEE_E_READ
    DTC_2_ALGO_FEE_E_UNCONFIG_BLK_EXCEEDED_Mapping: debounce-algorithm=ALGO_FEE_E_UNCONFIG_BLK_EXCEEDED, diagnostic-event=FEE_E_UNCONFIG_BLK_EXCEEDED
    DTC_2_ALGO_FEE_E_WRITE_CYCLES_EXHAUSTED_Mapping: debounce-algorithm=ALGO_FEE_E_WRITE_CYCLES_EXHAUSTED, diagnostic-event=FEE_E_WRITE_CYCLES_EXHAUSTED
    DTC_2_ALGO_FEE_E_WRITE_Mapping: debounce-algorithm=ALGO_FEE_E_WRITE, diagnostic-event=FEE_E_WRITE
    DTC_2_ALGO_FLS_E_COMPARE_FAILED_Mapping: debounce-algorithm=ALGO_FLS_E_COMPARE_FAILED, diagnostic-event=FLS_E_COMPARE_FAILED
    DTC_2_ALGO_FLS_E_ERASE_FAILED_Mapping: debounce-algorithm=ALGO_FLS_E_ERASE_FAILED, diagnostic-event=FLS_E_ERASE_FAILED
    DTC_2_ALGO_FLS_E_READ_FAILED_Mapping: debounce-algorithm=ALGO_FLS_E_READ_FAILED, diagnostic-event=FLS_E_READ_FAILED
    DTC_2_ALGO_FLS_E_UNEXPECTED_FLASH_ID_Mapping: debounce-algorithm=ALGO_FLS_E_UNEXPECTED_FLASH_ID, diagnostic-event=FLS_E_UNEXPECTED_FLASH_ID
    DTC_2_ALGO_FLS_E_WRITE_FAILED_Mapping: debounce-algorithm=ALGO_FLS_E_WRITE_FAILED, diagnostic-event=FLS_E_WRITE_FAILED
    DTC_2_ALGO_LIN_E_TIMEOUT_Mapping: debounce-algorithm=ALGO_LIN_E_TIMEOUT, diagnostic-event=LIN_E_TIMEOUT
    DTC_2_ALGO_MCU_E_CCU6_CLC_DISABLE_ERR_Mapping: debounce-algorithm=ALGO_MCU_E_CCU6_CLC_DISABLE_ERR, diagnostic-event=MCU_E_CCU6_CLC_DISABLE_ERR
    DTC_2_ALGO_MCU_E_CCU6_CLC_ENABLE_ERR_Mapping: debounce-algorithm=ALGO_MCU_E_CCU6_CLC_ENABLE_ERR, diagnostic-event=MCU_E_CCU6_CLC_ENABLE_ERR
    DTC_2_ALGO_MCU_E_CCUCON_UPDATE_ERR_Mapping: debounce-algorithm=ALGO_MCU_E_CCUCON_UPDATE_ERR, diagnostic-event=MCU_E_CCUCON_UPDATE_ERR
    DTC_2_ALGO_MCU_E_CLOCK_FAILURE_Mapping: debounce-algorithm=ALGO_MCU_E_CLOCK_FAILURE, diagnostic-event=MCU_E_CLOCK_FAILURE
    DTC_2_ALGO_MCU_E_CONVCTRL_CLC_DISABLE_ERR_Mapping: debounce-algorithm=ALGO_MCU_E_CONVCTRL_CLC_DISABLE_ERR, diagnostic-event=MCU_E_CONVCTRL_CLC_DISABLE_ERR
    DTC_2_ALGO_MCU_E_CONVCTRL_CLC_ENABLE_ERR_Mapping: debounce-algorithm=ALGO_MCU_E_CONVCTRL_CLC_ENABLE_ERR, diagnostic-event=MCU_E_CONVCTRL_CLC_ENABLE_ERR
    DTC_2_ALGO_MCU_E_GPT12_CLC_DISABLE_ERR_Mapping: debounce-algorithm=ALGO_MCU_E_GPT12_CLC_DISABLE_ERR, diagnostic-event=MCU_E_GPT12_CLC_DISABLE_ERR
    DTC_2_ALGO_MCU_E_GPT12_CLC_ENABLE_ERR_Mapping: debounce-algorithm=ALGO_MCU_E_GPT12_CLC_ENABLE_ERR, diagnostic-event=MCU_E_GPT12_CLC_ENABLE_ERR
    DTC_2_ALGO_MCU_E_GTM_CLC_DISABLE_ERR_Mapping: debounce-algorithm=ALGO_MCU_E_GTM_CLC_DISABLE_ERR, diagnostic-event=MCU_E_GTM_CLC_DISABLE_ERR
    DTC_2_ALGO_MCU_E_GTM_CLC_ENABLE_ERR_Mapping: debounce-algorithm=ALGO_MCU_E_GTM_CLC_ENABLE_ERR, diagnostic-event=MCU_E_GTM_CLC_ENABLE_ERR
    DTC_2_ALGO_MCU_E_OSC_FAILURE_Mapping: debounce-algorithm=ALGO_MCU_E_OSC_FAILURE, diagnostic-event=MCU_E_OSC_FAILURE
    DTC_2_ALGO_MCU_E_PERIPHERAL_PLL_LOCK_LOSS_Mapping: debounce-algorithm=ALGO_MCU_E_PERIPHERAL_PLL_LOCK_LOSS, diagnostic-event=MCU_E_PERIPHERAL_PLL_LOCK_LOSS
    DTC_2_ALGO_MCU_E_PERIPHERAL_PLL_TIMEOUT_ERR_Mapping: debounce-algorithm=ALGO_MCU_E_PERIPHERAL_PLL_TIMEOUT_ERR, diagnostic-event=MCU_E_PERIPHERAL_PLL_TIMEOUT_ERR
    DTC_2_ALGO_MCU_E_PMSWCR_UPDATE_ERR_Mapping: debounce-algorithm=ALGO_MCU_E_PMSWCR_UPDATE_ERR, diagnostic-event=MCU_E_PMSWCR_UPDATE_ERR
    DTC_2_ALGO_MCU_E_SYSTEM_PLL_LOCK_LOSS_Mapping: debounce-algorithm=ALGO_MCU_E_SYSTEM_PLL_LOCK_LOSS, diagnostic-event=MCU_E_SYSTEM_PLL_LOCK_LOSS
    DTC_2_ALGO_MCU_E_SYSTEM_PLL_TIMEOUT_ERR_Mapping: debounce-algorithm=ALGO_MCU_E_SYSTEM_PLL_TIMEOUT_ERR, diagnostic-event=MCU_E_SYSTEM_PLL_TIMEOUT_ERR
    DTC_2_ALGO_SPI_E_HARDWARE_ERROR_Mapping: debounce-algorithm=ALGO_SPI_E_HARDWARE_ERROR, diagnostic-event=SPI_E_HARDWARE_ERROR
    DTC_2_ALGO_WDGM_E_DATA_CORRUPTION_Mapping: debounce-algorithm=ALGO_WDGM_E_DATA_CORRUPTION, diagnostic-event=WDGM_E_DATA_CORRUPTION
    DTC_2_ALGO_WDGM_E_MONITORING_Mapping: debounce-algorithm=ALGO_WDGM_E_MONITORING, diagnostic-event=WDGM_E_MONITORING
    DTC_2_ALGO_WDGM_E_SET_MODE_Mapping: debounce-algorithm=ALGO_WDGM_E_SET_MODE, diagnostic-event=WDGM_E_SET_MODE
  diagnostic contribution set DiagContributionSet: category=DIAGNOSTICS_ECU_EXTRACT, ecu-instance=VSM
    common-properties:
      67 x diagnostic debounce algorithm props, all with debounce-behavior=FREEZE:
        ALGO_AdcClcFailureNotification
          debounce-algorithm:
            diag event debounce time based ALGO_DEBOUNCE_AdcClcFailureNotification: time-failed-threshold=0.01, time-passed-threshold=0.01
        ALGO_AdcConvStopTimeNotification
          debounce-algorithm:
            diag event debounce time based ALGO_DEBOUNCE_AdcConvStopTimeNotification: time-failed-threshold=0.01, time-passed-threshold=0.01
        ALGO_CANSM_E_BUS_OFF_0
          debounce-algorithm:
            diag event debounce time based ALGO_DEBOUNCE_CANSM_E_BUS_OFF_0: time-failed-threshold=0.01, time-passed-threshold=0.01
        ALGO_CANSM_E_BUS_OFF_1
          debounce-algorithm:
            diag event debounce time based ALGO_DEBOUNCE_CANSM_E_BUS_OFF_1: time-failed-threshold=0.01, time-passed-threshold=0.01
        ALGO_CANSM_E_BUS_OFF_10
          debounce-algorithm:
            diag event debounce time based ALGO_DEBOUNCE_CANSM_E_BUS_OFF_10: time-failed-threshold=0.01, time-passed-threshold=0.01
        ALGO_CANSM_E_BUS_OFF_11
          debounce-algorithm:
            diag event debounce time based ALGO_DEBOUNCE_CANSM_E_BUS_OFF_11: time-failed-threshold=0.01, time-passed-threshold=0.01
        ALGO_CANSM_E_BUS_OFF_12
          debounce-algorithm:
            diag event debounce time based ALGO_DEBOUNCE_CANSM_E_BUS_OFF_12: time-failed-threshold=0.01, time-passed-threshold=0.01
        ALGO_CANSM_E_BUS_OFF_13
          debounce-algorithm:
            diag event debounce time based ALGO_DEBOUNCE_CANSM_E_BUS_OFF_13: time-failed-threshold=0.01, time-passed-threshold=0.01
        ALGO_CANSM_E_BUS_OFF_14
          debounce-algorithm:
            diag event debounce time based ALGO_DEBOUNCE_CANSM_E_BUS_OFF_14: time-failed-threshold=0.01, time-passed-threshold=0.01
        ALGO_CANSM_E_BUS_OFF_15
          debounce-algorithm:
            diag event debounce time based ALGO_DEBOUNCE_CANSM_E_BUS_OFF_15: time-failed-threshold=0.01, time-passed-threshold=0.01
        ALGO_CANSM_E_BUS_OFF_2
          debounce-algorithm:
            diag event debounce time based ALGO_DEBOUNCE_CANSM_E_BUS_OFF_2: time-failed-threshold=0.01, time-passed-threshold=0.01
        ALGO_CANSM_E_BUS_OFF_3
          debounce-algorithm:
            diag event debounce time based ALGO_DEBOUNCE_CANSM_E_BUS_OFF_3: time-failed-threshold=0.01, time-passed-threshold=0.01
        ALGO_CANSM_E_BUS_OFF_4
          debounce-algorithm:
            diag event debounce time based ALGO_DEBOUNCE_CANSM_E_BUS_OFF_4: time-failed-threshold=0.01, time-passed-threshold=0.01
        ALGO_CANSM_E_BUS_OFF_5
          debounce-algorithm:
            diag event debounce time based ALGO_DEBOUNCE_CANSM_E_BUS_OFF_5: time-failed-threshold=0.01, time-passed-threshold=0.01
        ALGO_CANSM_E_BUS_OFF_6
          debounce-algorithm:
            diag event debounce time based ALGO_DEBOUNCE_CANSM_E_BUS_OFF_6: time-failed-threshold=0.01, time-passed-threshold=0.01
        ALGO_CANSM_E_BUS_OFF_7
          debounce-algorithm:
            diag event debounce time based ALGO_DEBOUNCE_CANSM_E_BUS_OFF_7: time-failed-threshold=0.01, time-passed-threshold=0.01
        ALGO_CANSM_E_BUS_OFF_8
          debounce-algorithm:
            diag event debounce time based ALGO_DEBOUNCE_CANSM_E_BUS_OFF_8: time-failed-threshold=0.01, time-passed-threshold=0.01
        ALGO_CANSM_E_BUS_OFF_9
          debounce-algorithm:
            diag event debounce time based ALGO_DEBOUNCE_CANSM_E_BUS_OFF_9: time-failed-threshold=0.01, time-passed-threshold=0.01
        ALGO_CAN_E_TIMEOUT
          debounce-algorithm:
            diag event debounce time based ALGO_DEBOUNCE_CAN_E_TIMEOUT: time-failed-threshold=0.01, time-passed-threshold=0.01
        ALGO_ECUM_E_RAM_CHECK_FAILED
          debounce-algorithm:
            diag event debounce time based ALGO_DEBOUNCE_ECUM_E_RAM_CHECK_FAILED: time-failed-threshold=0.01, time-passed-threshold=0.01
        ALGO_ETH_E_ACCESS
          debounce-algorithm:
            diag event debounce time based ALGO_DEBOUNCE_ETH_E_ACCESS: time-failed-threshold=0.01, time-passed-threshold=0.01
        ALGO_ETH_E_ALIGNMENT
          debounce-algorithm:
            diag event debounce time based ALGO_DEBOUNCE_ETH_E_ALIGNMENT: time-failed-threshold=0.01, time-passed-threshold=0.01
        ALGO_ETH_E_CRC
          debounce-algorithm:
            diag event debounce time based ALGO_DEBOUNCE_ETH_E_CRC: time-failed-threshold=0.01, time-passed-threshold=0.01
        ALGO_ETH_E_FRAMESEQ
          debounce-algorithm:
            diag event debounce time based ALGO_DEBOUNCE_ETH_E_FRAMESEQ: time-failed-threshold=0.01, time-passed-threshold=0.01
        ALGO_ETH_E_LATECOLLISION
          debounce-algorithm:
            diag event debounce time based ALGO_DEBOUNCE_ETH_E_LATECOLLISION: time-failed-threshold=0.01, time-passed-threshold=0.01
        ALGO_ETH_E_MULTIPLECOLLISION
          debounce-algorithm:
            diag event debounce time based ALGO_DEBOUNCE_ETH_E_MULTIPLECOLLISION: time-failed-threshold=0.01, time-passed-threshold=0.01
        ALGO_ETH_E_OVERSIZEFRAME
          debounce-algorithm:
            diag event debounce time based ALGO_DEBOUNCE_ETH_E_OVERSIZEFRAME: time-failed-threshold=0.01, time-passed-threshold=0.01
        ALGO_ETH_E_RX_FRAMES_LOST
          debounce-algorithm:
            diag event debounce time based ALGO_DEBOUNCE_ETH_E_RX_FRAMES_LOST: time-failed-threshold=0.01, time-passed-threshold=0.01
        ALGO_ETH_E_SINGLECOLLISION
          debounce-algorithm:
            diag event debounce time based ALGO_DEBOUNCE_ETH_E_SINGLECOLLISION: time-failed-threshold=0.01, time-passed-threshold=0.01
        ALGO_ETH_E_TIMEOUT
          debounce-algorithm:
            diag event debounce time based ALGO_DEBOUNCE_ETH_E_TIMEOUT: time-failed-threshold=0.01, time-passed-threshold=0.01
        ALGO_ETH_E_UNDERSIZEFRAME
          debounce-algorithm:
            diag event debounce time based ALGO_DEBOUNCE_ETH_E_UNDERSIZEFRAME: time-failed-threshold=0.01, time-passed-threshold=0.01
        ALGO_FEE_E_GC_ERASE
          debounce-algorithm:
            diag event debounce time based ALGO_DEBOUNCE_FEE_E_GC_ERASE: time-failed-threshold=0.01, time-passed-threshold=0.01
        ALGO_FEE_E_GC_INIT
          debounce-algorithm:
            diag event debounce time based ALGO_DEBOUNCE_FEE_E_GC_INIT: time-failed-threshold=0.01, time-passed-threshold=0.01
        ALGO_FEE_E_GC_READ
          debounce-algorithm:
            diag event debounce time based ALGO_DEBOUNCE_FEE_E_GC_READ: time-failed-threshold=0.01, time-passed-threshold=0.01
        ALGO_FEE_E_GC_TRIG
          debounce-algorithm:
            diag event debounce time based ALGO_DEBOUNCE_FEE_E_GC_TRIG: time-failed-threshold=0.01, time-passed-threshold=0.01
        ALGO_FEE_E_GC_WRITE
          debounce-algorithm:
            diag event debounce time based ALGO_DEBOUNCE_FEE_E_GC_WRITE: time-failed-threshold=0.01, time-passed-threshold=0.01
        ALGO_FEE_E_INVALIDATE
          debounce-algorithm:
            diag event debounce time based ALGO_DEBOUNCE_FEE_E_INVALIDATE: time-failed-threshold=0.01, time-passed-threshold=0.01
        ALGO_FEE_E_READ
          debounce-algorithm:
            diag event debounce time based ALGO_DEBOUNCE_FEE_E_READ: time-failed-threshold=0.01, time-passed-threshold=0.01
        ALGO_FEE_E_UNCONFIG_BLK_EXCEEDED
          debounce-algorithm:
            diag event debounce time based ALGO_DEBOUNCE_FEE_E_UNCONFIG_BLK_EXCEEDED: time-failed-threshold=0.01, time-passed-threshold=0.01
        ALGO_FEE_E_WRITE
          debounce-algorithm:
            diag event debounce time based ALGO_DEBOUNCE_FEE_E_WRITE: time-failed-threshold=0.01, time-passed-threshold=0.01
        ALGO_FEE_E_WRITE_CYCLES_EXHAUSTED
          debounce-algorithm:
            diag event debounce time based ALGO_DEBOUNCE_FEE_E_WRITE_CYCLES_EXHAUSTED: time-failed-threshold=0.01, time-passed-threshold=0.01
        ALGO_FLS_E_COMPARE_FAILED
          debounce-algorithm:
            diag event debounce time based ALGO_DEBOUNCE_FLS_E_COMPARE_FAILED: time-failed-threshold=0.01, time-passed-threshold=0.01
        ALGO_FLS_E_ERASE_FAILED
          debounce-algorithm:
            diag event debounce time based ALGO_DEBOUNCE_FLS_E_ERASE_FAILED: time-failed-threshold=0.01, time-passed-threshold=0.01
        ALGO_FLS_E_READ_FAILED
          debounce-algorithm:
            diag event debounce time based ALGO_DEBOUNCE_FLS_E_READ_FAILED: time-failed-threshold=0.01, time-passed-threshold=0.01
        ALGO_FLS_E_UNEXPECTED_FLASH_ID
          debounce-algorithm:
            diag event debounce time based ALGO_DEBOUNCE_FLS_E_UNEXPECTED_FLASH_ID: time-failed-threshold=0.01, time-passed-threshold=0.01
        ALGO_FLS_E_WRITE_FAILED
          debounce-algorithm:
            diag event debounce time based ALGO_DEBOUNCE_FLS_E_WRITE_FAILED: time-failed-threshold=0.01, time-passed-threshold=0.01
        ALGO_LIN_E_TIMEOUT
          debounce-algorithm:
            diag event debounce time based ALGO_DEBOUNCE_LIN_E_TIMEOUT: time-failed-threshold=0.01, time-passed-threshold=0.01
        ALGO_MCU_E_CCU6_CLC_DISABLE_ERR
          debounce-algorithm:
            diag event debounce time based ALGO_DEBOUNCE_MCU_E_CCU6_CLC_DISABLE_ERR: time-failed-threshold=0.01, time-passed-threshold=0.01
        ALGO_MCU_E_CCU6_CLC_ENABLE_ERR
          debounce-algorithm:
            diag event debounce time based ALGO_DEBOUNCE_MCU_E_CCU6_CLC_ENABLE_ERR: time-failed-threshold=0.01, time-passed-threshold=0.01
        ALGO_MCU_E_CCUCON_UPDATE_ERR
          debounce-algorithm:
            diag event debounce time based ALGO_DEBOUNCE_MCU_E_CCUCON_UPDATE_ERR: time-failed-threshold=0.01, time-passed-threshold=0.01
        ALGO_MCU_E_CLOCK_FAILURE
          debounce-algorithm:
            diag event debounce time based ALGO_DEBOUNCE_MCU_E_CLOCK_FAILURE: time-failed-threshold=0.01, time-passed-threshold=0.01
        ALGO_MCU_E_CONVCTRL_CLC_DISABLE_ERR
          debounce-algorithm:
            diag event debounce time based ALGO_DEBOUNCE_MCU_E_CONVCTRL_CLC_DISABLE_ERR: time-failed-threshold=0.01, time-passed-threshold=0.01
        ALGO_MCU_E_CONVCTRL_CLC_ENABLE_ERR
          debounce-algorithm:
            diag event debounce time based ALGO_DEBOUNCE_MCU_E_CONVCTRL_CLC_ENABLE_ERR: time-failed-threshold=0.01, time-passed-threshold=0.01
        ALGO_MCU_E_GPT12_CLC_DISABLE_ERR
          debounce-algorithm:
            diag event debounce time based ALGO_DEBOUNCE_MCU_E_GPT12_CLC_DISABLE_ERR: time-failed-threshold=0.01, time-passed-threshold=0.01
        ALGO_MCU_E_GPT12_CLC_ENABLE_ERR
          debounce-algorithm:
            diag event debounce time based ALGO_DEBOUNCE_MCU_E_GPT12_CLC_ENABLE_ERR: time-failed-threshold=0.01, time-passed-threshold=0.01
        ALGO_MCU_E_GTM_CLC_DISABLE_ERR
          debounce-algorithm:
            diag event debounce time based ALGO_DEBOUNCE_MCU_E_GTM_CLC_DISABLE_ERR: time-failed-threshold=0.01, time-passed-threshold=0.01
        ALGO_MCU_E_GTM_CLC_ENABLE_ERR
          debounce-algorithm:
            diag event debounce time based ALGO_DEBOUNCE_MCU_E_GTM_CLC_ENABLE_ERR: time-failed-threshold=0.01, time-passed-threshold=0.01
        ALGO_MCU_E_OSC_FAILURE
          debounce-algorithm:
            diag event debounce time based ALGO_DEBOUNCE_MCU_E_OSC_FAILURE: time-failed-threshold=0.01, time-passed-threshold=0.01
        ALGO_MCU_E_PERIPHERAL_PLL_LOCK_LOSS
          debounce-algorithm:
            diag event debounce time based ALGO_DEBOUNCE_MCU_E_PERIPHERAL_PLL_LOCK_LOSS: time-failed-threshold=0.01, time-passed-threshold=0.01
        ALGO_MCU_E_PERIPHERAL_PLL_TIMEOUT_ERR
          debounce-algorithm:
            diag event debounce time based ALGO_DEBOUNCE_MCU_E_PERIPHERAL_PLL_TIMEOUT_ERR: time-failed-threshold=0.01, time-passed-threshold=0.01
        ALGO_MCU_E_PMSWCR_UPDATE_ERR
          debounce-algorithm:
            diag event debounce time based ALGO_DEBOUNCE_MCU_E_PMSWCR_UPDATE_ERR: time-failed-threshold=0.01, time-passed-threshold=0.01
        ALGO_MCU_E_SYSTEM_PLL_LOCK_LOSS
          debounce-algorithm:
            diag event debounce time based ALGO_DEBOUNCE_MCU_E_SYSTEM_PLL_LOCK_LOSS: time-failed-threshold=0.01, time-passed-threshold=0.01
        ALGO_MCU_E_SYSTEM_PLL_TIMEOUT_ERR
          debounce-algorithm:
            diag event debounce time based ALGO_DEBOUNCE_MCU_E_SYSTEM_PLL_TIMEOUT_ERR: time-failed-threshold=0.01, time-passed-threshold=0.01
        ALGO_SPI_E_HARDWARE_ERROR
          debounce-algorithm:
            diag event debounce time based ALGO_DEBOUNCE_SPI_E_HARDWARE_ERROR: time-failed-threshold=0.01, time-passed-threshold=0.01
        ALGO_WDGM_E_DATA_CORRUPTION
          debounce-algorithm:
            diag event debounce time based ALGO_DEBOUNCE_WDGM_E_DATA_CORRUPTION: time-failed-threshold=0.01, time-passed-threshold=0.01
        ALGO_WDGM_E_MONITORING
          debounce-algorithm:
            diag event debounce time based ALGO_DEBOUNCE_WDGM_E_MONITORING: time-failed-threshold=0.01, time-passed-threshold=0.01
        ALGO_WDGM_E_SET_MODE
          debounce-algorithm:
            diag event debounce time based ALGO_DEBOUNCE_WDGM_E_SET_MODE: time-failed-threshold=0.01, time-passed-threshold=0.01
    elements:
      AdcClcFailureNotification
      DTC_2_ALGO_AdcClcFailureNotification_Mapping
      AdcClcFailureNotificationToEnableCondGroupMapping
      AdcClcFailureNotificationToOpCycleMapping
      AdcClcFailureNotificationToStorageCondGroupMapping
      AdcConvStopTimeNotification
      DTC_2_ALGO_AdcConvStopTimeNotification_Mapping
      AdcConvStopTimeNotificationToEnableCondGroupMapping
      AdcConvStopTimeNotificationToOpCycleMapping
      AdcConvStopTimeNotificationToStorageCondGroupMapping
      CANSM_E_BUS_OFF_0
      DTC_2_ALGO_CANSM_E_BUS_OFF_0_Mapping
      CANSM_E_BUS_OFF_0ToEnableCondGroupMapping
      CANSM_E_BUS_OFF_0ToOpCycleMapping
      CANSM_E_BUS_OFF_0ToStorageCondGroupMapping
      CANSM_E_BUS_OFF_1
      DTC_2_ALGO_CANSM_E_BUS_OFF_1_Mapping
      CANSM_E_BUS_OFF_1ToEnableCondGroupMapping
      CANSM_E_BUS_OFF_1ToOpCycleMapping
      CANSM_E_BUS_OFF_1ToStorageCondGroupMapping
      CANSM_E_BUS_OFF_2
      DTC_2_ALGO_CANSM_E_BUS_OFF_2_Mapping
      CANSM_E_BUS_OFF_2ToEnableCondGroupMapping
      CANSM_E_BUS_OFF_2ToOpCycleMapping
      CANSM_E_BUS_OFF_2ToStorageCondGroupMapping
      CANSM_E_BUS_OFF_3
      DTC_2_ALGO_CANSM_E_BUS_OFF_3_Mapping
      CANSM_E_BUS_OFF_3ToEnableCondGroupMapping
      CANSM_E_BUS_OFF_3ToOpCycleMapping
      CANSM_E_BUS_OFF_3ToStorageCondGroupMapping
      CANSM_E_BUS_OFF_4
      DTC_2_ALGO_CANSM_E_BUS_OFF_4_Mapping
      CANSM_E_BUS_OFF_4ToEnableCondGroupMapping
      CANSM_E_BUS_OFF_4ToOpCycleMapping
      CANSM_E_BUS_OFF_4ToStorageCondGroupMapping
      CANSM_E_BUS_OFF_5
      DTC_2_ALGO_CANSM_E_BUS_OFF_5_Mapping
      CANSM_E_BUS_OFF_5ToEnableCondGroupMapping
      CANSM_E_BUS_OFF_5ToOpCycleMapping
      CANSM_E_BUS_OFF_5ToStorageCondGroupMapping
      CANSM_E_BUS_OFF_6
      DTC_2_ALGO_CANSM_E_BUS_OFF_6_Mapping
      CANSM_E_BUS_OFF_6ToEnableCondGroupMapping
      CANSM_E_BUS_OFF_6ToOpCycleMapping
      CANSM_E_BUS_OFF_6ToStorageCondGroupMapping
      CANSM_E_BUS_OFF_7
      DTC_2_ALGO_CANSM_E_BUS_OFF_7_Mapping
      CANSM_E_BUS_OFF_7ToEnableCondGroupMapping
      CANSM_E_BUS_OFF_7ToOpCycleMapping
      CANSM_E_BUS_OFF_7ToStorageCondGroupMapping
      CANSM_E_BUS_OFF_8
      DTC_2_ALGO_CANSM_E_BUS_OFF_8_Mapping
      CANSM_E_BUS_OFF_8ToEnableCondGroupMapping
      CANSM_E_BUS_OFF_8ToOpCycleMapping
      CANSM_E_BUS_OFF_8ToStorageCondGroupMapping
      CANSM_E_BUS_OFF_9
      DTC_2_ALGO_CANSM_E_BUS_OFF_9_Mapping
      CANSM_E_BUS_OFF_9ToEnableCondGroupMapping
      CANSM_E_BUS_OFF_9ToOpCycleMapping
      CANSM_E_BUS_OFF_9ToStorageCondGroupMapping
      CANSM_E_BUS_OFF_10
      DTC_2_ALGO_CANSM_E_BUS_OFF_10_Mapping
      CANSM_E_BUS_OFF_10ToEnableCondGroupMapping
      CANSM_E_BUS_OFF_10ToOpCycleMapping
      CANSM_E_BUS_OFF_10ToStorageCondGroupMapping
      CANSM_E_BUS_OFF_11
      DTC_2_ALGO_CANSM_E_BUS_OFF_11_Mapping
      CANSM_E_BUS_OFF_11ToEnableCondGroupMapping
      CANSM_E_BUS_OFF_11ToOpCycleMapping
      CANSM_E_BUS_OFF_11ToStorageCondGroupMapping
      CANSM_E_BUS_OFF_12
      DTC_2_ALGO_CANSM_E_BUS_OFF_12_Mapping
      CANSM_E_BUS_OFF_12ToEnableCondGroupMapping
      CANSM_E_BUS_OFF_12ToOpCycleMapping
      CANSM_E_BUS_OFF_12ToStorageCondGroupMapping
      CANSM_E_BUS_OFF_13
      DTC_2_ALGO_CANSM_E_BUS_OFF_13_Mapping
      CANSM_E_BUS_OFF_13ToEnableCondGroupMapping
      CANSM_E_BUS_OFF_13ToOpCycleMapping
      CANSM_E_BUS_OFF_13ToStorageCondGroupMapping
      CANSM_E_BUS_OFF_14
      DTC_2_ALGO_CANSM_E_BUS_OFF_14_Mapping
      CANSM_E_BUS_OFF_14ToEnableCondGroupMapping
      CANSM_E_BUS_OFF_14ToOpCycleMapping
      CANSM_E_BUS_OFF_14ToStorageCondGroupMapping
      CANSM_E_BUS_OFF_15
      DTC_2_ALGO_CANSM_E_BUS_OFF_15_Mapping
      CANSM_E_BUS_OFF_15ToEnableCondGroupMapping
      CANSM_E_BUS_OFF_15ToOpCycleMapping
      CANSM_E_BUS_OFF_15ToStorageCondGroupMapping
      CAN_E_TIMEOUT
      DTC_2_ALGO_CAN_E_TIMEOUT_Mapping
      CAN_E_TIMEOUTToEnableCondGroupMapping
      CAN_E_TIMEOUTToOpCycleMapping
      CAN_E_TIMEOUTToStorageCondGroupMapping
      ECUM_E_RAM_CHECK_FAILED
      DTC_2_ALGO_ECUM_E_RAM_CHECK_FAILED_Mapping
      ECUM_E_RAM_CHECK_FAILEDToEnableCondGroupMapping
      ECUM_E_RAM_CHECK_FAILEDToOpCycleMapping
      ECUM_E_RAM_CHECK_FAILEDToStorageCondGroupMapping
      ETH_E_ACCESS
      DTC_2_ALGO_ETH_E_ACCESS_Mapping
      ETH_E_ACCESSToEnableCondGroupMapping
      ETH_E_ACCESSToOpCycleMapping
      ETH_E_ACCESSToStorageCondGroupMapping
      ETH_E_ALIGNMENT
      DTC_2_ALGO_ETH_E_ALIGNMENT_Mapping
      ETH_E_ALIGNMENTToEnableCondGroupMapping
      ETH_E_ALIGNMENTToOpCycleMapping
      ETH_E_ALIGNMENTToStorageCondGroupMapping
      ETH_E_CRC
      DTC_2_ALGO_ETH_E_CRC_Mapping
      ETH_E_CRCToEnableCondGroupMapping
      ETH_E_CRCToOpCycleMapping
      ETH_E_CRCToStorageCondGroupMapping
      ETH_E_FRAMESEQ
      DTC_2_ALGO_ETH_E_FRAMESEQ_Mapping
      ETH_E_FRAMESEQToEnableCondGroupMapping
      ETH_E_FRAMESEQToOpCycleMapping
      ETH_E_FRAMESEQToStorageCondGroupMapping
      ETH_E_MULTIPLECOLLISION
      DTC_2_ALGO_ETH_E_MULTIPLECOLLISION_Mapping
      ETH_E_MULTIPLECOLLISIONToEnableCondGroupMapping
      ETH_E_MULTIPLECOLLISIONToOpCycleMapping
      ETH_E_MULTIPLECOLLISIONToStorageCondGroupMapping
      ETH_E_LATECOLLISION
      DTC_2_ALGO_ETH_E_LATECOLLISION_Mapping
      ETH_E_LATECOLLISIONToEnableCondGroupMapping
      ETH_E_LATECOLLISIONToOpCycleMapping
      ETH_E_LATECOLLISIONToStorageCondGroupMapping
      ETH_E_OVERSIZEFRAME
      DTC_2_ALGO_ETH_E_OVERSIZEFRAME_Mapping
      ETH_E_OVERSIZEFRAMEToEnableCondGroupMapping
      ETH_E_OVERSIZEFRAMEToOpCycleMapping
      ETH_E_OVERSIZEFRAMEToStorageCondGroupMapping
      ETH_E_RX_FRAMES_LOST
      DTC_2_ALGO_ETH_E_RX_FRAMES_LOST_Mapping
      ETH_E_RX_FRAMES_LOSTToEnableCondGroupMapping
      ETH_E_RX_FRAMES_LOSTToOpCycleMapping
      ETH_E_RX_FRAMES_LOSTToStorageCondGroupMapping
      ETH_E_TIMEOUT
      DTC_2_ALGO_ETH_E_TIMEOUT_Mapping
      ETH_E_TIMEOUTToEnableCondGroupMapping
      ETH_E_TIMEOUTToOpCycleMapping
      ETH_E_TIMEOUTToStorageCondGroupMapping
      ETH_E_UNDERSIZEFRAME
      DTC_2_ALGO_ETH_E_UNDERSIZEFRAME_Mapping
      ETH_E_UNDERSIZEFRAMEToEnableCondGroupMapping
      ETH_E_UNDERSIZEFRAMEToOpCycleMapping
      ETH_E_UNDERSIZEFRAMEToStorageCondGroupMapping
      ETH_E_SINGLECOLLISION
      DTC_2_ALGO_ETH_E_SINGLECOLLISION_Mapping
      ETH_E_SINGLECOLLISIONToEnableCondGroupMapping
      ETH_E_SINGLECOLLISIONToOpCycleMapping
      ETH_E_SINGLECOLLISIONToStorageCondGroupMapping
      FEE_E_GC_ERASE
      DTC_2_ALGO_FEE_E_GC_ERASE_Mapping
      FEE_E_GC_ERASEToEnableCondGroupMapping
      FEE_E_GC_ERASEToOpCycleMapping
      FEE_E_GC_ERASEToStorageCondGroupMapping
      FEE_E_GC_INIT
      DTC_2_ALGO_FEE_E_GC_INIT_Mapping
      FEE_E_GC_INITToEnableCondGroupMapping
      FEE_E_GC_INITToOpCycleMapping
      FEE_E_GC_INITToStorageCondGroupMapping
      FEE_E_GC_READ
      DTC_2_ALGO_FEE_E_GC_READ_Mapping
      FEE_E_GC_READToEnableCondGroupMapping
      FEE_E_GC_READToOpCycleMapping
      FEE_E_GC_READToStorageCondGroupMapping
      FEE_E_GC_TRIG
      DTC_2_ALGO_FEE_E_GC_TRIG_Mapping
      FEE_E_GC_TRIGToEnableCondGroupMapping
      FEE_E_GC_TRIGToOpCycleMapping
      FEE_E_GC_TRIGToStorageCondGroupMapping
      FEE_E_GC_WRITE
      DTC_2_ALGO_FEE_E_GC_WRITE_Mapping
      FEE_E_GC_WRITEToEnableCondGroupMapping
      FEE_E_GC_WRITEToOpCycleMapping
      FEE_E_GC_WRITEToStorageCondGroupMapping
      FEE_E_INVALIDATE
      DTC_2_ALGO_FEE_E_INVALIDATE_Mapping
      FEE_E_INVALIDATEToEnableCondGroupMapping
      FEE_E_INVALIDATEToOpCycleMapping
      FEE_E_INVALIDATEToStorageCondGroupMapping
      FEE_E_READ
      DTC_2_ALGO_FEE_E_READ_Mapping
      FEE_E_READToEnableCondGroupMapping
      FEE_E_READToOpCycleMapping
      FEE_E_READToStorageCondGroupMapping
      FEE_E_UNCONFIG_BLK_EXCEEDED
      DTC_2_ALGO_FEE_E_UNCONFIG_BLK_EXCEEDED_Mapping
      FEE_E_UNCONFIG_BLK_EXCEEDEDToEnableCondGroupMapping
      FEE_E_UNCONFIG_BLK_EXCEEDEDToOpCycleMapping
      FEE_E_UNCONFIG_BLK_EXCEEDEDToStorageCondGroupMapping
      FEE_E_WRITE
      DTC_2_ALGO_FEE_E_WRITE_Mapping
      FEE_E_WRITEToEnableCondGroupMapping
      FEE_E_WRITEToOpCycleMapping
      FEE_E_WRITEToStorageCondGroupMapping
      FEE_E_WRITE_CYCLES_EXHAUSTED
      DTC_2_ALGO_FEE_E_WRITE_CYCLES_EXHAUSTED_Mapping
      FEE_E_WRITE_CYCLES_EXHAUSTEDToEnableCondGroupMapping
      FEE_E_WRITE_CYCLES_EXHAUSTEDToOpCycleMapping
      FEE_E_WRITE_CYCLES_EXHAUSTEDToStorageCondGroupMapping
      FLS_E_COMPARE_FAILED
      DTC_2_ALGO_FLS_E_COMPARE_FAILED_Mapping
      FLS_E_COMPARE_FAILEDToEnableCondGroupMapping
      FLS_E_COMPARE_FAILEDToOpCycleMapping
      FLS_E_COMPARE_FAILEDToStorageCondGroupMapping
      FLS_E_ERASE_FAILED
      DTC_2_ALGO_FLS_E_ERASE_FAILED_Mapping
      FLS_E_ERASE_FAILEDToEnableCondGroupMapping
      FLS_E_ERASE_FAILEDToOpCycleMapping
      FLS_E_ERASE_FAILEDToStorageCondGroupMapping
      FLS_E_READ_FAILED
      DTC_2_ALGO_FLS_E_READ_FAILED_Mapping
      FLS_E_READ_FAILEDToEnableCondGroupMapping
      FLS_E_READ_FAILEDToOpCycleMapping
      FLS_E_READ_FAILEDToStorageCondGroupMapping
      FLS_E_UNEXPECTED_FLASH_ID
      DTC_2_ALGO_FLS_E_UNEXPECTED_FLASH_ID_Mapping
      FLS_E_UNEXPECTED_FLASH_IDToEnableCondGroupMapping
      FLS_E_UNEXPECTED_FLASH_IDToOpCycleMapping
      FLS_E_UNEXPECTED_FLASH_IDToStorageCondGroupMapping
      FLS_E_WRITE_FAILED
      DTC_2_ALGO_FLS_E_WRITE_FAILED_Mapping
      FLS_E_WRITE_FAILEDToEnableCondGroupMapping
      FLS_E_WRITE_FAILEDToOpCycleMapping
      FLS_E_WRITE_FAILEDToStorageCondGroupMapping
      LIN_E_TIMEOUT
      DTC_2_ALGO_LIN_E_TIMEOUT_Mapping
      LIN_E_TIMEOUTToEnableCondGroupMapping
      LIN_E_TIMEOUTToOpCycleMapping
      LIN_E_TIMEOUTToStorageCondGroupMapping
      MCU_E_CCUCON_UPDATE_ERR
      DTC_2_ALGO_MCU_E_CCUCON_UPDATE_ERR_Mapping
      MCU_E_CCUCON_UPDATE_ERRToEnableCondGroupMapping
      MCU_E_CCUCON_UPDATE_ERRToOpCycleMapping
      MCU_E_CCUCON_UPDATE_ERRToStorageCondGroupMapping
      MCU_E_CLOCK_FAILURE
      DTC_2_ALGO_MCU_E_CLOCK_FAILURE_Mapping
      MCU_E_CLOCK_FAILUREToEnableCondGroupMapping
      MCU_E_CLOCK_FAILUREToOpCycleMapping
      MCU_E_CLOCK_FAILUREToStorageCondGroupMapping
      MCU_E_CONVCTRL_CLC_ENABLE_ERR
      DTC_2_ALGO_MCU_E_CONVCTRL_CLC_ENABLE_ERR_Mapping
      MCU_E_CONVCTRL_CLC_ENABLE_ERRToEnableCondGroupMapping
      MCU_E_CONVCTRL_CLC_ENABLE_ERRToOpCycleMapping
      MCU_E_CONVCTRL_CLC_ENABLE_ERRToStorageCondGroupMapping
      MCU_E_GTM_CLC_DISABLE_ERR
      DTC_2_ALGO_MCU_E_GTM_CLC_DISABLE_ERR_Mapping
      MCU_E_GTM_CLC_DISABLE_ERRToEnableCondGroupMapping
      MCU_E_GTM_CLC_DISABLE_ERRToOpCycleMapping
      MCU_E_GTM_CLC_DISABLE_ERRToStorageCondGroupMapping
      MCU_E_GTM_CLC_ENABLE_ERR
      DTC_2_ALGO_MCU_E_GTM_CLC_ENABLE_ERR_Mapping
      MCU_E_GTM_CLC_ENABLE_ERRToEnableCondGroupMapping
      MCU_E_GTM_CLC_ENABLE_ERRToOpCycleMapping
      MCU_E_GTM_CLC_ENABLE_ERRToStorageCondGroupMapping
      MCU_E_OSC_FAILURE
      DTC_2_ALGO_MCU_E_OSC_FAILURE_Mapping
      MCU_E_OSC_FAILUREToEnableCondGroupMapping
      MCU_E_OSC_FAILUREToOpCycleMapping
      MCU_E_OSC_FAILUREToStorageCondGroupMapping
      MCU_E_PERIPHERAL_PLL_LOCK_LOSS
      DTC_2_ALGO_MCU_E_PERIPHERAL_PLL_LOCK_LOSS_Mapping
      MCU_E_PERIPHERAL_PLL_LOCK_LOSSToEnableCondGroupMapping
      MCU_E_PERIPHERAL_PLL_LOCK_LOSSToOpCycleMapping
      MCU_E_PERIPHERAL_PLL_LOCK_LOSSToStorageCondGroupMapping
      MCU_E_PERIPHERAL_PLL_TIMEOUT_ERR
      DTC_2_ALGO_MCU_E_PERIPHERAL_PLL_TIMEOUT_ERR_Mapping
      MCU_E_PERIPHERAL_PLL_TIMEOUT_ERRToEnableCondGroupMapping
      MCU_E_PERIPHERAL_PLL_TIMEOUT_ERRToOpCycleMapping
      MCU_E_PERIPHERAL_PLL_TIMEOUT_ERRToStorageCondGroupMapping
      MCU_E_SYSTEM_PLL_LOCK_LOSS
      DTC_2_ALGO_MCU_E_SYSTEM_PLL_LOCK_LOSS_Mapping
      MCU_E_SYSTEM_PLL_LOCK_LOSSToEnableCondGroupMapping
      MCU_E_SYSTEM_PLL_LOCK_LOSSToOpCycleMapping
      MCU_E_SYSTEM_PLL_LOCK_LOSSToStorageCondGroupMapping
      MCU_E_SYSTEM_PLL_TIMEOUT_ERR
      DTC_2_ALGO_MCU_E_SYSTEM_PLL_TIMEOUT_ERR_Mapping
      MCU_E_SYSTEM_PLL_TIMEOUT_ERRToEnableCondGroupMapping
      MCU_E_SYSTEM_PLL_TIMEOUT_ERRToOpCycleMapping
      MCU_E_SYSTEM_PLL_TIMEOUT_ERRToStorageCondGroupMapping
      MCU_E_CONVCTRL_CLC_DISABLE_ERR
      DTC_2_ALGO_MCU_E_CONVCTRL_CLC_DISABLE_ERR_Mapping
      MCU_E_CONVCTRL_CLC_DISABLE_ERRToEnableCondGroupMapping
      MCU_E_CONVCTRL_CLC_DISABLE_ERRToOpCycleMapping
      MCU_E_CONVCTRL_CLC_DISABLE_ERRToStorageCondGroupMapping
      MCU_E_GPT12_CLC_ENABLE_ERR
      DTC_2_ALGO_MCU_E_GPT12_CLC_ENABLE_ERR_Mapping
      MCU_E_GPT12_CLC_ENABLE_ERRToEnableCondGroupMapping
      MCU_E_GPT12_CLC_ENABLE_ERRToOpCycleMapping
      MCU_E_GPT12_CLC_ENABLE_ERRToStorageCondGroupMapping
      MCU_E_GPT12_CLC_DISABLE_ERR
      DTC_2_ALGO_MCU_E_GPT12_CLC_DISABLE_ERR_Mapping
      MCU_E_GPT12_CLC_DISABLE_ERRToEnableCondGroupMapping
      MCU_E_GPT12_CLC_DISABLE_ERRToOpCycleMapping
      MCU_E_GPT12_CLC_DISABLE_ERRToStorageCondGroupMapping
      MCU_E_CCU6_CLC_ENABLE_ERR
      DTC_2_ALGO_MCU_E_CCU6_CLC_ENABLE_ERR_Mapping
      MCU_E_CCU6_CLC_ENABLE_ERRToEnableCondGroupMapping
      MCU_E_CCU6_CLC_ENABLE_ERRToOpCycleMapping
      MCU_E_CCU6_CLC_ENABLE_ERRToStorageCondGroupMapping
      MCU_E_CCU6_CLC_DISABLE_ERR
      DTC_2_ALGO_MCU_E_CCU6_CLC_DISABLE_ERR_Mapping
      MCU_E_CCU6_CLC_DISABLE_ERRToEnableCondGroupMapping
      MCU_E_CCU6_CLC_DISABLE_ERRToOpCycleMapping
      MCU_E_CCU6_CLC_DISABLE_ERRToStorageCondGroupMapping
      MCU_E_PMSWCR_UPDATE_ERR
      DTC_2_ALGO_MCU_E_PMSWCR_UPDATE_ERR_Mapping
      MCU_E_PMSWCR_UPDATE_ERRToEnableCondGroupMapping
      MCU_E_PMSWCR_UPDATE_ERRToOpCycleMapping
      MCU_E_PMSWCR_UPDATE_ERRToStorageCondGroupMapping
      SPI_E_HARDWARE_ERROR
      DTC_2_ALGO_SPI_E_HARDWARE_ERROR_Mapping
      SPI_E_HARDWARE_ERRORToEnableCondGroupMapping
      SPI_E_HARDWARE_ERRORToOpCycleMapping
      SPI_E_HARDWARE_ERRORToStorageCondGroupMapping
      WDGM_E_DATA_CORRUPTION
      DTC_2_ALGO_WDGM_E_DATA_CORRUPTION_Mapping
      WDGM_E_DATA_CORRUPTIONToEnableCondGroupMapping
      WDGM_E_DATA_CORRUPTIONToOpCycleMapping
      WDGM_E_DATA_CORRUPTIONToStorageCondGroupMapping
      WDGM_E_MONITORING
      DTC_2_ALGO_WDGM_E_MONITORING_Mapping
      WDGM_E_MONITORINGToEnableCondGroupMapping
      WDGM_E_MONITORINGToOpCycleMapping
      WDGM_E_MONITORINGToStorageCondGroupMapping
      WDGM_E_SET_MODE
      DTC_2_ALGO_WDGM_E_SET_MODE_Mapping
      WDGM_E_SET_MODEToEnableCondGroupMapping
      WDGM_E_SET_MODEToOpCycleMapping
      WDGM_E_SET_MODEToStorageCondGroupMapping
      PrimaryMemory
      DEM_OPCYC_POWER
      EX_DATA_REC_SSP_EB_BSW
      DemEnableCondition_MASTER
      DemEnableCondition_CORE0_MonitoringASILB
      DemEnableCondition_CORE1_APPASILA
      DemEnableCondition_CORE1_APPASILB
      DemEnableCondition_CORE1_MonitoringASILB
      DemEnableConditionGroup_MASTER
      DemEnableConditionGroup_CORE0_MonitoringASILB
      DemEnableConditionGroup_CORE1_AppASILA
      DemEnableConditionGroup_CORE1_AppASILB
      DemEnableConditionGroup_CORE1_MonitoringASILB
      DemStorageCondition_MASTER
      DemStorageConditionGroup_MASTER
      DemStorageCondition_CORE0_MonitoringASILB
      DemStorageConditionGroup_CORE0_MonitoringASILB
      DemStorageCondition_CORE1_MonitoringASILB
      DemStorageConditionGroup_CORE1_MonitoringASILB
      DemStorageCondition_CORE1_APPASILB
      DemStorageConditionGroup_CORE1_APPASILB
      DemStorageCondition_CORE1_APPASILB
      DemStorageConditionGroup_CORE1_APPASILB
      DemStorageCondition_CORE1_APPASILA
      DemStorageConditionGroup_CORE1_APPASILA
  diagnostic event ECUM_E_RAM_CHECK_FAILED: aging-allowed=false, event-kind=BSW, prestorage-freeze-frame=false
    diagnostic connected indicator DiagConnectedIndicatorECUM_E_RAM_CHECK_FAILED: behavior=CONTINUOUS-ON-MODE, healing-cycle=DEM_OPCYC_POWER, indicator=DiagIndicator
  diagnostic event to enable condition group mapping ECUM_E_RAM_CHECK_FAILEDToEnableCondGroupMapping: diagnostic-event=ECUM_E_RAM_CHECK_FAILED, enable-condition-group=DemEnableConditionGroup_MASTER
  diagnostic event to operation cycle mapping ECUM_E_RAM_CHECK_FAILEDToOpCycleMapping: diagnostic-event=ECUM_E_RAM_CHECK_FAILED, operation-cycle=DEM_OPCYC_POWER
  diagnostic event to storage condition group mapping ECUM_E_RAM_CHECK_FAILEDToStorageCondGroupMapping: diagnostic-event=ECUM_E_RAM_CHECK_FAILED, storage-condition-group=DemStorageConditionGroup_MASTER
  diagnostic event ETH_E_ACCESS: aging-allowed=false, event-kind=BSW, prestorage-freeze-frame=false
    diagnostic connected indicator DiagConnectedIndicatorETH_E_ACCESS: behavior=CONTINUOUS-ON-MODE, healing-cycle=DEM_OPCYC_POWER, indicator=DiagIndicator
  diagnostic event to enable condition group mapping ETH_E_ACCESSToEnableCondGroupMapping: diagnostic-event=ETH_E_ACCESS, enable-condition-group=DemEnableConditionGroup_MASTER
  diagnostic event to operation cycle mapping ETH_E_ACCESSToOpCycleMapping: diagnostic-event=ETH_E_ACCESS, operation-cycle=DEM_OPCYC_POWER
  diagnostic event to storage condition group mapping ETH_E_ACCESSToStorageCondGroupMapping: diagnostic-event=ETH_E_ACCESS, storage-condition-group=DemStorageConditionGroup_MASTER
  diagnostic event ETH_E_ALIGNMENT: aging-allowed=false, event-kind=BSW, prestorage-freeze-frame=false
    diagnostic connected indicator DiagConnectedIndicatorETH_E_ALIGNMENT: behavior=CONTINUOUS-ON-MODE, healing-cycle=DEM_OPCYC_POWER, indicator=DiagIndicator
  diagnostic event to enable condition group mapping ETH_E_ALIGNMENTToEnableCondGroupMapping: diagnostic-event=ETH_E_ALIGNMENT, enable-condition-group=DemEnableConditionGroup_MASTER
  diagnostic event to operation cycle mapping ETH_E_ALIGNMENTToOpCycleMapping: diagnostic-event=ETH_E_ALIGNMENT, operation-cycle=DEM_OPCYC_POWER
  diagnostic event to storage condition group mapping ETH_E_ALIGNMENTToStorageCondGroupMapping: diagnostic-event=ETH_E_ALIGNMENT, storage-condition-group=DemStorageConditionGroup_MASTER
  diagnostic event ETH_E_CRC: aging-allowed=false, event-kind=BSW, prestorage-freeze-frame=false
    diagnostic connected indicator DiagConnectedIndicatorETH_E_CRC: behavior=CONTINUOUS-ON-MODE, healing-cycle=DEM_OPCYC_POWER, indicator=DiagIndicator
  diagnostic event to enable condition group mapping ETH_E_CRCToEnableCondGroupMapping: diagnostic-event=ETH_E_CRC, enable-condition-group=DemEnableConditionGroup_MASTER
  diagnostic event to operation cycle mapping ETH_E_CRCToOpCycleMapping: diagnostic-event=ETH_E_CRC, operation-cycle=DEM_OPCYC_POWER
  diagnostic event to storage condition group mapping ETH_E_CRCToStorageCondGroupMapping: diagnostic-event=ETH_E_CRC, storage-condition-group=DemStorageConditionGroup_MASTER
  diagnostic event ETH_E_FRAMESEQ: aging-allowed=false, event-kind=BSW, prestorage-freeze-frame=false
    diagnostic connected indicator DiagConnectedIndicatorETH_E_FRAMESEQ: behavior=CONTINUOUS-ON-MODE, healing-cycle=DEM_OPCYC_POWER, indicator=DiagIndicator
  diagnostic event to enable condition group mapping ETH_E_FRAMESEQToEnableCondGroupMapping: diagnostic-event=ETH_E_FRAMESEQ, enable-condition-group=DemEnableConditionGroup_MASTER
  diagnostic event to operation cycle mapping ETH_E_FRAMESEQToOpCycleMapping: diagnostic-event=ETH_E_FRAMESEQ, operation-cycle=DEM_OPCYC_POWER
  diagnostic event to storage condition group mapping ETH_E_FRAMESEQToStorageCondGroupMapping: diagnostic-event=ETH_E_FRAMESEQ, storage-condition-group=DemStorageConditionGroup_MASTER
  diagnostic event ETH_E_LATECOLLISION: aging-allowed=false, event-kind=BSW, prestorage-freeze-frame=false
    diagnostic connected indicator DiagConnectedIndicatorETH_E_LATECOLLISION: behavior=CONTINUOUS-ON-MODE, healing-cycle=DEM_OPCYC_POWER, indicator=DiagIndicator
  diagnostic event to enable condition group mapping ETH_E_LATECOLLISIONToEnableCondGroupMapping: diagnostic-event=ETH_E_LATECOLLISION, enable-condition-group=DemEnableConditionGroup_MASTER
  diagnostic event to operation cycle mapping ETH_E_LATECOLLISIONToOpCycleMapping: diagnostic-event=ETH_E_LATECOLLISION, operation-cycle=DEM_OPCYC_POWER
  diagnostic event to storage condition group mapping ETH_E_LATECOLLISIONToStorageCondGroupMapping: diagnostic-event=ETH_E_LATECOLLISION, storage-condition-group=DemStorageConditionGroup_MASTER
  diagnostic event ETH_E_MULTIPLECOLLISION: aging-allowed=false, event-kind=BSW, prestorage-freeze-frame=false
    diagnostic connected indicator DiagConnectedIndicatorETH_E_MULTIPLECOLLISION: behavior=CONTINUOUS-ON-MODE, healing-cycle=DEM_OPCYC_POWER, indicator=DiagIndicator
  diagnostic event to enable condition group mapping ETH_E_MULTIPLECOLLISIONToEnableCondGroupMapping: diagnostic-event=ETH_E_MULTIPLECOLLISION, enable-condition-group=DemEnableConditionGroup_MASTER
  diagnostic event to operation cycle mapping ETH_E_MULTIPLECOLLISIONToOpCycleMapping: diagnostic-event=ETH_E_MULTIPLECOLLISION, operation-cycle=DEM_OPCYC_POWER
  diagnostic event to storage condition group mapping ETH_E_MULTIPLECOLLISIONToStorageCondGroupMapping: diagnostic-event=ETH_E_MULTIPLECOLLISION, storage-condition-group=DemStorageConditionGroup_MASTER
  diagnostic event ETH_E_OVERSIZEFRAME: aging-allowed=false, event-kind=BSW, prestorage-freeze-frame=false
    diagnostic connected indicator DiagConnectedIndicatorETH_E_OVERSIZEFRAME: behavior=CONTINUOUS-ON-MODE, healing-cycle=DEM_OPCYC_POWER, indicator=DiagIndicator
  diagnostic event to enable condition group mapping ETH_E_OVERSIZEFRAMEToEnableCondGroupMapping: diagnostic-event=ETH_E_OVERSIZEFRAME, enable-condition-group=DemEnableConditionGroup_MASTER
  diagnostic event to operation cycle mapping ETH_E_OVERSIZEFRAMEToOpCycleMapping: diagnostic-event=ETH_E_OVERSIZEFRAME, operation-cycle=DEM_OPCYC_POWER
  diagnostic event to storage condition group mapping ETH_E_OVERSIZEFRAMEToStorageCondGroupMapping: diagnostic-event=ETH_E_OVERSIZEFRAME, storage-condition-group=DemStorageConditionGroup_MASTER
  diagnostic event ETH_E_RX_FRAMES_LOST: aging-allowed=false, event-kind=BSW, prestorage-freeze-frame=false
    diagnostic connected indicator DiagConnectedIndicatorETH_E_RX_FRAMES_LOST: behavior=CONTINUOUS-ON-MODE, healing-cycle=DEM_OPCYC_POWER, indicator=DiagIndicator
  diagnostic event to enable condition group mapping ETH_E_RX_FRAMES_LOSTToEnableCondGroupMapping: diagnostic-event=ETH_E_RX_FRAMES_LOST, enable-condition-group=DemEnableConditionGroup_MASTER
  diagnostic event to operation cycle mapping ETH_E_RX_FRAMES_LOSTToOpCycleMapping: diagnostic-event=ETH_E_RX_FRAMES_LOST, operation-cycle=DEM_OPCYC_POWER
  diagnostic event to storage condition group mapping ETH_E_RX_FRAMES_LOSTToStorageCondGroupMapping: diagnostic-event=ETH_E_RX_FRAMES_LOST, storage-condition-group=DemStorageConditionGroup_MASTER
  diagnostic event ETH_E_SINGLECOLLISION: aging-allowed=false, event-kind=BSW, prestorage-freeze-frame=false
    diagnostic connected indicator DiagConnectedIndicatorETH_E_SINGLECOLLISION: behavior=CONTINUOUS-ON-MODE, healing-cycle=DEM_OPCYC_POWER, indicator=DiagIndicator
  diagnostic event to enable condition group mapping ETH_E_SINGLECOLLISIONToEnableCondGroupMapping: diagnostic-event=ETH_E_SINGLECOLLISION, enable-condition-group=DemEnableConditionGroup_MASTER
  diagnostic event to operation cycle mapping ETH_E_SINGLECOLLISIONToOpCycleMapping: diagnostic-event=ETH_E_SINGLECOLLISION, operation-cycle=DEM_OPCYC_POWER
  diagnostic event to storage condition group mapping ETH_E_SINGLECOLLISIONToStorageCondGroupMapping: diagnostic-event=ETH_E_SINGLECOLLISION, storage-condition-group=DemStorageConditionGroup_MASTER
  diagnostic event ETH_E_TIMEOUT: aging-allowed=false, event-kind=BSW, prestorage-freeze-frame=false
    diagnostic connected indicator DiagConnectedIndicatorETH_E_TIMEOUT: behavior=CONTINUOUS-ON-MODE, healing-cycle=DEM_OPCYC_POWER, indicator=DiagIndicator
  diagnostic event to enable condition group mapping ETH_E_TIMEOUTToEnableCondGroupMapping: diagnostic-event=ETH_E_TIMEOUT, enable-condition-group=DemEnableConditionGroup_MASTER
  diagnostic event to operation cycle mapping ETH_E_TIMEOUTToOpCycleMapping: diagnostic-event=ETH_E_TIMEOUT, operation-cycle=DEM_OPCYC_POWER
  diagnostic event to storage condition group mapping ETH_E_TIMEOUTToStorageCondGroupMapping: diagnostic-event=ETH_E_TIMEOUT, storage-condition-group=DemStorageConditionGroup_MASTER
  diagnostic event ETH_E_UNDERSIZEFRAME: aging-allowed=false, event-kind=BSW, prestorage-freeze-frame=false
    diagnostic connected indicator DiagConnectedIndicatorETH_E_UNDERSIZEFRAME: behavior=CONTINUOUS-ON-MODE, healing-cycle=DEM_OPCYC_POWER, indicator=DiagIndicator
  diagnostic event to enable condition group mapping ETH_E_UNDERSIZEFRAMEToEnableCondGroupMapping: diagnostic-event=ETH_E_UNDERSIZEFRAME, enable-condition-group=DemEnableConditionGroup_MASTER
  diagnostic event to operation cycle mapping ETH_E_UNDERSIZEFRAMEToOpCycleMapping: diagnostic-event=ETH_E_UNDERSIZEFRAME, operation-cycle=DEM_OPCYC_POWER
  diagnostic event to storage condition group mapping ETH_E_UNDERSIZEFRAMEToStorageCondGroupMapping: diagnostic-event=ETH_E_UNDERSIZEFRAME, storage-condition-group=DemStorageConditionGroup_MASTER
  diagnostic extended data record EX_DATA_REC_SSP_EB_BSW: record-number=238, trigger=CONFIRMED, update=true
    diagnostic-parameter bit-offset=0:
      diagnostic data element Dde_SSP_EB_BSW: base-type=uint8, sw-bit-representation=number-of-bits=0, sw-value-block-size=0.0, sw-text-props={array-size-semantics=FIXED-SIZE, sw-max-text-size=1, sw-fill-character=0}
  diagnostic event FEE_E_GC_ERASE: aging-allowed=false, event-kind=BSW, prestorage-freeze-frame=false
    diagnostic connected indicator DiagConnectedIndicatorFEE_E_GC_ERASE: behavior=CONTINUOUS-ON-MODE, healing-cycle=DEM_OPCYC_POWER, indicator=DiagIndicator
  diagnostic event to enable condition group mapping FEE_E_GC_ERASEToEnableCondGroupMapping: diagnostic-event=FEE_E_GC_ERASE, enable-condition-group=DemEnableConditionGroup_MASTER
  diagnostic event to operation cycle mapping FEE_E_GC_ERASEToOpCycleMapping: diagnostic-event=FEE_E_GC_ERASE, operation-cycle=DEM_OPCYC_POWER
  diagnostic event to storage condition group mapping FEE_E_GC_ERASEToStorageCondGroupMapping: diagnostic-event=FEE_E_GC_ERASE, storage-condition-group=DemStorageConditionGroup_MASTER
  diagnostic event FEE_E_GC_INIT: aging-allowed=false, event-kind=BSW, prestorage-freeze-frame=false
    diagnostic connected indicator DiagConnectedIndicatorFEE_E_GC_INIT: behavior=CONTINUOUS-ON-MODE, healing-cycle=DEM_OPCYC_POWER, indicator=DiagIndicator
  diagnostic event to enable condition group mapping FEE_E_GC_INITToEnableCondGroupMapping: diagnostic-event=FEE_E_GC_INIT, enable-condition-group=DemEnableConditionGroup_MASTER
  diagnostic event to operation cycle mapping FEE_E_GC_INITToOpCycleMapping: diagnostic-event=FEE_E_GC_INIT, operation-cycle=DEM_OPCYC_POWER
  diagnostic event to storage condition group mapping FEE_E_GC_INITToStorageCondGroupMapping: diagnostic-event=FEE_E_GC_INIT, storage-condition-group=DemStorageConditionGroup_MASTER
  diagnostic event FEE_E_GC_READ: aging-allowed=false, event-kind=BSW, prestorage-freeze-frame=false
    diagnostic connected indicator DiagConnectedIndicatorFEE_E_GC_READ: behavior=CONTINUOUS-ON-MODE, healing-cycle=DEM_OPCYC_POWER, indicator=DiagIndicator
  diagnostic event to enable condition group mapping FEE_E_GC_READToEnableCondGroupMapping: diagnostic-event=FEE_E_GC_READ, enable-condition-group=DemEnableConditionGroup_MASTER
  diagnostic event to operation cycle mapping FEE_E_GC_READToOpCycleMapping: diagnostic-event=FEE_E_GC_READ, operation-cycle=DEM_OPCYC_POWER
  diagnostic event to storage condition group mapping FEE_E_GC_READToStorageCondGroupMapping: diagnostic-event=FEE_E_GC_READ, storage-condition-group=DemStorageConditionGroup_MASTER
  diagnostic event FEE_E_GC_TRIG: aging-allowed=false, event-kind=BSW, prestorage-freeze-frame=false
    diagnostic connected indicator DiagConnectedIndicatorFEE_E_GC_TRIG: behavior=CONTINUOUS-ON-MODE, healing-cycle=DEM_OPCYC_POWER, indicator=DiagIndicator
  diagnostic event to enable condition group mapping FEE_E_GC_TRIGToEnableCondGroupMapping: diagnostic-event=FEE_E_GC_TRIG, enable-condition-group=DemEnableConditionGroup_MASTER
  diagnostic event to operation cycle mapping FEE_E_GC_TRIGToOpCycleMapping: diagnostic-event=FEE_E_GC_TRIG, operation-cycle=DEM_OPCYC_POWER
  diagnostic event to storage condition group mapping FEE_E_GC_TRIGToStorageCondGroupMapping: diagnostic-event=FEE_E_GC_TRIG, storage-condition-group=DemStorageConditionGroup_MASTER
  diagnostic event FEE_E_GC_WRITE: aging-allowed=false, event-kind=BSW, prestorage-freeze-frame=false
    diagnostic connected indicator DiagConnectedIndicatorFEE_E_GC_WRITE: behavior=CONTINUOUS-ON-MODE, healing-cycle=DEM_OPCYC_POWER, indicator=DiagIndicator
  diagnostic event to enable condition group mapping FEE_E_GC_WRITEToEnableCondGroupMapping: diagnostic-event=FEE_E_GC_WRITE, enable-condition-group=DemEnableConditionGroup_MASTER
  diagnostic event to operation cycle mapping FEE_E_GC_WRITEToOpCycleMapping: diagnostic-event=FEE_E_GC_WRITE, operation-cycle=DEM_OPCYC_POWER
  diagnostic event to storage condition group mapping FEE_E_GC_WRITEToStorageCondGroupMapping: diagnostic-event=FEE_E_GC_WRITE, storage-condition-group=DemStorageConditionGroup_MASTER
  diagnostic event FEE_E_INVALIDATE: aging-allowed=false, event-kind=BSW, prestorage-freeze-frame=false
    diagnostic connected indicator DiagConnectedIndicatorFEE_E_INVALIDATE: behavior=CONTINUOUS-ON-MODE, healing-cycle=DEM_OPCYC_POWER, indicator=DiagIndicator
  diagnostic event to enable condition group mapping FEE_E_INVALIDATEToEnableCondGroupMapping: diagnostic-event=FEE_E_INVALIDATE, enable-condition-group=DemEnableConditionGroup_MASTER
  diagnostic event to operation cycle mapping FEE_E_INVALIDATEToOpCycleMapping: diagnostic-event=FEE_E_INVALIDATE, operation-cycle=DEM_OPCYC_POWER
  diagnostic event to storage condition group mapping FEE_E_INVALIDATEToStorageCondGroupMapping: diagnostic-event=FEE_E_INVALIDATE, storage-condition-group=DemStorageConditionGroup_MASTER
  diagnostic event FEE_E_READ: aging-allowed=false, event-kind=BSW, prestorage-freeze-frame=false
    diagnostic connected indicator DiagConnectedIndicatorFEE_E_READ: behavior=CONTINUOUS-ON-MODE, healing-cycle=DEM_OPCYC_POWER, indicator=DiagIndicator
  diagnostic event to enable condition group mapping FEE_E_READToEnableCondGroupMapping: diagnostic-event=FEE_E_READ, enable-condition-group=DemEnableConditionGroup_MASTER
  diagnostic event to operation cycle mapping FEE_E_READToOpCycleMapping: diagnostic-event=FEE_E_READ, operation-cycle=DEM_OPCYC_POWER
  diagnostic event to storage condition group mapping FEE_E_READToStorageCondGroupMapping: diagnostic-event=FEE_E_READ, storage-condition-group=DemStorageConditionGroup_MASTER
  diagnostic event FEE_E_UNCONFIG_BLK_EXCEEDED: aging-allowed=false, event-kind=BSW, prestorage-freeze-frame=false
    diagnostic connected indicator DiagConnectedIndicatorFEE_E_UNCONFIG_BLK_EXCEEDED: behavior=CONTINUOUS-ON-MODE, healing-cycle=DEM_OPCYC_POWER, indicator=DiagIndicator
  diagnostic event to enable condition group mapping FEE_E_UNCONFIG_BLK_EXCEEDEDToEnableCondGroupMapping: diagnostic-event=FEE_E_UNCONFIG_BLK_EXCEEDED, enable-condition-group=DemEnableConditionGroup_MASTER
  diagnostic event to operation cycle mapping FEE_E_UNCONFIG_BLK_EXCEEDEDToOpCycleMapping: diagnostic-event=FEE_E_UNCONFIG_BLK_EXCEEDED, operation-cycle=DEM_OPCYC_POWER
  diagnostic event to storage condition group mapping FEE_E_UNCONFIG_BLK_EXCEEDEDToStorageCondGroupMapping: diagnostic-event=FEE_E_UNCONFIG_BLK_EXCEEDED, storage-condition-group=DemStorageConditionGroup_MASTER
  diagnostic event FEE_E_WRITE: aging-allowed=false, event-kind=BSW, prestorage-freeze-frame=false
    diagnostic connected indicator DiagConnectedIndicatorFEE_E_WRITE: behavior=CONTINUOUS-ON-MODE, healing-cycle=DEM_OPCYC_POWER, indicator=DiagIndicator
  diagnostic event to enable condition group mapping FEE_E_WRITEToEnableCondGroupMapping: diagnostic-event=FEE_E_WRITE, enable-condition-group=DemEnableConditionGroup_MASTER
  diagnostic event to operation cycle mapping FEE_E_WRITEToOpCycleMapping: diagnostic-event=FEE_E_WRITE, operation-cycle=DEM_OPCYC_POWER
  diagnostic event to storage condition group mapping FEE_E_WRITEToStorageCondGroupMapping: diagnostic-event=FEE_E_WRITE, storage-condition-group=DemStorageConditionGroup_MASTER
  diagnostic event FEE_E_WRITE_CYCLES_EXHAUSTED: aging-allowed=false, event-kind=BSW, prestorage-freeze-frame=false
    diagnostic connected indicator DiagConnectedIndicatorFEE_E_WRITE_CYCLES_EXHAUSTED: behavior=CONTINUOUS-ON-MODE, healing-cycle=DEM_OPCYC_POWER, indicator=DiagIndicator
  diagnostic event to enable condition group mapping FEE_E_WRITE_CYCLES_EXHAUSTEDToEnableCondGroupMapping: diagnostic-event=FEE_E_WRITE_CYCLES_EXHAUSTED, enable-condition-group=DemEnableConditionGroup_MASTER
  diagnostic event to operation cycle mapping FEE_E_WRITE_CYCLES_EXHAUSTEDToOpCycleMapping: diagnostic-event=FEE_E_WRITE_CYCLES_EXHAUSTED, operation-cycle=DEM_OPCYC_POWER
  diagnostic event to storage condition group mapping FEE_E_WRITE_CYCLES_EXHAUSTEDToStorageCondGroupMapping: diagnostic-event=FEE_E_WRITE_CYCLES_EXHAUSTED, storage-condition-group=DemStorageConditionGroup_MASTER
  diagnostic event FLS_E_COMPARE_FAILED: aging-allowed=false, event-kind=BSW, prestorage-freeze-frame=false
    diagnostic connected indicator DiagConnectedIndicatorFLS_E_COMPARE_FAILED: behavior=CONTINUOUS-ON-MODE, healing-cycle=DEM_OPCYC_POWER, indicator=DiagIndicator
  diagnostic event to enable condition group mapping FLS_E_COMPARE_FAILEDToEnableCondGroupMapping: diagnostic-event=FLS_E_COMPARE_FAILED, enable-condition-group=DemEnableConditionGroup_MASTER
  diagnostic event to operation cycle mapping FLS_E_COMPARE_FAILEDToOpCycleMapping: diagnostic-event=FLS_E_COMPARE_FAILED, operation-cycle=DEM_OPCYC_POWER
  diagnostic event to storage condition group mapping FLS_E_COMPARE_FAILEDToStorageCondGroupMapping: diagnostic-event=FLS_E_COMPARE_FAILED, storage-condition-group=DemStorageConditionGroup_MASTER
  diagnostic event FLS_E_ERASE_FAILED: aging-allowed=false, event-kind=BSW, prestorage-freeze-frame=false
    diagnostic connected indicator DiagConnectedIndicatorFLS_E_ERASE_FAILED: behavior=CONTINUOUS-ON-MODE, healing-cycle=DEM_OPCYC_POWER, indicator=DiagIndicator
  diagnostic event to enable condition group mapping FLS_E_ERASE_FAILEDToEnableCondGroupMapping: diagnostic-event=FLS_E_ERASE_FAILED, enable-condition-group=DemEnableConditionGroup_MASTER
  diagnostic event to operation cycle mapping FLS_E_ERASE_FAILEDToOpCycleMapping: diagnostic-event=FLS_E_ERASE_FAILED, operation-cycle=DEM_OPCYC_POWER
  diagnostic event to storage condition group mapping FLS_E_ERASE_FAILEDToStorageCondGroupMapping: diagnostic-event=FLS_E_ERASE_FAILED, storage-condition-group=DemStorageConditionGroup_MASTER
  diagnostic event FLS_E_READ_FAILED: aging-allowed=false, event-kind=BSW, prestorage-freeze-frame=false
    diagnostic connected indicator DiagConnectedIndicatorFLS_E_READ_FAILED: behavior=CONTINUOUS-ON-MODE, healing-cycle=DEM_OPCYC_POWER, indicator=DiagIndicator
  diagnostic event to enable condition group mapping FLS_E_READ_FAILEDToEnableCondGroupMapping: diagnostic-event=FLS_E_READ_FAILED, enable-condition-group=DemEnableConditionGroup_MASTER
  diagnostic event to operation cycle mapping FLS_E_READ_FAILEDToOpCycleMapping: diagnostic-event=FLS_E_READ_FAILED, operation-cycle=DEM_OPCYC_POWER
  diagnostic event to storage condition group mapping FLS_E_READ_FAILEDToStorageCondGroupMapping: diagnostic-event=FLS_E_READ_FAILED, storage-condition-group=DemStorageConditionGroup_MASTER
  diagnostic event FLS_E_UNEXPECTED_FLASH_ID: aging-allowed=false, event-kind=BSW, prestorage-freeze-frame=false
    diagnostic connected indicator DiagConnectedIndicatorFLS_E_UNEXPECTED_FLASH_ID: behavior=CONTINUOUS-ON-MODE, healing-cycle=DEM_OPCYC_POWER, indicator=DiagIndicator
  diagnostic event to enable condition group mapping FLS_E_UNEXPECTED_FLASH_IDToEnableCondGroupMapping: diagnostic-event=FLS_E_UNEXPECTED_FLASH_ID, enable-condition-group=DemEnableConditionGroup_MASTER
  diagnostic event to operation cycle mapping FLS_E_UNEXPECTED_FLASH_IDToOpCycleMapping: diagnostic-event=FLS_E_UNEXPECTED_FLASH_ID, operation-cycle=DEM_OPCYC_POWER
  diagnostic event to storage condition group mapping FLS_E_UNEXPECTED_FLASH_IDToStorageCondGroupMapping: diagnostic-event=FLS_E_UNEXPECTED_FLASH_ID, storage-condition-group=DemStorageConditionGroup_MASTER
  diagnostic event FLS_E_WRITE_FAILED: aging-allowed=false, event-kind=BSW, prestorage-freeze-frame=false
    diagnostic connected indicator DiagConnectedIndicatorFLS_E_WRITE_FAILED: behavior=CONTINUOUS-ON-MODE, healing-cycle=DEM_OPCYC_POWER, indicator=DiagIndicator
  diagnostic event to enable condition group mapping FLS_E_WRITE_FAILEDToEnableCondGroupMapping: diagnostic-event=FLS_E_WRITE_FAILED, enable-condition-group=DemEnableConditionGroup_MASTER
  diagnostic event to operation cycle mapping FLS_E_WRITE_FAILEDToOpCycleMapping: diagnostic-event=FLS_E_WRITE_FAILED, operation-cycle=DEM_OPCYC_POWER
  diagnostic event to storage condition group mapping FLS_E_WRITE_FAILEDToStorageCondGroupMapping: diagnostic-event=FLS_E_WRITE_FAILED, storage-condition-group=DemStorageConditionGroup_MASTER
  diagnostic event LIN_E_TIMEOUT: aging-allowed=false, event-kind=BSW, prestorage-freeze-frame=false
    diagnostic connected indicator DiagConnectedIndicatorLIN_E_TIMEOUT: behavior=CONTINUOUS-ON-MODE, healing-cycle=DEM_OPCYC_POWER, indicator=DiagIndicator
  diagnostic event to enable condition group mapping LIN_E_TIMEOUTToEnableCondGroupMapping: diagnostic-event=LIN_E_TIMEOUT, enable-condition-group=DemEnableConditionGroup_MASTER
  diagnostic event to operation cycle mapping LIN_E_TIMEOUTToOpCycleMapping: diagnostic-event=LIN_E_TIMEOUT, operation-cycle=DEM_OPCYC_POWER
  diagnostic event to storage condition group mapping LIN_E_TIMEOUTToStorageCondGroupMapping: diagnostic-event=LIN_E_TIMEOUT, storage-condition-group=DemStorageConditionGroup_MASTER
  diagnostic event MCU_E_CCU6_CLC_DISABLE_ERR: aging-allowed=false, event-kind=BSW, prestorage-freeze-frame=false
    diagnostic connected indicator DiagConnectedIndicatorMCU_E_CCU6_CLC_DISABLE_ERR: behavior=CONTINUOUS-ON-MODE, healing-cycle=DEM_OPCYC_POWER, indicator=DiagIndicator
  diagnostic event to enable condition group mapping MCU_E_CCU6_CLC_DISABLE_ERRToEnableCondGroupMapping: diagnostic-event=MCU_E_CCU6_CLC_DISABLE_ERR, enable-condition-group=DemEnableConditionGroup_MASTER
  diagnostic event to operation cycle mapping MCU_E_CCU6_CLC_DISABLE_ERRToOpCycleMapping: diagnostic-event=MCU_E_CCU6_CLC_DISABLE_ERR, operation-cycle=DEM_OPCYC_POWER
  diagnostic event to storage condition group mapping MCU_E_CCU6_CLC_DISABLE_ERRToStorageCondGroupMapping: diagnostic-event=MCU_E_CCU6_CLC_DISABLE_ERR, storage-condition-group=DemStorageConditionGroup_MASTER
  diagnostic event MCU_E_CCU6_CLC_ENABLE_ERR: aging-allowed=false, event-kind=BSW, prestorage-freeze-frame=false
    diagnostic connected indicator DiagConnectedIndicatorMCU_E_CCU6_CLC_ENABLE_ERR: behavior=CONTINUOUS-ON-MODE, healing-cycle=DEM_OPCYC_POWER, indicator=DiagIndicator
  diagnostic event to enable condition group mapping MCU_E_CCU6_CLC_ENABLE_ERRToEnableCondGroupMapping: diagnostic-event=MCU_E_CCU6_CLC_ENABLE_ERR, enable-condition-group=DemEnableConditionGroup_MASTER
  diagnostic event to operation cycle mapping MCU_E_CCU6_CLC_ENABLE_ERRToOpCycleMapping: diagnostic-event=MCU_E_CCU6_CLC_ENABLE_ERR, operation-cycle=DEM_OPCYC_POWER
  diagnostic event to storage condition group mapping MCU_E_CCU6_CLC_ENABLE_ERRToStorageCondGroupMapping: diagnostic-event=MCU_E_CCU6_CLC_ENABLE_ERR, storage-condition-group=DemStorageConditionGroup_MASTER
  diagnostic event MCU_E_CCUCON_UPDATE_ERR: aging-allowed=false, event-kind=BSW, prestorage-freeze-frame=false
    diagnostic connected indicator DiagConnectedIndicatorMCU_E_CCUCON_UPDATE_ERR: behavior=CONTINUOUS-ON-MODE, healing-cycle=DEM_OPCYC_POWER, indicator=DiagIndicator
  diagnostic event to enable condition group mapping MCU_E_CCUCON_UPDATE_ERRToEnableCondGroupMapping: diagnostic-event=MCU_E_CCUCON_UPDATE_ERR, enable-condition-group=DemEnableConditionGroup_MASTER
  diagnostic event to operation cycle mapping MCU_E_CCUCON_UPDATE_ERRToOpCycleMapping: diagnostic-event=MCU_E_CCUCON_UPDATE_ERR, operation-cycle=DEM_OPCYC_POWER
  diagnostic event to storage condition group mapping MCU_E_CCUCON_UPDATE_ERRToStorageCondGroupMapping: diagnostic-event=MCU_E_CCUCON_UPDATE_ERR, storage-condition-group=DemStorageConditionGroup_MASTER
  diagnostic event MCU_E_CLOCK_FAILURE: aging-allowed=false, event-kind=BSW, prestorage-freeze-frame=false
    diagnostic connected indicator DiagConnectedIndicatorMCU_E_CLOCK_FAILURE: behavior=CONTINUOUS-ON-MODE, healing-cycle=DEM_OPCYC_POWER, indicator=DiagIndicator
  diagnostic event to enable condition group mapping MCU_E_CLOCK_FAILUREToEnableCondGroupMapping: diagnostic-event=MCU_E_CLOCK_FAILURE, enable-condition-group=DemEnableConditionGroup_MASTER
  diagnostic event to operation cycle mapping MCU_E_CLOCK_FAILUREToOpCycleMapping: diagnostic-event=MCU_E_CLOCK_FAILURE, operation-cycle=DEM_OPCYC_POWER
  diagnostic event to storage condition group mapping MCU_E_CLOCK_FAILUREToStorageCondGroupMapping: diagnostic-event=MCU_E_CLOCK_FAILURE, storage-condition-group=DemStorageConditionGroup_MASTER
  diagnostic event MCU_E_CONVCTRL_CLC_DISABLE_ERR: aging-allowed=false, event-kind=BSW, prestorage-freeze-frame=false
    diagnostic connected indicator DiagConnectedIndicatorMCU_E_CONVCTRL_CLC_DISABLE_ERR: behavior=CONTINUOUS-ON-MODE, healing-cycle=DEM_OPCYC_POWER, indicator=DiagIndicator
  diagnostic event to enable condition group mapping MCU_E_CONVCTRL_CLC_DISABLE_ERRToEnableCondGroupMapping: diagnostic-event=MCU_E_CONVCTRL_CLC_DISABLE_ERR, enable-condition-group=DemEnableConditionGroup_MASTER
  diagnostic event to operation cycle mapping MCU_E_CONVCTRL_CLC_DISABLE_ERRToOpCycleMapping: diagnostic-event=MCU_E_CONVCTRL_CLC_DISABLE_ERR, operation-cycle=DEM_OPCYC_POWER
  diagnostic event to storage condition group mapping MCU_E_CONVCTRL_CLC_DISABLE_ERRToStorageCondGroupMapping: diagnostic-event=MCU_E_CONVCTRL_CLC_DISABLE_ERR, storage-condition-group=DemStorageConditionGroup_MASTER
  diagnostic event MCU_E_CONVCTRL_CLC_ENABLE_ERR: aging-allowed=false, event-kind=BSW, prestorage-freeze-frame=false
    diagnostic connected indicator DiagConnectedIndicatorMCU_E_CONVCTRL_CLC_ENABLE_ERR: behavior=CONTINUOUS-ON-MODE, healing-cycle=DEM_OPCYC_POWER, indicator=DiagIndicator
  diagnostic event to enable condition group mapping MCU_E_CONVCTRL_CLC_ENABLE_ERRToEnableCondGroupMapping: diagnostic-event=MCU_E_CONVCTRL_CLC_ENABLE_ERR, enable-condition-group=DemEnableConditionGroup_MASTER
  diagnostic event to operation cycle mapping MCU_E_CONVCTRL_CLC_ENABLE_ERRToOpCycleMapping: diagnostic-event=MCU_E_CONVCTRL_CLC_ENABLE_ERR, operation-cycle=DEM_OPCYC_POWER
  diagnostic event to storage condition group mapping MCU_E_CONVCTRL_CLC_ENABLE_ERRToStorageCondGroupMapping: diagnostic-event=MCU_E_CONVCTRL_CLC_ENABLE_ERR, storage-condition-group=DemStorageConditionGroup_MASTER
  diagnostic event MCU_E_GPT12_CLC_DISABLE_ERR: aging-allowed=false, event-kind=BSW, prestorage-freeze-frame=false
    diagnostic connected indicator DiagConnectedIndicatorMCU_E_GPT12_CLC_DISABLE_ERR: behavior=CONTINUOUS-ON-MODE, healing-cycle=DEM_OPCYC_POWER, indicator=DiagIndicator
  diagnostic event to enable condition group mapping MCU_E_GPT12_CLC_DISABLE_ERRToEnableCondGroupMapping: diagnostic-event=MCU_E_GPT12_CLC_DISABLE_ERR, enable-condition-group=DemEnableConditionGroup_MASTER
  diagnostic event to operation cycle mapping MCU_E_GPT12_CLC_DISABLE_ERRToOpCycleMapping: diagnostic-event=MCU_E_GPT12_CLC_DISABLE_ERR, operation-cycle=DEM_OPCYC_POWER
  diagnostic event to storage condition group mapping MCU_E_GPT12_CLC_DISABLE_ERRToStorageCondGroupMapping: diagnostic-event=MCU_E_GPT12_CLC_DISABLE_ERR, storage-condition-group=DemStorageConditionGroup_MASTER
  diagnostic event MCU_E_GPT12_CLC_ENABLE_ERR: aging-allowed=false, event-kind=BSW, prestorage-freeze-frame=false
    diagnostic connected indicator DiagConnectedIndicatorMCU_E_GPT12_CLC_ENABLE_ERR: behavior=CONTINUOUS-ON-MODE, healing-cycle=DEM_OPCYC_POWER, indicator=DiagIndicator
  diagnostic event to enable condition group mapping MCU_E_GPT12_CLC_ENABLE_ERRToEnableCondGroupMapping: diagnostic-event=MCU_E_GPT12_CLC_ENABLE_ERR, enable-condition-group=DemEnableConditionGroup_MASTER
  diagnostic event to operation cycle mapping MCU_E_GPT12_CLC_ENABLE_ERRToOpCycleMapping: diagnostic-event=MCU_E_GPT12_CLC_ENABLE_ERR, operation-cycle=DEM_OPCYC_POWER
  diagnostic event to storage condition group mapping MCU_E_GPT12_CLC_ENABLE_ERRToStorageCondGroupMapping: diagnostic-event=MCU_E_GPT12_CLC_ENABLE_ERR, storage-condition-group=DemStorageConditionGroup_MASTER
  diagnostic event MCU_E_GTM_CLC_DISABLE_ERR: aging-allowed=false, event-kind=BSW, prestorage-freeze-frame=false
    diagnostic connected indicator DiagConnectedIndicatorMCU_E_GTM_CLC_DISABLE_ERR: behavior=CONTINUOUS-ON-MODE, healing-cycle=DEM_OPCYC_POWER, indicator=DiagIndicator
  diagnostic event to enable condition group mapping MCU_E_GTM_CLC_DISABLE_ERRToEnableCondGroupMapping: diagnostic-event=MCU_E_GTM_CLC_DISABLE_ERR, enable-condition-group=DemEnableConditionGroup_MASTER
  diagnostic event to operation cycle mapping MCU_E_GTM_CLC_DISABLE_ERRToOpCycleMapping: diagnostic-event=MCU_E_GTM_CLC_DISABLE_ERR, operation-cycle=DEM_OPCYC_POWER
  diagnostic event to storage condition group mapping MCU_E_GTM_CLC_DISABLE_ERRToStorageCondGroupMapping: diagnostic-event=MCU_E_GTM_CLC_DISABLE_ERR, storage-condition-group=DemStorageConditionGroup_MASTER
  diagnostic event MCU_E_GTM_CLC_ENABLE_ERR: aging-allowed=false, event-kind=BSW, prestorage-freeze-frame=false
    diagnostic connected indicator DiagConnectedIndicatorMCU_E_GTM_CLC_ENABLE_ERR: behavior=CONTINUOUS-ON-MODE, healing-cycle=DEM_OPCYC_POWER, indicator=DiagIndicator
  diagnostic event to enable condition group mapping MCU_E_GTM_CLC_ENABLE_ERRToEnableCondGroupMapping: diagnostic-event=MCU_E_GTM_CLC_ENABLE_ERR, enable-condition-group=DemEnableConditionGroup_MASTER
  diagnostic event to operation cycle mapping MCU_E_GTM_CLC_ENABLE_ERRToOpCycleMapping: diagnostic-event=MCU_E_GTM_CLC_ENABLE_ERR, operation-cycle=DEM_OPCYC_POWER
  diagnostic event to storage condition group mapping MCU_E_GTM_CLC_ENABLE_ERRToStorageCondGroupMapping: diagnostic-event=MCU_E_GTM_CLC_ENABLE_ERR, storage-condition-group=DemStorageConditionGroup_MASTER
  diagnostic event MCU_E_OSC_FAILURE: aging-allowed=false, event-kind=BSW, prestorage-freeze-frame=false
    diagnostic connected indicator DiagConnectedIndicatorMCU_E_OSC_FAILURE: behavior=CONTINUOUS-ON-MODE, healing-cycle=DEM_OPCYC_POWER, indicator=DiagIndicator
  diagnostic event to enable condition group mapping MCU_E_OSC_FAILUREToEnableCondGroupMapping: diagnostic-event=MCU_E_OSC_FAILURE, enable-condition-group=DemEnableConditionGroup_MASTER
  diagnostic event to operation cycle mapping MCU_E_OSC_FAILUREToOpCycleMapping: diagnostic-event=MCU_E_OSC_FAILURE, operation-cycle=DEM_OPCYC_POWER
  diagnostic event to storage condition group mapping MCU_E_OSC_FAILUREToStorageCondGroupMapping: diagnostic-event=MCU_E_OSC_FAILURE, storage-condition-group=DemStorageConditionGroup_MASTER
  diagnostic event MCU_E_PERIPHERAL_PLL_LOCK_LOSS: aging-allowed=false, event-kind=BSW, prestorage-freeze-frame=false
    diagnostic connected indicator DiagConnectedIndicatorMCU_E_PERIPHERAL_PLL_LOCK_LOSS: behavior=CONTINUOUS-ON-MODE, healing-cycle=DEM_OPCYC_POWER, indicator=DiagIndicator
  diagnostic event to enable condition group mapping MCU_E_PERIPHERAL_PLL_LOCK_LOSSToEnableCondGroupMapping: diagnostic-event=MCU_E_PERIPHERAL_PLL_LOCK_LOSS, enable-condition-group=DemEnableConditionGroup_MASTER
  diagnostic event to operation cycle mapping MCU_E_PERIPHERAL_PLL_LOCK_LOSSToOpCycleMapping: diagnostic-event=MCU_E_PERIPHERAL_PLL_LOCK_LOSS, operation-cycle=DEM_OPCYC_POWER
  diagnostic event to storage condition group mapping MCU_E_PERIPHERAL_PLL_LOCK_LOSSToStorageCondGroupMapping: diagnostic-event=MCU_E_PERIPHERAL_PLL_LOCK_LOSS, storage-condition-group=DemStorageConditionGroup_MASTER
  diagnostic event MCU_E_PERIPHERAL_PLL_TIMEOUT_ERR: aging-allowed=false, event-kind=BSW, prestorage-freeze-frame=false
    diagnostic connected indicator DiagConnectedIndicatorMCU_E_PERIPHERAL_PLL_TIMEOUT_ERR: behavior=CONTINUOUS-ON-MODE, healing-cycle=DEM_OPCYC_POWER, indicator=DiagIndicator
  diagnostic event to enable condition group mapping MCU_E_PERIPHERAL_PLL_TIMEOUT_ERRToEnableCondGroupMapping: diagnostic-event=MCU_E_PERIPHERAL_PLL_TIMEOUT_ERR, enable-condition-group=DemEnableConditionGroup_MASTER
  diagnostic event to operation cycle mapping MCU_E_PERIPHERAL_PLL_TIMEOUT_ERRToOpCycleMapping: diagnostic-event=MCU_E_PERIPHERAL_PLL_TIMEOUT_ERR, operation-cycle=DEM_OPCYC_POWER
  diagnostic event to storage condition group mapping MCU_E_PERIPHERAL_PLL_TIMEOUT_ERRToStorageCondGroupMapping: diagnostic-event=MCU_E_PERIPHERAL_PLL_TIMEOUT_ERR, storage-condition-group=DemStorageConditionGroup_MASTER
  diagnostic event MCU_E_PMSWCR_UPDATE_ERR: aging-allowed=false, event-kind=BSW, prestorage-freeze-frame=false
    diagnostic connected indicator DiagConnectedIndicatorMCU_E_PMSWCR_UPDATE_ERR: behavior=CONTINUOUS-ON-MODE, healing-cycle=DEM_OPCYC_POWER, indicator=DiagIndicator
  diagnostic event to enable condition group mapping MCU_E_PMSWCR_UPDATE_ERRToEnableCondGroupMapping: diagnostic-event=MCU_E_PMSWCR_UPDATE_ERR, enable-condition-group=DemEnableConditionGroup_MASTER
  diagnostic event to operation cycle mapping MCU_E_PMSWCR_UPDATE_ERRToOpCycleMapping: diagnostic-event=MCU_E_PMSWCR_UPDATE_ERR, operation-cycle=DEM_OPCYC_POWER
  diagnostic event to storage condition group mapping MCU_E_PMSWCR_UPDATE_ERRToStorageCondGroupMapping: diagnostic-event=MCU_E_PMSWCR_UPDATE_ERR, storage-condition-group=DemStorageConditionGroup_MASTER
  diagnostic event MCU_E_SYSTEM_PLL_LOCK_LOSS: aging-allowed=false, event-kind=BSW, prestorage-freeze-frame=false
    diagnostic connected indicator DiagConnectedIndicatorMCU_E_SYSTEM_PLL_LOCK_LOSS: behavior=CONTINUOUS-ON-MODE, healing-cycle=DEM_OPCYC_POWER, indicator=DiagIndicator
  diagnostic event to enable condition group mapping MCU_E_SYSTEM_PLL_LOCK_LOSSToEnableCondGroupMapping: diagnostic-event=MCU_E_SYSTEM_PLL_LOCK_LOSS, enable-condition-group=DemEnableConditionGroup_MASTER
  diagnostic event to operation cycle mapping MCU_E_SYSTEM_PLL_LOCK_LOSSToOpCycleMapping: diagnostic-event=MCU_E_SYSTEM_PLL_LOCK_LOSS, operation-cycle=DEM_OPCYC_POWER
  diagnostic event to storage condition group mapping MCU_E_SYSTEM_PLL_LOCK_LOSSToStorageCondGroupMapping: diagnostic-event=MCU_E_SYSTEM_PLL_LOCK_LOSS, storage-condition-group=DemStorageConditionGroup_MASTER
  diagnostic event MCU_E_SYSTEM_PLL_TIMEOUT_ERR: aging-allowed=false, event-kind=BSW, prestorage-freeze-frame=false
    diagnostic connected indicator DiagConnectedIndicatorMCU_E_SYSTEM_PLL_TIMEOUT_ERR: behavior=CONTINUOUS-ON-MODE, healing-cycle=DEM_OPCYC_POWER, indicator=DiagIndicator
  diagnostic event to enable condition group mapping MCU_E_SYSTEM_PLL_TIMEOUT_ERRToEnableCondGroupMapping: diagnostic-event=MCU_E_SYSTEM_PLL_TIMEOUT_ERR, enable-condition-group=DemEnableConditionGroup_MASTER
  diagnostic event to operation cycle mapping MCU_E_SYSTEM_PLL_TIMEOUT_ERRToOpCycleMapping: diagnostic-event=MCU_E_SYSTEM_PLL_TIMEOUT_ERR, operation-cycle=DEM_OPCYC_POWER
  diagnostic event to storage condition group mapping MCU_E_SYSTEM_PLL_TIMEOUT_ERRToStorageCondGroupMapping: diagnostic-event=MCU_E_SYSTEM_PLL_TIMEOUT_ERR, storage-condition-group=DemStorageConditionGroup_MASTER
  diagnostic event SPI_E_HARDWARE_ERROR: aging-allowed=false, event-kind=BSW, prestorage-freeze-frame=false
    diagnostic connected indicator DiagConnectedIndicatorSPI_E_HARDWARE_ERROR: behavior=CONTINUOUS-ON-MODE, healing-cycle=DEM_OPCYC_POWER, indicator=DiagIndicator
  diagnostic event to enable condition group mapping SPI_E_HARDWARE_ERRORToEnableCondGroupMapping: diagnostic-event=SPI_E_HARDWARE_ERROR, enable-condition-group=DemEnableConditionGroup_MASTER
  diagnostic event to operation cycle mapping SPI_E_HARDWARE_ERRORToOpCycleMapping: diagnostic-event=SPI_E_HARDWARE_ERROR, operation-cycle=DEM_OPCYC_POWER
  diagnostic event to storage condition group mapping SPI_E_HARDWARE_ERRORToStorageCondGroupMapping: diagnostic-event=SPI_E_HARDWARE_ERROR, storage-condition-group=DemStorageConditionGroup_MASTER
  diagnostic data identifier set SSP_EB_BSW_DidSet: data-identifier=DID_CONTEXTE_0xE812
  diagnostic trouble code props SSP_EB_BSW_Properties: aging=DaigAging, environment-capture-to-reporting=CAPTURE-SYNCHRONOUS-TO-REPORTING, extended-data-records=EX_DATA_REC_SSP_EB_BSW, freeze-frames=FreezeFrames_VSM_1, freeze-frame-content=SSP_EB_BSW_DidSet, immediate-nv-data-storage=false, max-number-freeze-frame-records=0, memory-destination=PrimaryMemory, priority=10, significance=FAULT
  diagnostic event WDGM_E_DATA_CORRUPTION: aging-allowed=false, event-kind=BSW, prestorage-freeze-frame=false
    diagnostic connected indicator DiagConnectedIndicatorWDGM_E_DATA_CORRUPTION: behavior=CONTINUOUS-ON-MODE, healing-cycle=DEM_OPCYC_POWER, indicator=DiagIndicator
  diagnostic event to enable condition group mapping WDGM_E_DATA_CORRUPTIONToEnableCondGroupMapping: diagnostic-event=WDGM_E_DATA_CORRUPTION, enable-condition-group=DemEnableConditionGroup_MASTER
  diagnostic event to operation cycle mapping WDGM_E_DATA_CORRUPTIONToOpCycleMapping: diagnostic-event=WDGM_E_DATA_CORRUPTION, operation-cycle=DEM_OPCYC_POWER
  diagnostic event to storage condition group mapping WDGM_E_DATA_CORRUPTIONToStorageCondGroupMapping: diagnostic-event=WDGM_E_DATA_CORRUPTION, storage-condition-group=DemStorageConditionGroup_MASTER
  diagnostic event WDGM_E_MONITORING: aging-allowed=false, event-kind=BSW, prestorage-freeze-frame=false
    diagnostic connected indicator DiagConnectedIndicatorWDGM_E_MONITORING: behavior=CONTINUOUS-ON-MODE, healing-cycle=DEM_OPCYC_POWER, indicator=DiagIndicator
  diagnostic event to enable condition group mapping WDGM_E_MONITORINGToEnableCondGroupMapping: diagnostic-event=WDGM_E_MONITORING, enable-condition-group=DemEnableConditionGroup_MASTER
  diagnostic event to operation cycle mapping WDGM_E_MONITORINGToOpCycleMapping: diagnostic-event=WDGM_E_MONITORING, operation-cycle=DEM_OPCYC_POWER
  diagnostic event to storage condition group mapping WDGM_E_MONITORINGToStorageCondGroupMapping: diagnostic-event=WDGM_E_MONITORING, storage-condition-group=DemStorageConditionGroup_MASTER
  diagnostic event WDGM_E_SET_MODE: aging-allowed=false, event-kind=BSW, prestorage-freeze-frame=false
    diagnostic connected indicator DiagConnectedIndicatorWDGM_E_SET_MODE: behavior=CONTINUOUS-ON-MODE, healing-cycle=DEM_OPCYC_POWER, indicator=DiagIndicator
  diagnostic event to enable condition group mapping WDGM_E_SET_MODEToEnableCondGroupMapping: diagnostic-event=WDGM_E_SET_MODE, enable-condition-group=DemEnableConditionGroup_MASTER
  diagnostic event to operation cycle mapping WDGM_E_SET_MODEToOpCycleMapping: diagnostic-event=WDGM_E_SET_MODE, operation-cycle=DEM_OPCYC_POWER
  diagnostic event to storage condition group mapping WDGM_E_SET_MODEToStorageCondGroupMapping: diagnostic-event=WDGM_E_SET_MODE, storage-condition-group=DemStorageConditionGroup_MASTER
