AUTOSAR XML (schema 4-2-2)
package /BswMMode/DataTypeMappingSets
  data type mapping set BswMModeMapping
    mode-request-type-maps:
      implementation-data-type=uint8, mode-group=BswMModeGroup
      implementation-data-type=uint8, mode-group=ValidationResult
      implementation-data-type=uint8, mode-group=GlobalEcuState
package /BswMMode/ModeDeclarationGroups
  mode declaration group BswMModeGroup: initial-mode=BSWM_STARTUP_TWO_A
    7 x mode:
      BSWM_GO_OFF_ONE_A
      BSWM_GO_SLEEP_ONE
      BSWM_PRP_SHUTDOWN
      BSWM_RUN_TWO
      BSWM_STARTUP_TWO_A
      BSWM_STARTUP_TWO_B
      BSWM_WAKEUP_TWO
  mode declaration group GlobalEcuState: initial-mode=ECU_STATE_STARTUP
    4 x mode:
      ECU_STATE_SHUTDOWN
      ECU_STATE_SLEEP
      ECU_STATE_STARTUP
      ECU_STATE_UP
  mode declaration group ValidationResult: initial-mode=VALIDATION_UNDEFINED
    mode VALIDATION_FAILED
    mode VALIDATION_SUCCEEDED
    mode VALIDATION_UNDEFINED
package /BswMMode/PortInterfaces
  mode switch interface BswMModeInterface: is-service=true
    mode group BswMMode: type=BswMModeGroup
  mode switch interface GlobalEcuStateInterface: is-service=true
    mode group GlobalEcuState: type=GlobalEcuState
  mode switch interface ValidationResultInterface: is-service=true
    mode group ValidationResult: type=ValidationResult
package /RootP_Mode
  mode switch interface AppModeInterface: is-service=true
    mode group AppMode: type=ApplicationModeGroup
  mode declaration group ApplicationModeGroup: initial-mode=APP_WAKEUP
    6 x mode:
      APP_CONFIG
      APP_OFF
      APP_ON
      APP_SYNC_INIT1
      APP_SYNC_INIT2
      APP_WAKEUP
  data type mapping set ApplicationModeMapping: mode-request-type-map{implementation-data-type=uint8, mode-group=ApplicationModeGroup}
