AUTOSAR XML (schema 4-0-3)
package /AUTOSAR_Dem/ImplementationDataTypes
  impl type Dem_DTCOriginType: compu {1=DEM_DTC_ORIGIN_PRIMARY_MEMORY, 2=DEM_DTC_ORIGIN_MIRROR_MEMORY, 3=DEM_DTC_ORIGIN_PERMANENT_MEMORY, 4=DEM_DTC_ORIGIN_SECONDARY_MEMORY}, range raw 1..4, implementation-data-type=uint8
  impl type Dem_DTCFormatType: compu {0=DEM_DTC_FORMAT_OBD, 1=DEM_DTC_FORMAT_UDS}, range raw 0..1, implementation-data-type=uint8
package /AUTOSAR_Dem/PortInterfaces
  client server interface DcmIf: is-service=true
    operation ClearDTC: possible-error=[DEM_CLEAR_WRONG_DTC, DEM_CLEAR_WRONG_DTCORIGIN, DEM_CLEAR_FAILED, DEM_CLEAR_PENDING]
      arg DTC: type=uint32, direction=IN
      arg DTCFormat: type=Dem_DTCFormatType, direction=IN
      arg DTCOrigin: type=Dem_DTCOriginType, direction=IN
    4 x error:
      DEM_CLEAR_WRONG_DTC: error-code=1
      DEM_CLEAR_WRONG_DTCORIGIN: error-code=2
      DEM_CLEAR_FAILED: error-code=3
      DEM_CLEAR_PENDING: error-code=4
