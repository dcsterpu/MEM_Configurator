AUTOSAR XML (schema 4-2-1)
package /RootP_DiagDesc
  diagnostic contribution set DiagContributionSet: category=DiagContributionSet
    elements:
      DIDG_APV
      DIDG_APV_Read
      DIDG_APV_Write
      DIDG_APV_List
      DIDG_APV_List_Read
      DIDG_CodeUce
      DIDG_CodeUce_Read
      DIDG_CodeUce_Write
      DIDG_CodeUce_List
      DIDG_CodeUce_List_Read
      DIDG_DCONF
      DIDG_DCONF_Read
      DIDG_DCONF_Write
      DIDG_DCONF_List
      DIDG_DCONF_List_Read
      DIDG_DCONF_SEC
      DIDG_DCONF_SEC_Read
      DIDG_DCONF_SEC_Write
      DIDG_DCONF_SEC_List
      DIDG_DCONF_SEC_List_Read
      DIDG_STD_ASSEMBLY_FACTORY
      DIDG_STD_ASSEMBLY_FACTORY_Read
      DIDG_STD_ASSEMBLY_FACTORY_List
      DIDG_STD_ASSEMBLY_FACTORY_List_Read
      DIDG_ETUDE
      DIDG_ETUDE_Read
      DIDG_ETUDE_List
      DIDG_ETUDE_List_Read
      DIDG_OLD
      DIDG_OLD_Read
      DIDG_OLD_List
      DIDG_OLD_List_Read
  diagnostic service table VSM_ServicesTable:
    diagnostic-connections=DiagConnectionDcm
    ecu-instance=VSM
    protocol-kind=DCM_UDS_ON_CAN
    service-instance=[DID_ContactFrein_Read, DID_DmdPushDemDiagFil_Read, DID_EntreePlusAPC_Read, DID_EntreePlusDEM_Read, DID_EtatBouclCeintAVD_Read, DID_EtatBouclCeintAVG_Read, DID_EtatBouclCeintRang2Centre_Read, DID_EtatBouclCeintRang2Droite_Read, DID_EtatBouclCeintRang2Gauche_Read, DID_EtatPresencePassAV_Read, DID_PARAMETRAGE_Read, DID_PARAMETRAGE_Write, DID_PresNonBouclePar2c_Read, DID_PresNonBouclePar2d_Read, DID_PresNonBouclePar2g_Read, DID_PushAlarme_Read, DID_PushDmdDemarrage_Read, DID_TensionModeSelector_Read, DID_VERR_CENTRALISE_Read, DID_EtatDmdEjectionTrappeCarb_Read, DID_PRESENCE_ETSR_Read, DID_PRESENCE_ETSR_Write, DID_VIT_ILV_FOR_PLV_Read, DID_NAV_POI_RADAR_Read, DID_NAV_POI_RADAR_Write, DID_OPT_ANTICIPATED_PLV_Read, DID_OPT_ANTICIPATED_PLV_Write, DID_TYPE_ILV_Read, DID_TYPE_ILV_Write, DID_OPTION_HADC_Read, DID_OPTION_HADC_Write, DID_ACC_ETAT_IHM_Read, DID_LKA_STATE_INDICATOR_Read, DID_P_INFO_LKA_LEFT_LINE_Read, DID_P_INFO_LKA_RIGHT_LINE_Read, DID_P_INFO_LPA_STATE_INDICATOR_Read, DID_P_INFO_LPA_STATE_POTENTIAL_Read, DID_LKA_ALERT_REQUEST_Read, DID_LKA_STATE_Read, DID_STEER_WL_DROPPED_WARNING_Read, DID_LKA_USER_PUSH_Read, DID_TYPE_LANE_ASSIST_Read, DID_TYPE_LANE_ASSIST_Write, DID_CURV_DERIVATIVE_LEFT_LINE_Read, DID_CURV_DERIVATIVE_RIGHT_LINE_Read, DID_DIST_VHL_TO_LEFT_LINE_Read, DID_DIST_VHL_TO_RIGHT_LINE_Read, DID_ESTIMATED_CURV_LEFT_LINE_Read, DID_ESTIMATED_CURV_RIGHT_LINE_Read, DID_HEADING_ANGLE_LEFT_LINE_Read, DID_HEADING_ANGLE_RIGHT_LINE_Read, DID_LANE_DETECTION_FAILURE_Read, DID_LEFT_LINE_DETECTION_DAA_Read, DID_LEFT_LINE_DETECTION_LKA_Read, DID_LEFT_LINE_TYPE_Read, DID_RIGHT_LINE_DETECTION_DAA_Read, DID_RIGHT_LINE_DETECTION_LKA_Read, DID_RIGHT_LINE_TYPE_Read, DID_DAA_LEVEL_LC_Read, DID_TYPE_DRIVER_ASSIST_Read, DID_TYPE_DRIVER_ASSIST_Write, DID_ActivCdeAlimEmbrComp_Read, DID_ActivCdeAlimEmbrComp_IoFromDcm, DID_PilotageRechauffeurEau_Read, DID_PilotageRechauffeurEau_IoFromDcm, DID_PRESENCE_CABIN_AQI_SENSOR_Read, DID_PRESENCE_CABIN_AQI_SENSOR_Write, DID_CLIM_M86_CurrentInstruction_dist_Read, DID_CLIM_M86_CurrentInstruction_Intake_Read, DID_CLIM_M86_CurrentInstruction_mix_fl_Read, DID_CLIM_M86_CurrentInstruction_mix_fr_Read, DID_CLIM_M86_CurrentPosition_dist_Read, DID_CLIM_M86_CurrentPosition_Intake_Read, DID_CLIM_M86_CurrentPosition_mix_fl_Read, DID_CLIM_M86_CurrentPosition_mix_fr_Read, DID_CLIM_M86_DirectionMoving_dist_Read, DID_CLIM_M86_DirectionMoving_Intake_Read, DID_CLIM_M86_DirectionMoving_mix_fl_Read, DID_CLIM_M86_DirectionMoving_mix_fr_Read, DID_CLIM_M86_INST_GOING_TO_DIST_Read, DID_CLIM_M86_INST_GOING_TO_INTAKE_Read, DID_CLIM_M86_INST_GOING_TO_MIX_FL_Read, DID_CLIM_M86_INST_GOING_TO_MIX_FR_Read, DID_CLIM_M86_INST_POS_ETAT_DIST_Read, DID_CLIM_M86_INST_POS_ETAT_INTAKE_Read, DID_CLIM_M86_INST_POS_ETAT_MIX_FL_Read, DID_CLIM_M86_INST_POS_ETAT_MIX_FR_Read, DID_CLIM_M86_INST_SETTING_POS_DIST_Read, DID_CLIM_M86_INST_SETTING_POS_INTAKE_Read, DID_CLIM_M86_INST_SETTING_POS_MIX_FL_Read, DID_CLIM_M86_INST_SETTING_POS_MIX_FR_Read, DID_CLIM_M86_NStartsSav_dist_Read, DID_CLIM_M86_NStartsSav_Intake_Read, DID_CLIM_M86_NStartsSav_mix_fl_Read, DID_CLIM_M86_NStartsSav_mix_fr_Read, DID_ActivAlimPulseurAR_Read, DID_ActivAlimPulseurAR_IoFromDcm, DID_ActivAlimPulseurAV_Read, DID_ActivAlimPulseurAV_IoFromDcm, DID_ActivEmbr_Read, DID_ActivEmbr_IoFromDcm, DID_ActivVanneCylindreeComp_Read, DID_ActivVanneCylindreeComp_IoFromDcm, DID_CmdCTP_Read, DID_CmdCTP_IoFromDcm, DID_CmdCylindreeComp_Read, DID_CmdCylindreeComp_IoFromDcm, DID_EtatEmbrayagePourCMM_Read, DID_MODUL_STTCONFORT_Read, DID_MODUL_STTCONFORT_Write, DID_EtatInhibPompeAerotherme_Read, DID_AuthEnclenchClim_Read, DID_EtatSecuBassePression_Read, DID_EtatSecuGivrage_Read, DID_EtatSecuHautePression_Read, DID_EtatSecuRegimeMoteur_Read, DID_RAPPORT_ENTRAIN_COMPRESSEUR_Read, DID_RAPPORT_ENTRAIN_COMPRESSEUR_Write, DID_CAPTEUR_POLLUANTS_Read, DID_CAPTEUR_POLLUANTS_Write, DID_EtatDiagGMV_Read, DID_EtatDmdCMMDebrayCompClim_Read, DID_EtatModeAC_Read, DID_ModeClim_Read, DID_MODUL_CPR_Read, DID_MODUL_CPR_Write, DID_MODUL_CTP_Read, DID_MODUL_CTP_Write, DID_MODUL_DEBIT_AERO_Read, DID_MODUL_DEBIT_AERO_Write, DID_MODUL_FMUX_Read, DID_MODUL_FMUX_Write, DID_MODUL_RECHAUFFEUR_Read, DID_MODUL_RECHAUFFEUR_Write, DID_NbrDemiPalesAffichees_Read, DID_PRECOND_THERMIQUE_Read, DID_PRECOND_THERMIQUE_Write, DID_PRESENCE_CIELO_Read, DID_PRESENCE_CIELO_Write, DID_SONDE_AIR_SOUFFLE_Read, DID_SONDE_AIR_SOUFFLE_Write, DID_SONDE_ENSOLEILLEMENT_Read, DID_SONDE_ENSOLEILLEMENT_Write, DID_SoulagementCompresseur_Read, DID_STRATEGIE_DCT_Read, DID_STRATEGIE_DCT_Write, DID_TYPE_CLIM_Read, DID_TYPE_CLIM_Write, DID_TYPE_ARCHI_IHM_CLIM_Read, DID_TYPE_ARCHI_IHM_CLIM_Write, DID_TYPE_IHM_DISTRIB_AV_TACT_Read, DID_TYPE_IHM_DISTRIB_AV_TACT_Write, DID_TYPE_IHM_ENTREE_AIR_PHYS_Read, DID_TYPE_IHM_ENTREE_AIR_PHYS_Write, DID_TYPE_IHM_PULSEUR_AR_Read, DID_TYPE_IHM_PULSEUR_AR_Write, DID_TYPE_IHM_PULSEUR_AV_PHYS_Read, DID_TYPE_IHM_PULSEUR_AV_PHYS_Write, DID_TYPE_IHM_PULSEUR_AV_TACT_Read, DID_TYPE_IHM_PULSEUR_AV_TACT_Write, DID_TYPE_IHM_PULSEUR_RG3_Read, DID_TYPE_IHM_PULSEUR_RG3_Write, DID_TYPE_IHM_TEMP_AV_PHYS_Read, DID_TYPE_IHM_TEMP_AV_PHYS_Write, DID_TYPE_IHM_TEMP_AV_TACT_Read, DID_TYPE_IHM_TEMP_AV_TACT_Write, DID_TYPE_IHM_TYPAGE_AUTO_Read, DID_TYPE_IHM_TYPAGE_AUTO_Write, DID_DefautCptTopRoueARD_Read, DID_DefautCptTopRoueARG_Read, DID_TYPE_FAP_Read, DID_TYPE_FAP_Write, DID_ConditionMaintCurrentNwk_Read, DID_CondMaintienBSI_Read, DID_Holdinfo_Read, DID_MNLPCanPWTMaintCause_Read, DID_MNLPServerStateCode_Read, DID_SustainPartialWakeUp_Read, DID_TempHuileMotAffichee_Read, DID_TempHuileMotBrut_Read, DID_AlertePHuile_Read, DID_MoyNivHuileMot_Read, DID_NivHuileMotAffiche_Read, DID_NivHuileMotBrut_Read, DID_NUM_TABLE_NH_Read, DID_NUM_TABLE_NH_Write, DID_ORIGINE_NIVEAU_HUILE_Read, DID_ORIGINE_NIVEAU_HUILE_Write, DID_AdresseReseauxPCU_Read, DID_CLE_INHIB_AIRBAG_Read, DID_CLE_INHIB_AIRBAG_Write, DID_MethodDeploimScrapping_Read, DID_nombrePCU_Read, DID_DSG_DIRECTE_Read, DID_DSG_DIRECTE_Write, DID_TYPE_PUSH_DSGI_Read, DID_TYPE_PUSH_DSGI_Write, DID_PRESENCE_AVE_Read, DID_PRESENCE_AVE_Write, DID_EtatAutorisationDemarrage_Read, DID_EtatCmdDemarrage_Read, DID_EtatPrincipalSEV_Read, DID_TYPE_CHAINE_TRACTION_Read, DID_TYPE_CHAINE_TRACTION_Write, DID_TYPE_DEMARRAGE_Read, DID_TYPE_DEMARRAGE_Write, DID_TYPE_GMP_Read, DID_TYPE_GMP_Write, DID_ActivationFARC_Read, DID_DdeVoyFARC_Read, DID_DdeVoyFARC_IoFromDcm, DID_EtatFARC_Read, DID_FreinageEnCoursFARC_Read, DID_PRESENCE_FARC_Read, DID_PRESENCE_FARC_Write, DID_ActivationARC_Read, DID_AlerteSonoreCollision_Read, DID_AlerteVisuelleCollision_Read, DID_EtatARC_Read, DID_NiveauSensibiliteARC_Read, DID_PRESENCE_ARC_Read, DID_PRESENCE_ARC_Write, DID_AMVAR_Read, DID_AMVAR_Write, DID_DdeActivationPackDynHAB_Read, DID_DdePageTelemetrique_Read, DID_ModeDyn_Read, DID_P_INFO_CMDM_MODE_VHL_Read, DID_ReqModeAMVAR_Read, DID_ReqModeDA_Read, DID_req_mode_ESP_Read, DID_Retour_Etat_Mode_Eco_Read, DID_HMI_MODE_SELECTOR_Read, DID_HMI_MODE_SELECTOR_Write, DID_Info_cmd_select_Read, DID_PRESENCE_MODE_ECO_DYN_Read, DID_PRESENCE_MODE_ECO_DYN_Write, DID_CdePilotageRelDA_Read, DID_CdePilotageRelUCF_Read, DID_PRESENCE_MEAP_Read, DID_PRESENCE_MEAP_Write, DID_P_INFO_CMDM_CFG_MODE_HYB_VHL_Read, DID_ConsigneGMPDyn_Read, DID_POLYSENSORIAL_PACK_Read, DID_POLYSENSORIAL_PACK_Write, DID_PRESENCE_MODE_SPORT_DYN_Read, DID_PRESENCE_MODE_SPORT_DYN_Write, DID_CompteurkW_Read, DID_InfoEtatFluxMEL_Read, DID_InfoEtatFluxMTH_Read, DID_InfoSocBattHY_Read, DID_SocBattHY_Read, DID_EtatGMP_Read, DID_EtatGMPHY_Read, DID_GMPTournant_Read, DID_InfoAccLateraleInst_Read, DID_InfoAccLateralePct_Read, DID_InfoAccLongitudinaleInst_Read, DID_InfoAccLongitudinalePct_Read, DID_InfoBoostInst_Read, DID_InfoBoostPct_Read, DID_InfoPuissanceInst_Read, DID_InfoPuissancePct_Read, DID_InfoTorqueInst_Read, DID_InfoTorquePct_Read, DID_RegimeMoteur_Read, DID_RegimeMoteurAfficheCMB_Read, DID_SONDE_EAU_DANS_GASOIL_Read, DID_SONDE_EAU_DANS_GASOIL_Write, DID_TYPE_PACK_DYN_Read, DID_TYPE_PACK_DYN_Write, DID_CFG_AUTOR_MAP_HMI_Read, DID_CFG_AUTOR_MAP_HMI_Write, DID_InterdictionDemDeBV_Read, DID_MarcheArriere_Read, DID_PositionLevierBVAffiche_Read, DID_PRESENCE_GSI_Read, DID_PRESENCE_GSI_Write, DID_ProgrammeBV_Read, DID_TYPE_BOITE_VITESSE_Read, DID_TYPE_BOITE_VITESSE_Write, DID_TYPE_SC_Read, DID_TYPE_SC_Write, DID_CptDiagFrnAccel1_Read, DID_CptDiagFrnAccel2_Read, DID_CptDiagFrnDecel1_Read, DID_CptDiagFrnDecel2_Read, DID_CptDiagFrnPMC1_Read, DID_CptDiagFrnPMC2_Read, DID_CptDiagFrnTpsLong1_Read, DID_CptDiagFrnTpsLong2_Read, DID_ACQ_PUSH_ESP_Read, DID_ACQ_PUSH_ESP_Write, DID_PRESENCE_ASR_PLUS_Read, DID_PRESENCE_ASR_PLUS_Write, DID_OPTION_HBB_HBC_Read, DID_OPTION_HBB_HBC_Write, DID_RegulationASRESP_Read, DID_ACC_XVV_CMD_NON_AUTORISEE_IHM_Read, DID_DdeActivationRVVACC_Read, DID_ETAT_FONCT_LVV_RVV_Read, DID_FONCT_ACT_LVV_RVV_Read, DID_OPTION_PLV_Read, DID_OPTION_PLV_Write, DID_PRESENCE_LVV_RVV_ACC_Read, DID_PRESENCE_LVV_RVV_ACC_Write, DID_VIT_CONS_LVV_RVV_Read, DID_XVV_REGLAGE_CONSIGNE_VITESSE_Read, DID_ACC_AUTO_HOLD_Read, DID_ACC_DMD_REPRISE_CONDUCTEUR_ACC_Read, DID_ACC_INHIB_SUR_REGIME_Read, DID_ACC_TIV_IHM_Read, DID_ACC_XVV_DISPONIBLE_IHM_Read, DID_ACC_XVV_ETAT_FONCTION_IHM_Read, DID_AdrActivationAcc_Read, DID_AdrCockpitFailure_Read, DID_AdrGoAcc_Read, DID_AdrSelectionAcc_Read, DID_AdrSpdSetpoint_Read, DID_ARRET_VHL_ADAS_Read, DID_CONSIGNE_TIV_RVVI_Read, DID_DdeActivationACC_Read, DID_DRIVE_AWAY_REQUIRED_Read, DID_EtatIhmAcc_Read, DID_TYPE_ACC_Read, DID_TYPE_ACC_Write, DID_TYPE_TARGET_DETECTION_Read, DID_TYPE_TARGET_DETECTION_Write, DID_DdeActivationLVV_Read, DID_APPUI_PUSH_GAP_VCI_Read, DID_APPUI_PUSH_OK_VCI_Read, DID_CGT_XVV_CONS_MEMO_CLOSE_Read, DID_DEFAUT_LVV_RVV_Read, DID_DESACTIV_ET_HDC_Read, DID_DMD_XVV_CONS_VIT_PROG_Read, DID_ETAT_RVV_LVV_Read, DID_LPA_SELECTION_PUSH_DRIVE_Read, DID_OFFSET_VITESSE_TOTAL_Read, DID_P_INFO_XVV_APPEL_PAGE_SEL_CONS_Read, DID_P_INFO_XVV_APPEL_REGL_TIV_Read, DID_PUSH_SELECTION_LVV_Read, DID_PUSH_SELECTION_RVV_Read, DID_REGLAGE_CONS_TIV_Read, DID_SPEED_DWN_ET_HDC_Read, DID_SPEED_UP_ET_HDC_Read, DID_VitesseAfficheeCMB_Read, DID_VITESSE_VEHICULE_AFFICHEE_Read, DID_XVV_AUTOR_REGL_CONS_TIV_RVVI_Read, DID_XVV_DEFAUT_AFFICHEUR_Read, DID_CntrDamagAccBeltTr1_Read, DID_CntrDamagAccBeltTr2_Read, DID_CntrDamagAccBeltVB_Read, DID_CntrDamagAccBeltVT_Read, DID_CptEndomCourAcc_Read, DID_NbrTourCourAcc_Read, DID_CptRestartNum_Read, DID_ActivLedPushSTT_Read, DID_CptBesImmo_N2_DMTR_0_20_Read, DID_CptBesImmo_N2_DMTR_20_40_Read, DID_CptBesImmo_N2_DMTR_40_60_Read, DID_CptBesImmo_N3_DMTR_0_20_Read, DID_CptBesImmo_N3_DMTR_20_40_Read, DID_CptBesImmo_N3_DMTR_40_60_Read, DID_CptBesInhibCrt_DMTR_0_20_Read, DID_CptBesInhibCrt_DMTR_20_40_Read, DID_CptBesInhibCrt_DMTR_40_60_Read, DID_CptBesInhibLng_DMTR_0_20_Read, DID_CptBesInhibLng_DMTR_20_40_Read, DID_CptBesInhibLng_DMTR_40_60_Read, DID_CptNonArretCityPark020Km_Read, DID_CptNonArretCityPark2040Km_Read, DID_CptNonArretCityPark4060Km_Read, DID_CptNonArretClim020Km_Read, DID_CptNonArretClim2040Km_Read, DID_CptNonArretClim4060Km_Read, DID_CptNonArretGEEBatt020Km_Read, DID_CptNonArretGEEBatt2040Km_Read, DID_CptNonArretGEEBatt4060Km_Read, DID_CptNonArretGEEDmtr020Km_Read, DID_CptNonArretGEEDmtr2040Km_Read, DID_CptNonArretGEEDmtr4060Km_Read, DID_CptNonArretGEEQR020Km_Read, DID_CptNonArretGEEQR2040Km_Read, DID_CptNonArretGEEQR4060Km_Read, DID_CptRedemarrage_Read, DID_DmdChangementEtatSTT_Read, DID_EtatDoubleAppuiPushSTT_Read, DID_TYPE_AQUI_PUSH_STT_Read, DID_TYPE_AQUI_PUSH_STT_Write, DID_TYPE_STT_Read, DID_TYPE_STT_Write, DID_ActivationACPK_Read, DID_ED_AppuiPushSCP1_ACPK_Read, DID_ED_AppuiPushSCP2_Read, DID_EtatClignoLEDMPD_Read, DID_EtatLEDMPD_Read, DID_InfoACPKManeuverState_Read, DID_InfoACPKMenu_Read, DID_OPTION_CPK_Read, DID_OPTION_CPK_Write, DID_OPTION_SAM_Read, DID_OPTION_SAM_Write, DID_PRESENCE_PUSH_SAM_Read, DID_PRESENCE_PUSH_SAM_Write, DID_PresenceRemorque_Read, DID_CDE_PWM_LED_SCP_Read, DID_CDE_PWM_LED_SCP_IoFromDcm, DID_DdeLEDPushSCP_Read, DID_DdeLEDPushSCP_IoFromDcm, DID_PiloterLEDSAM_Read, DID_PiloterLEDSAM_IoFromDcm, DID_ActivAideVisuRecul_Read, DID_EtatInhibSonDOP_Read, DID_EtatInhibVisuelDOP_Read, DID_OPTION_DOP_Read, DID_OPTION_DOP_Write, DID_OPTION_ECO_COACHING_Read, DID_OPTION_ECO_COACHING_Write, DID_LOI_JAUGE_NIV_ALERTE_Read, DID_LOI_JAUGE_NIV_ALERTE_Write, DID_NivCarbAffiche_Read, DID_NIV_CARB_CRITIQUE_Read, DID_NIV_CARB_CRITIQUE_Write, DID_NivCarbRestant_Read, DID_EntreeJaugeCarb_Read, DID_EtatBouchonCarb_Read, DID_NivCarbMesure_Read, DID_NUMERO_TABLE_JAUGEAGE_Read, DID_NUMERO_TABLE_JAUGEAGE_Write, DID_LOC_ID_DS_INT_Read, DID_CfgTypeLocksSteering_Read, DID_CfgTypeLocksSteering_Write, DID_OPTION_BLUETOOTH_Read, DID_OPTION_BLUETOOTH_Write, DID_FONCTION_AML_ACTIVE_Read, DID_PRESENCE_ABC_COFFRE_Read, DID_PRESENCE_ABC_COFFRE_Write, DID_CfgTypeTrunkPushInterior_Read, DID_CfgTypeTrunkPushInterior_Write, DID_PRESENCE_OUV_AR_Read, DID_PRESENCE_OUV_AR_Write, DID_VOLET_MOTORISE_Read, DID_VOLET_MOTORISE_Write, DID_ETAT_CONDA_Read, DID_ETAT_CONDA_OUV_AR_Read, DID_MVA_SELECTIVITY_Read, DID_MVA_SELECTIVITY_Write, DID_STEERING_WHEEL_POSITION_Read, DID_STEERING_WHEEL_POSITION_Write, DID_TYPE_CONDA_Read, DID_TYPE_CONDA_Write, DID_ETAT_SELECTIVITE_COND_Read, DID_HFA_FUNCTION_STATE_Read, DID_CFG_PLIP_TOUCH_3_FUNCTION_Read, DID_CFG_PLIP_TOUCH_3_FUNCTION_Write, DID_OPTION_LVTOV_TELECMD_Read, DID_OPTION_LVTOV_TELECMD_Write, DID_TYPE_CENTRALIZED_CMD_WINDOWS_Read, DID_TYPE_CENTRALIZED_CMD_WINDOWS_Write, DID_CFG_PLIP_PRESS_TYPE_TOUCH_3_Read, DID_CFG_PLIP_PRESS_TYPE_TOUCH_3_Write, DID_TELECMD1_SYNCRHO_Read, DID_TELECMD2_SYNCRHO_Read, DID_TELECMD3_SYNCRHO_Read, DID_TELECMD4_SYNCRHO_Read, DID_TELECMD5_SYNCRHO_Read, DID_TELECMD_COURT_Read, DID_TELECMD_IDENT_Read, DID_TELECMD_LONG_Read, DID_TELECMD_MAINTENU_Read, DID_TELECMD_NON_IDENT_Read, DID_TELECMD_PUSH1_Read, DID_TELECMD_PUSH2_Read, DID_TELECMD_PUSH3_Read, DID_TELECMD_PUSH4_Read, DID_TELECMD_PUSH5_Read, DID_TELECMD_RELACHE_Read, DID_CMD_ALLUME_LED_SECU_ENFANT_Read, DID_CMD_ALLUME_LED_SECU_ENFANT_IoFromDcm, DID_DEFAILLANCE_CPO_COND_Read, DID_DMD_RAZ_FLAG_DIAG_GAV_Read, DID_DRIVER_LOCK_TYPE_Read, DID_DRIVER_LOCK_TYPE_Write, DID_FLAG_INFOS_SERRURES_Read, DID_FUEL_FLAP_LOCK_TYPE_Read, DID_FUEL_FLAP_LOCK_TYPE_Write, DID_HOOD_LOCK_TYPE_Read, DID_HOOD_LOCK_TYPE_Write, DID_INFO_CPO_ARD_Read, DID_INFO_CPO_ARG_Read, DID_INFO_CPO_AVD_Read, DID_INFO_CPO_AVG_Read, DID_INFO_CPO_COFFRE_Read, DID_INFO_CPO_LUNETTE_Read, DID_REAR_LEFT_LOCK_TYPE_Read, DID_REAR_LEFT_LOCK_TYPE_Write, DID_REAR_RIGHT_LOCK_TYPE_Read, DID_REAR_RIGHT_LOCK_TYPE_Write, DID_TEM_GAV_OUVRANT_OUVERT_Read, DID_OPTION_SUNROOF_Read, DID_OPTION_SUNROOF_Write, DID_PositionVelum_Read, DID_PRESENCE_IMA_Read, DID_PRESENCE_IMA_Write, DID_DdeDelestageChauffeNuque_Read, DID_DdeDelestageChauffeNuque_IoFromDcm, DID_EtatDelestageCTP_Read, DID_OPTION_SIEGE_CLIM_Read, DID_OPTION_SIEGE_CLIM_Write, DID_PRES_VOLANT_CHAUF_Read, DID_PRES_VOLANT_CHAUF_Write, DID_CDE_ACC_Read, DID_ModeConfigVhl_Read, DID_PositionShunt_Read, DID_AutorFctEnergieDeGEE_Read, DID_BesoinImmoDMTRSTT_Read, DID_ChargeBatterie_Read, DID_CourantBatterieMesure_Read, DID_DefautProdEE_Read, DID_Delestage_Read, DID_EtatReseauElectrique_Read, DID_NiveauSOC_Read, DID_StatutChargeBatterie_Read, DID_TemperatureBatterieBECB_Read, DID_TempInterneBatterieDEB_Read, DID_TensionAlimentationBSI_Read, DID_TensionBatterieBECB_Read, DID_TensionBatterieReposDeBECB_Read, DID_TensionBatterieSecu_Read, DID_TensionPrediteDemarrage_Read, DID_UPredRedemarrage_Read, DID_ModeEconomie_Read, DID_CFG_AUTOR_MAP_EEM_Read, DID_ConsigneTensionRegulateurAlt_Read, DID_DefautGEEUCFrein_Read, DID_DefautSoustension_Read, DID_DefautSurtension_Read, DID_EtatAutorRechargeUCAPS_Read, DID_SocLivraisonBas_Read, DID_TensionBatterieFiltree_Read, DID_TYPE_SOC_Read, DID_TYPE_SOC_Write, DID_ActivationAlertesPieton_Read, DID_ActivationFonctionAVN_Read, DID_AnimationPushAVN_Read, DID_OPTION_VISION_NOCTURNE_Read, DID_OPTION_VISION_NOCTURNE_Write, DID_AuthAllumLecteurCle_Read, DID_AuthAllumLecteurCle_IoFromDcm, DID_AuthAllumPushDem_Read, DID_AuthAllumPushDem_IoFromDcm, DID_EtatJourNuit_Read, DID_NivLuminositeMemo_Read, DID_NivLuminositeRetroEclPush_Read, DID_NivLuminositeRetroEclPush_IoFromDcm, DID_ActivEclCoffre_Read, DID_ActivEclCoffre_IoFromDcm, DID_ActivEclSeuilsAR_Read, DID_ActivEclSeuilsAR_IoFromDcm, DID_ActivEclSeuilsAV_Read, DID_ActivEclSeuilsAV_IoFromDcm, DID_ActivPlafRang1_Read, DID_ActivPlafRang1_IoFromDcm, DID_ActivPlafRang2_Read, DID_ActivPlafRang2_IoFromDcm, DID_EtatDmdExtinctionPlafRang1_Read, DID_EtatDmdPlafRang1_Read, DID_CFG_AUTOR_MAP_ECLI_Read, DID_CFG_AUTOR_MAP_ECLI_Write, DID_OPTION_POLY_AMBIANT_LIGHT_Read, DID_OPTION_POLY_AMBIANT_LIGHT_Write, DID_OPTION_AFS_Read, DID_OPTION_AFS_Write, DID_OPTION_ECL_INTERSEC_Read, DID_OPTION_ECL_INTERSEC_Write, DID_OPTION_ECL_VIR_STAT_Read, DID_OPTION_ECL_VIR_STAT_Write, DID_ActivAntiBrAR_Read, DID_ActivAntiBrAR_IoFromDcm, DID_ActivAntiBrAV_Read, DID_ActivAntiBrAV_IoFromDcm, DID_OPTION_ANTIBR_AV_Read, DID_OPTION_ANTIBR_AV_Write, DID_CmdDRL_Read, DID_CmdDRL_IoFromDcm, DID_CmdFxPosLeft_Read, DID_CmdFxPosLeft_IoFromDcm, DID_CmdFxPosRight_Read, DID_CmdFxPosRight_IoFromDcm, DID_CmdLicensePlate_Read, DID_CmdLicensePlate_IoFromDcm, DID_TYPE_ECL_AVANT_Read, DID_TYPE_ECL_AVANT_Write, DID_CmdAvertSonore_Read, DID_CmdAvertSonore_IoFromDcm, DID_CmdMainReverseLight_Read, DID_CmdMainReverseLight_IoFromDcm, DID_CmdStopLight_Read, DID_CmdStopLight_IoFromDcm, DID_PRESENCE_BSG_RQ_Read, DID_PRESENCE_BSG_RQ_Write, DID_CmdPushLedWarning_Read, DID_CmdPushLedWarning_IoFromDcm, DID_CmdTurnIndicatorLeft_Read, DID_CmdTurnIndicatorLeft_IoFromDcm, DID_CmdTurnIndicatorRight_Read, DID_CmdTurnIndicatorRight_IoFromDcm, DID_INHIB_MOVING_EFFECT_Read, DID_INHIB_MOVING_EFFECT_Write, DID_OPTION_AUTO_CROIS_ROUTE_Read, DID_OPTION_AUTO_CROIS_ROUTE_Write, DID_OPTION_AAF_Read, DID_OPTION_AAF_Write, DID_TYPE_COMODO_Read, DID_TYPE_COMODO_Write, DID_BARRETTE_TNB_SUR_LIN_Read, DID_BARRETTE_TNB_SUR_LIN_Write, DID_FlagDebouclCeintCond_Read, DID_FlagDebouclCeintPassAV_Read, DID_FlagDebouclCeintPavC_Read, DID_FlagDebouclCeintRang2Centre_Read, DID_FlagDebouclCeintRang2Droite_Read, DID_FlagDebouclCeintRang2Gauche_Read, DID_FlagDebouclCeintRang3Droite_Read, DID_FlagDebouclCeintRang3Gauche_Read, DID_INHIB_DIAG_TNB_COND_Read, DID_INHIB_DIAG_TNB_COND_Write, DID_INHIB_DIAG_TNB_PARC_Read, DID_INHIB_DIAG_TNB_PARC_Write, DID_INHIB_DIAG_TNB_PARD_Read, DID_INHIB_DIAG_TNB_PARD_Write, DID_INHIB_DIAG_TNB_PARG_Read, DID_INHIB_DIAG_TNB_PARG_Write, DID_DefautPresenceConducteur_Read, DID_OPTION_TAXI_Read, DID_OPTION_TAXI_Write, DID_EtatCeintureCond_Read, DID_EtatCeinturePar2c_Read, DID_EtatCeinturePar2d_Read, DID_EtatCeinturePar2g_Read, DID_EtatCeinturePav_Read, DID_INHIB_DIAG_TNB_PAV_Read, DID_INHIB_DIAG_TNB_PAV_Write, DID_NAPPE_DETECTION_PASS_Read, DID_NAPPE_DETECTION_PASS_Write, DID_NBR_CNB_Read, DID_NBR_CNB_Write, DID_PresencePassagerAr2c_Read, DID_PresencePassagerAr2d_Read, DID_PresencePassagerAr2g_Read, DID_PresencePassagerAvant_Read, DID_TYPE_PRES_PASS_SENSOR_Read, DID_TYPE_PRES_PASS_SENSOR_Write, DID_ActivAuthReglSiegeCond_Read, DID_ActivAuthReglSiegeCond_IoFromDcm, DID_MEMO_CONDUCTEUR_Read, DID_MEMO_CONDUCTEUR_Write, DID_OPTION_ACCUEIL_CONDUCTEUR_Read, DID_OPTION_ACCUEIL_CONDUCTEUR_Write, DID_OPTION_MASSAGE_Read, DID_OPTION_MASSAGE_Write, DID_PRESENCE_VTH_Read, DID_PRESENCE_VTH_Write, DID_RETRO_AVEC_MEMO_Read, DID_RETRO_AVEC_MEMO_Write, DID_ActivAuthSiegesClim_Read, DID_ActivAuthSiegesClim_IoFromDcm, DID_AutorAlimSiegesChauffants_Read, DID_AutorAlimSiegesChauffants_IoFromDcm, DID_CdePBCZone1_Read, DID_CdePBCZone1_IoFromDcm, DID_CdePBCZone2_Read, DID_CdePBCZone2_IoFromDcm, DID_EtatActivationPBC_Read, DID_EtatActivationPBC_IoFromDcm, DID_PRESENCE_PBC_Read, DID_PRESENCE_PBC_Write, DID_ActivDegivrage_Read, DID_ActivDegivrage_IoFromDcm, DID_CLIMAT_Read, DID_CLIMAT_Write, DID_DEGI_GICLEURS_AV_Read, DID_DEGI_GICLEURS_AV_Write, DID_DmdChgtPBC_Read, DID_TYPE_MODUL_OPTI_VIDE_Read, DID_TYPE_MODUL_OPTI_VIDE_Write, DID_OPTION_SWEEPING_COURTESY_Read, DID_OPTION_SWEEPING_COURTESY_Write, DID_PILOTAGE_ESSUIE_VITRE_AR_Read, DID_PILOTAGE_ESSUIE_VITRE_AR_IoFromDcm, DID_PILOTAGE_ESSUIE_VITRE_AV_Read, DID_PILOTAGE_ESSUIE_VITRE_AV_IoFromDcm, DID_PILOTAGE_LAVAGE_AR_Read, DID_PILOTAGE_LAVAGE_AR_IoFromDcm, DID_PILOTAGE_LAVAGE_AV_Read, DID_PILOTAGE_LAVAGE_AV_IoFromDcm, DID_OPTION_CDP_Read, DID_OPTION_CDP_Write, DID_DispoAffMenuParam_Read, DID_EtatDmdAffEclAmbMenu_Read, DID_EtatDmdAffEclAmbMenu_IoFromDcm, DID_EtatMenuPrgMem_Read, DID_MenuParamVhl_Read, DID_AFFICH_POI_ADBLUE_Read, DID_AFFICH_POI_ADBLUE_Write, DID_PRESENCE_SCR_Read, DID_PRESENCE_SCR_Write, DID_AnneeAffichee_Read, DID_CompteurTemporel_Read, DID_EtatProgReveilPrecondElec_Read, DID_EtatProgReveilPrecondTherm_Read, DID_EtatProgReveilRTAB_Read, DID_HeureAffichee_Read, DID_HeureProgReveilPrecondTherm_Read, DID_JourAffiche_Read, DID_JourSemaine_Read, DID_MinuteAffichee_Read, DID_MoisAffiche_Read, DID_TypeAffichage_Read, DID_ConsoMoyenneHY1_Read, DID_ConsoMoyenneHY2_Read, DID_ConsoMoyenneHY3_Read, DID_ConsoMoyenneHY4_Read, DID_ConsoMoyenneHY5_Read, DID_ConsoMoyenneHY6_Read, DID_ConsoRapide_Read, DID_DISPO_PSEUDO_CONSO_CAR_Read, DID_DISPO_PSEUDO_CONSO_CAR_Write, DID_AutonomieCalculee_Read, DID_ConsoInstantanee_Read, DID_ConsoMoyTrajet1_Read, DID_ConsoMoyTrajet2_Read, DID_DistanceMaint_Read, DID_DistanceMaint1km_Read, DID_DistanceTrajet1_Read, DID_DistanceTrajet2_Read, DID_DureeMaint1000s_Read, DID_DureeTrajet1_Read, DID_DureeTrajet2_Read, DID_VitMoyenneMaint_Read, DID_KmTotal_Read, DID_OdoCompteurEspionOdo_Read, DID_OdoKmApresSaut_Read, DID_OdoKmAvantSaut_Read, DID_OdometrePartielMemoBsi_Read, DID_OdometrePartielMux_Read, DID_OdometreTotalMemoBsi_Read, DID_ValiditeDistanceParcourue_Read, DID_AccelerationLong_Read, DID_DispoVitesseLongi_Read, DID_VitesseLongi_Read, DID_DureeDerniereMaintenance_Read, DID_DureeMarketingSel_Read, DID_KMLorsRAZMaintenance_Read, DID_KmMaintenance_Read, DID_KmMarketingSel_Read, DID_MaintenanceKMDepassee_Read, DID_MaintenanceTempoDepassee_Read, DID_NbJourMaintenance_Read, DID_NbMaintenanceEffectuees_Read, DID_OPT_MARKETING_MAINT_Read, DID_OPT_MARKETING_MAINT_Write, DID_PictoCleMaintenance_Read, DID_SeuilDuree1ereMaint_Read, DID_SeuilDuree1ereMaint_Write, DID_SeuilDureeTotaleAvtMnt_Read, DID_SeuilDureeTotaleAvtMnt_Write, DID_SeuilKm1ereMaint_Read, DID_SeuilKm1ereMaint_Write, DID_SeuilMntMarketing_200km_Read, DID_SeuilMntMarketing_200km_Write, DID_SeuilSeveriseMaint_Read, DID_TYPE_MAINTENANCE_Read, DID_TYPE_MAINTENANCE_Write, DID_TempExterieure_Read, DID_DispoEtatMenuPrgPem_Read, DID_DispoEtatMenuReserveZEV_Read, DID_DispoMenuInfoXVV_Read, DID_EtatFctMenuParam_Read, DID_EtatMenuInfoParamDispo_Read, DID_EtatMenuInfoUniteLangueDispo_Read, DID_EtatMenuReserveZEV_Read, DID_EtatMenuUnitesLangue_Read, DID_EtatReglageButeesXVV_Read, DID_VitLVVDeMenuPerso_Read, DID_DISTRACTION_MODE_Read, DID_DISTRACTION_MODE_Write, DID_EtatPushOnOffRadio_Read, DID_PresenceCRT_Read, DID_PresenceCRT_Write, DID_TYPE_BTEL_Read, DID_TYPE_BTEL_Write, DID_SOFTWARE_UPDATE_CAPABILITY_Read, DID_SOFTWARE_UPDATE_CAPABILITY_Write, DID_AbsenceDmdDeverrMEL_Read, DID_ADCMELAntiscanning_Read, DID_EtatVerrouillageMEL_Read, DID_AbsenceDmdDeverrBVP_Read, DID_ADCBVPAntiscanning_Read, DID_EtatVerrouillageBVP_Read, DID_CODE_VIN_Read, DID_CODE_VIN_Write, DID_IdentMLReconnu_Read, DID_NbNFCUidAppris_Read, DID_SMARTDEVICE_BY_SDCM_Read, DID_SMARTDEVICE_BY_SDCM_Write, DID_AbsenceDmdDeverrouillage_Read, DID_ADCBSIAntiscanning_Read, DID_EtatVerrouillageCMM_Read, DID_AbsenceDmdCrypteeAVE_Read, DID_AbsenceReponseCrypteeAVE_Read, DID_PresenceReponseNokAVE_Read, DID_AbsenceReponseAuthent_Read, DID_AbsenceReponseIdentification_Read, DID_ADCBSIVierge_Read, DID_CFG_AUTOR_MAP_INVIO_Read, DID_CFG_AUTOR_MAP_INVIO_Write, DID_CleReconnue_Read, DID_GEN_RSK16_Read, DID_GEN_RSK16_Write, DID_NbNPTAesAppris_Read, DID_NbPMLAesAppris_Read, DID_NbrTrspAppris_Read, DID_OPTION_WLC_Read, DID_OPTION_WLC_Write, DID_PresenceCle_Read, DID_TYPE_CLE_Read, DID_TYPE_CLE_Write, DID_ALARME_SECONDE_MONTE_Read, DID_ALARME_SECONDE_MONTE_Write, DID_AutorRechargeSirene_Read, DID_CdeAlerteSonoreKlaxon_Read, DID_CdeAlerteSonoreKlaxon_IoFromDcm, DID_CmdActivationSurvAS_Read, DID_CmdActivationSurvAS_IoFromDcm, DID_CmdActivationSurvSIR_Read, DID_CmdActivationSurvSIR_IoFromDcm, DID_CmdActivationSurvVOL_Read, DID_CmdActivationSurvVOL_IoFromDcm, DID_CmdAlerteSonoreAlarme_Read, DID_DmdSignalisationWarning_Read, DID_DmdSignalisationWarning_IoFromDcm, DID_EffractionSEV_Read, DID_INHIB_VOLUMETRIE_ALARME_Read, DID_INHIB_VOLUMETRIE_ALARME_Write, DID_LEDAlarme_Read, DID_LEDAlarme_IoFromDcm, DID_PRESENCE_MUS_LIN_Read, DID_PRESENCE_MUS_LIN_Write, DID_PRESENCE_SIRENE_LIN_Read, DID_PRESENCE_SIRENE_LIN_Write, DID_SignalActivAlarme_Read, DID_SignalActivAlarme_IoFromDcm, DID_SignalDesactivAlarme_Read, DID_SignalDesactivAlarme_IoFromDcm, DID_SignalEffractionPerim_Read, DID_TYPE_ALARME_Read, DID_TYPE_ALARME_Write, DID_DIAG_INTEGRA_ELEC_Read, DID_InformationUP_Read, DID_ModeIEVEnCours_Read, DID_NB_SAISIE_TELECODAGE_Read, DID_OPTIONS_TLM_Read, DID_OPTIONS_TLM_Write, DID_ProcessUsine1_Read, DID_ProcessUsine1_Write, DID_ProcessUsine2_Read, DID_ProcessUsine2_Write, DID_ProcessUsine3_Read, DID_ProcessUsine3_Write, DID_ProcessUsine4_Read, DID_ProcessUsine4_Write, DID_ProcessUsine5_Read, DID_ProcessUsine5_Write, DID_ProcessUsine6_Read, DID_ProcessUsine6_Write, DID_TRACA_SITE_SIGN_DATE_Read, DID_TRACA_SITE_SIGN_DATE_Write, DID_UCE_001_Read, DID_UCE_001_Write, DID_UCE_002_Read, DID_UCE_002_Write, DID_UCE_003_Read, DID_UCE_003_Write, DID_UCE_004_Read, DID_UCE_004_Write, DID_UCE_005_Read, DID_UCE_005_Write, DID_UCE_006_Read, DID_UCE_006_Write, DID_UCE_007_Read, DID_UCE_007_Write, DID_UCE_008_Read, DID_UCE_008_Write, DID_UCE_009_Read, DID_UCE_009_Write, DID_UCE_010_Read, DID_UCE_010_Write, DID_UCE_011_Read, DID_UCE_011_Write, DID_UCE_012_Read, DID_UCE_012_Write, DID_UCE_013_Read, DID_UCE_013_Write, DID_UCE_014_Read, DID_UCE_014_Write, DID_UCE_015_Read, DID_UCE_015_Write, DID_UCE_016_Read, DID_UCE_016_Write, DID_UCE_017_Read, DID_UCE_017_Write, DID_UCE_018_Read, DID_UCE_018_Write, DID_UCE_019_Read, DID_UCE_019_Write, DID_UCE_020_Read, DID_UCE_020_Write, DID_UCE_021_Read, DID_UCE_021_Write, DID_UCE_022_Read, DID_UCE_022_Write, DID_UCE_023_Read, DID_UCE_023_Write, DID_UCE_024_Read, DID_UCE_024_Write, DID_UCE_025_Read, DID_UCE_025_Write, DID_UCE_026_Read, DID_UCE_026_Write, DID_UCE_027_Read, DID_UCE_028_Read, DID_UCE_028_Write, DID_UCE_029_Read, DID_UCE_029_Write, DID_UCE_030_Read, DID_UCE_030_Write, DID_UCE_031_Read, DID_UCE_031_Write, DID_UCE_032_Read, DID_UCE_032_Write, DID_UCE_033_Read, DID_UCE_033_Write, DID_UCE_034_Read, DID_UCE_034_Write, DID_UCE_035_Read, DID_UCE_035_Write, DID_UCE_036_Read, DID_UCE_036_Write, DID_UCE_037_Read, DID_UCE_037_Write, DID_UCE_038_Read, DID_UCE_038_Write, DID_UCE_039_Read, DID_UCE_039_Write, DID_UCE_040_Read, DID_UCE_040_Write, DID_UCE_041_Read, DID_UCE_041_Write, DID_UCE_042_Read, DID_UCE_042_Write, DID_UCE_043_Read, DID_UCE_043_Write, DID_UCE_044_Read, DID_UCE_044_Write, DID_UCE_045_Read, DID_UCE_045_Write, DID_UCE_046_Read, DID_UCE_046_Write, DID_UCE_047_Read, DID_UCE_047_Write, DID_UCE_048_Read, DID_UCE_048_Write, DID_UCE_049_Read, DID_UCE_049_Write, DID_UCE_050_Read, DID_UCE_050_Write, DID_UCE_051_Read, DID_UCE_051_Write, DID_UCE_052_Read, DID_UCE_052_Write, DID_UCE_053_Read, DID_UCE_053_Write, DID_UCE_054_Read, DID_UCE_054_Write, DID_UCE_055_Read, DID_UCE_055_Write, DID_UCE_056_Read, DID_UCE_056_Write, DID_UCE_057_Read, DID_UCE_057_Write, DID_UCE_058_Read, DID_UCE_058_Write, DID_UCE_059_Read, DID_UCE_059_Write, DID_UCE_060_Read, DID_UCE_060_Write, DID_UCE_061_Read, DID_UCE_061_Write, DID_UCE_062_Read, DID_UCE_062_Write, DID_UCE_063_Read, DID_UCE_063_Write, DID_UCE_064_Read, DID_UCE_064_Write, DID_UCE_065_Read, DID_UCE_065_Write, DID_UCE_066_Read, DID_UCE_066_Write, DID_UCE_067_Read, DID_UCE_067_Write, DID_UCE_068_Read, DID_UCE_068_Write, DID_UCE_069_Read, DID_UCE_069_Write, DID_UCE_070_Read, DID_UCE_070_Write, DID_UCE_071_Read, DID_UCE_071_Write, DID_UCE_072_Read, DID_UCE_072_Write, DID_UCE_073_Read, DID_UCE_073_Write, DID_UCE_074_Read, DID_UCE_074_Write, DID_UCE_075_Read, DID_UCE_075_Write, DID_UCE_076_Read, DID_UCE_076_Write, DID_UCE_077_Read, DID_UCE_077_Write, DID_UCE_078_Read, DID_UCE_078_Write, DID_UCE_079_Read, DID_UCE_079_Write, DID_UCE_080_Read, DID_UCE_080_Write, DID_UCE_081_Read, DID_UCE_081_Write, DID_UCE_082_Read, DID_UCE_082_Write, DID_UCE_083_Read, DID_UCE_083_Write, DID_UCE_084_Read, DID_UCE_084_Write, DID_UCE_085_Read, DID_UCE_085_Write, DID_UCE_086_Read, DID_UCE_086_Write, DID_UCE_087_Read, DID_UCE_087_Write, DID_UCE_088_Read, DID_UCE_088_Write, DID_UCE_089_Read, DID_UCE_089_Write, DID_UCE_090_Read, DID_UCE_090_Write, DID_UCE_091_Read, DID_UCE_091_Write, DID_UCE_092_Read, DID_UCE_092_Write, DID_UCE_093_Read, DID_UCE_093_Write, DID_UCE_094_Read, DID_UCE_094_Write, DID_UCE_095_Read, DID_UCE_095_Write, DID_UCE_096_Read, DID_UCE_096_Write, DID_UCE_097_Read, DID_UCE_097_Write, DID_UCE_098_Read, DID_UCE_098_Write, DID_UCE_099_Read, DID_UCE_099_Write, DID_UCE_100_Read, DID_UCE_100_Write, DID_UCE_101_Read, DID_UCE_101_Write, DID_UCE_102_Read, DID_UCE_102_Write, DID_UCE_103_Read, DID_UCE_103_Write, DID_UCE_104_Read, DID_UCE_104_Write, DID_UCE_105_Read, DID_UCE_105_Write, DID_UCE_106_Read, DID_UCE_106_Write, DID_UCE_107_Read, DID_UCE_107_Write, DID_UCE_108_Read, DID_UCE_108_Write, DID_UCE_109_Read, DID_UCE_109_Write, DID_UCE_110_Read, DID_UCE_110_Write, DID_UCE_111_Read, DID_UCE_111_Write, DID_UCE_112_Read, DID_UCE_112_Write, DID_UCE_113_Read, DID_UCE_113_Write, DID_UCE_114_Read, DID_UCE_114_Write, DID_UCE_115_Read, DID_UCE_115_Write, DID_UCE_116_Read, DID_UCE_116_Write, DID_UCE_117_Read, DID_UCE_117_Write, DID_UCE_118_Read, DID_UCE_118_Write, DID_UCE_119_Read, DID_UCE_119_Write, DID_UCE_120_Read, DID_UCE_120_Write, DID_UCE_121_Read, DID_UCE_121_Write, DID_UCE_122_Read, DID_UCE_122_Write, DID_UCE_123_Read, DID_UCE_123_Write, DID_UCE_124_Read, DID_UCE_124_Write, DID_UCE_125_Read, DID_UCE_125_Write, DID_UCE_126_Read, DID_UCE_126_Write, DID_UCE_127_Read, DID_UCE_127_Write, DID_UCE_128_Read, DID_UCE_128_Write, DID_ZA_Read, DID_ZI_Read, DIDG_APV_Read, DIDG_APV_Write, DIDG_APV_List_Read, DIDG_CodeUce_Read, DIDG_CodeUce_Write, DIDG_CodeUce_List_Read, DIDG_DCONF_Read, DIDG_DCONF_Write, DIDG_DCONF_List_Read, DIDG_DCONF_SEC_Read, DIDG_DCONF_SEC_Write, DIDG_DCONF_SEC_List_Read, DIDG_STD_ASSEMBLY_FACTORY_Read, DIDG_STD_ASSEMBLY_FACTORY_List_Read, DIDG_ETUDE_Read, DIDG_ETUDE_List_Read, DIDG_OLD_Read, DIDG_OLD_List_Read, DiagnosticClearDiagnosticInformation, DiagnosticControlDTCSettingEnableLog, DiagnosticControlDTCSettingDisableLog, DiagnosticReadDTCInformation0x01, DiagnosticReadDTCInformation0x02, DiagnosticReadDTCInformation0x04, DiagnosticReadDTCInformation0x06, DiagnosticEcuHardReset, DiagnosticEcuSoftReset, DiagnosticSessionControlDefaultSession, DiagnosticSessionControlExtendedSession, DiagnosticSessionControlProgrammingSession, ReadMemoryByAddress, WriteMemoryByAddress, Routine_ClearVehicleFaultLog, DID_VehiculeLogFull_Read, DID_VsmFaultTable_Read, Routine_VeilleRapReseaux, Routine_MesNivHuile, Routine_RehabRadar, Routine_RAZCptDiagFrein, Routine_InhibAlerteFSE, Routine_InhibForceeSTT, Routine_RAZFlagPushSTT, Routine_RAZNbrRedem, Routine_ReinitNivCarb, Routine_ConfigVhl, Routine_RAZIndicDiagTNB, Routine_MAJCptTempVhl, Routine_MAJDateHeure, Routine_Raz2Kilometrage, Routine_RazKilometrage, Routine_RAZMaint1, Routine_RAZMaint2, Routine_RAZMaint3, Routine_RAZMaint4, Routine_RAZMaint5, Routine_RAZMaint6, Routine_AppBadgeBML, Routine_ApprUidNFC, Routine_DiagRemoteImmo, Routine_PilotageAVE, Routine_ProgAVE, Routine_AppClePlip, Routine_AppCodeBSI, Routine_ApprScanData, Routine_AuthentTrsp, Routine_DeverrBSI, Routine_DiagWLC, Routine_DMD_INTEGRAT_ELECT_VHL, Routine_PARAM_RAJ_STMIN, Routine_PREP_SORTIE_USINE, Routine_RAZ_CPU_LOAD, Routine_UMP_DELPHI]
  diagnostic service table VSM_ServicesTable_DoIP: diagnostic-connections=DiagConnectionDoIP, ecu-instance=VSM, protocol-kind=DCM_UDS_ON_IP, service-instance=DiagnosticSessionControlSafetySystemDiagnosticSession
  14 x diagnostic data identifier:
    DIDG_APV: id=54273
      diagnostic-parameter bit-offset=0:
        diagnostic data element DIDG_APV: array-size-semantics=FIXED-SIZE, max-number-of-elements=243, implementation-data-type=tBYTE
    DIDG_APV_List: id=54289
      diagnostic-parameter bit-offset=0:
        diagnostic data element DIDG_APV_List: array-size-semantics=FIXED-SIZE, max-number-of-elements=322, implementation-data-type=tBYTE
    DIDG_CodeUce: id=54274
      diagnostic-parameter bit-offset=0:
        diagnostic data element DIDG_CodeUce: array-size-semantics=FIXED-SIZE, max-number-of-elements=69, implementation-data-type=tBYTE
    DIDG_CodeUce_List: id=54290
      diagnostic-parameter bit-offset=0:
        diagnostic data element DIDG_CodeUce_List: array-size-semantics=FIXED-SIZE, max-number-of-elements=256, implementation-data-type=tBYTE
    DIDG_DCONF: id=54275
      diagnostic-parameter bit-offset=0:
        diagnostic data element DIDG_DCONF: array-size-semantics=FIXED-SIZE, max-number-of-elements=1, implementation-data-type=tBYTE
    DIDG_DCONF_List: id=54291
      diagnostic-parameter bit-offset=0:
        diagnostic data element DIDG_DCONF_List: array-size-semantics=FIXED-SIZE, max-number-of-elements=2, implementation-data-type=tBYTE
    DIDG_DCONF_SEC: id=54276
      diagnostic-parameter bit-offset=0:
        diagnostic data element DIDG_DCONF_SEC: array-size-semantics=FIXED-SIZE, max-number-of-elements=133, implementation-data-type=tBYTE
    DIDG_DCONF_SEC_List: id=54292
      diagnostic-parameter bit-offset=0:
        diagnostic data element DIDG_DCONF_SEC_List: array-size-semantics=FIXED-SIZE, max-number-of-elements=250, implementation-data-type=tBYTE
    DIDG_STD_ASSEMBLY_FACTORY: id=54278
      diagnostic-parameter bit-offset=0:
        diagnostic data element DIDG_STD_ASSEMBLY_FACTORY: array-size-semantics=FIXED-SIZE, max-number-of-elements=151, implementation-data-type=tBYTE
    DIDG_STD_ASSEMBLY_FACTORY_List: id=54294
      diagnostic-parameter bit-offset=0:
        diagnostic data element DIDG_STD_ASSEMBLY_FACTORY_List: array-size-semantics=FIXED-SIZE, max-number-of-elements=28, implementation-data-type=tBYTE
    DIDG_ETUDE: id=54279
      diagnostic-parameter bit-offset=0:
        diagnostic data element DIDG_ETUDE: array-size-semantics=FIXED-SIZE, max-number-of-elements=95, implementation-data-type=tBYTE
    DIDG_ETUDE_List: id=54295
      diagnostic-parameter bit-offset=0:
        diagnostic data element DIDG_ETUDE_List: array-size-semantics=FIXED-SIZE, max-number-of-elements=104, implementation-data-type=tBYTE
    DIDG_OLD: id=54280
      diagnostic-parameter bit-offset=0:
        diagnostic data element DIDG_OLD: array-size-semantics=FIXED-SIZE, max-number-of-elements=467, implementation-data-type=tBYTE
    DIDG_OLD_List: id=54296
      diagnostic-parameter bit-offset=0:
        diagnostic data element DIDG_OLD_List: array-size-semantics=FIXED-SIZE, max-number-of-elements=620, implementation-data-type=tBYTE
package /RootP_DcmDesc
  diagnostic read data by identifier DIDG_APV_Read: access-permission=AP_All, data-identifier=DIDG_APV, read-class=ReadDataByIdentifierClass
  diagnostic write data by identifier DIDG_APV_Write: access-permission=AP_All, data-identifier=DIDG_APV, write-class=WriteDataByIdentifierClass
  diagnostic read data by identifier DIDG_APV_List_Read: access-permission=AP_All, data-identifier=DIDG_APV_List, read-class=ReadDataByIdentifierClass
  diagnostic read data by identifier DIDG_CodeUce_Read: access-permission=AP_All, data-identifier=DIDG_CodeUce, read-class=ReadDataByIdentifierClass
  diagnostic write data by identifier DIDG_CodeUce_Write: access-permission=AP_All, data-identifier=DIDG_CodeUce, write-class=WriteDataByIdentifierClass
  diagnostic read data by identifier DIDG_CodeUce_List_Read: access-permission=AP_All, data-identifier=DIDG_CodeUce_List, read-class=ReadDataByIdentifierClass
  diagnostic read data by identifier DIDG_DCONF_Read: access-permission=AP_All, data-identifier=DIDG_DCONF, read-class=ReadDataByIdentifierClass
  diagnostic write data by identifier DIDG_DCONF_Write: access-permission=AP_All, data-identifier=DIDG_DCONF, write-class=WriteDataByIdentifierClass
  diagnostic read data by identifier DIDG_DCONF_List_Read: access-permission=AP_All, data-identifier=DIDG_DCONF_List, read-class=ReadDataByIdentifierClass
  diagnostic read data by identifier DIDG_DCONF_SEC_Read: access-permission=AP_All, data-identifier=DIDG_DCONF_SEC, read-class=ReadDataByIdentifierClass
  diagnostic write data by identifier DIDG_DCONF_SEC_Write: access-permission=AP_All, data-identifier=DIDG_DCONF_SEC, write-class=WriteDataByIdentifierClass
  7 x diagnostic read data by identifier, all with access-permission=AP_All, read-class=ReadDataByIdentifierClass:
    DIDG_DCONF_SEC_List_Read: data-identifier=DIDG_DCONF_SEC_List
    DIDG_STD_ASSEMBLY_FACTORY_Read: data-identifier=DIDG_STD_ASSEMBLY_FACTORY
    DIDG_STD_ASSEMBLY_FACTORY_List_Read: data-identifier=DIDG_STD_ASSEMBLY_FACTORY_List
    DIDG_ETUDE_Read: data-identifier=DIDG_ETUDE
    DIDG_ETUDE_List_Read: data-identifier=DIDG_ETUDE_List
    DIDG_OLD_Read: data-identifier=DIDG_OLD
    DIDG_OLD_List_Read: data-identifier=DIDG_OLD_List
