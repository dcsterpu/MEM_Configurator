AUTOSAR XML (schema 4-2-2)
package /RootP_DemDesc
  diagnostic enable condition group ActiveCanBody: enable-conditions=[ActiveCanBody3, ActiveCanBody4, ActiveCanBody5, ActiveCanBody6, ActiveCanBody7]
  6 x diagnostic enable condition, all with init-value=false:
    ActiveCanBody{3..7}
    ActiveCanBody9
  diagnostic enable condition group ActiveCanPwt: enable-conditions=[ActiveCanPwt1, ActiveCanPwt2]
  diagnostic enable condition ActiveCanPwt1: init-value=false
  diagnostic enable condition ActiveCanPwt2: init-value=false
  diagnostic enable condition ActiveCanPwt8: init-value=false
  diagnostic enable condition group ActiveLin: enable-conditions=[ActiveLin1, ActiveLin2, ActiveLin3, ActiveLin4, ActiveLin5]
  8 x diagnostic enable condition, all with init-value=false:
    ActiveLin{1..8}
  diagnostic enable condition group DoCanBody: enable-conditions=[DoCanBody_3, DoCanBody_4, DoCanBody_5, DoCanBody_6, DoCanBody_7]
  6 x diagnostic enable condition, all with init-value=false:
    DoCanBody_{3..7}
    DoCanBody_9
  diagnostic enable condition group DoCanPwt: enable-conditions=[DoCanPwt_1, DoCanPwt_2]
  diagnostic enable condition DoCanPwt_1: init-value=false
  diagnostic enable condition DoCanPwt_2: init-value=false
  diagnostic enable condition DoCanPwt_8: init-value=false
  diagnostic enable condition group DoLin: enable-conditions=[DoLin_1, DoLin_2, DoLin_3, DoLin_4, DoLin_5]
  9 x diagnostic enable condition, all with init-value=false:
    DoLin_{1..8}
    CmmMonitoring
package /RootP_DiagDesc
  diagnostic contribution set DiagContributionSet: category=DIAGNOSTICS_ECU_EXTRACT
    elements:
      ActiveLin
      ActiveCanPwt
      ActiveCanBody
      ActiveLin{1..8}
      ActiveCanPwt1
      ActiveCanPwt2
      ActiveCanBody{3..7}
      ActiveCanPwt8
      ActiveCanBody9
      DoCanBody
      DoLin
      DoCanPwt
      DoLin_{1..8}
      DoCanPwt_1
      DoCanPwt_2
      DoCanPwt_8
      DoCanBody_{3..7}
      DoCanBody_9
      CmmMonitoring
