AUTOSAR XML (schema 4-2-2)
package /RootP_NetworkDesc/CONFIG
  can tp config CanTpConfig: communication-cluster=DIAG, can-tp-ecu{cycle-time-main-function=0.005, ecu-instance=VSM}
    can tp address CanTpAddress_Dcm: tp-address=0
    can tp channel CanTpChannel_Dcm: channel-id=1, channel-mode=FULL-DUPLEX-MODE
    can-tp-connection addressing-format=STANDARD, can-tp-channel=CanTpChannel_Dcm, cancellation=false, data-pdu=NPdu_RxNPduDcm, flow-control-pdu=NPdu_TxNPduDcm, max-block-size=0, padding-activation=false, receiver=CanTpNode_Dcm, timeout-br=1.0, timeout-bs=0.0, timeout-cr=1.0, timeout-cs=0.0, tp-sdu=DcmIPdu_RxDcmIPduDcm, transmit-cancellation=false, transmitter=CanTpNode_Dcm:
      ident DcmIPdu_RxDcmIPduDcm
    can-tp-connection addressing-format=STANDARD, can-tp-channel=CanTpChannel_Dcm, cancellation=false, data-pdu=NPdu_TxNPduDcm, flow-control-pdu=NPdu_RxNPduDcm, max-block-size=0, padding-activation=false, receiver=CanTpNode_Dcm, timeout-br=0.0, timeout-bs=1.0, timeout-cr=0.0, timeout-cs=1.0, tp-sdu=DcmIPdu_TxDcmIPduDcm, transmit-cancellation=false, transmitter=CanTpNode_Dcm:
      ident DcmIPdu_TxDcmIPduDcm
    can tp node CanTpNode_Dcm: connector=cc_VSM_DIAG, max-fc-wait=255, st-min=0.005, timeout-ar=1.0, timeout-as=1.0, tp-address=CanTpAddress_Dcm
package /RootP_NetworkDesc/PDUS
  dcm i pdu DoIpDcmRxPduRequest: length=4095, diag-pdu-type=DIAG-REQUEST
  dcm i pdu DoIpDcmRxPduRequestFunctional: length=4095, diag-pdu-type=DIAG-REQUEST
  dcm i pdu DoIpDcmTxPduResponse: length=4095, diag-pdu-type=DIAG-RESPONSE
  general purpose pdu DoIpSoAdRxPduTcp: category=DoIP, length=1472, meta-data-length=0
  general purpose pdu DoIpSoAdTxPduTcp: category=DoIP, length=1472, meta-data-length=0
  general purpose pdu DoIpSoAdRxPduTcp_2: category=DoIP, length=1472, meta-data-length=0
  general purpose pdu DoIpSoAdTxPduTcp_2: category=DoIP, length=1472, meta-data-length=0
  general purpose pdu DoIpSoAdRxPduVehicleIdentificationRequestUdp: category=DoIP, length=1472, meta-data-length=0
  general purpose pdu DoIpSoAdTxPduVehicleIdentificationResponseUdp: category=DoIP, length=4095, meta-data-length=0
  general purpose pdu DoIpSoAdTxPduVehiculeAnnoucementResponseUdp: category=DoIP, length=4095, meta-data-length=0
  general purpose pdu DoIpSoAdRxPduBroadcastDirectedVehicleIdentificationRequestUdp: category=DoIP, length=1472, meta-data-length=0
  general purpose pdu DoIpSoAdTxPduBroadcastDirectedVehicleIdentificationResponseUdp: category=DoIP, length=4095, meta-data-length=0
  general purpose pdu DoIpSoAdRxPduBroadcastLimitedVehicleIdentificationRequestUdp: category=DoIP, length=1472, meta-data-length=0
  general purpose pdu DoIpSoAdTxPduBroadcastLimitedVehicleIdentificationResponseUdp: category=DoIP, length=4095, meta-data-length=0
package /RootP_NetworkDesc/CLUSTERS
  ethernet cluster ETH_DIAG: speed=10000
    ethernet physical channel ETH_DIAG_Channel: comm-connectors=[cc_OUTIL_DIAG_ETH, cc_VSM_ETH]
      pdu triggering ipt_DoIpDcmRxPduRequest: pdu=DoIpDcmRxPduRequest
      pdu triggering ipt_DoIpDcmRxPduRequestFunc: pdu=DoIpDcmRxPduRequestFunctional
      pdu triggering ipt_DoIpDcmTxPduResponse: pdu=DoIpDcmTxPduResponse
      pdu triggering ipt_DoIpSoAdRxPduTcp: pdu=DoIpSoAdRxPduTcp
      pdu triggering ipt_DoIpSoAdRxPduTcp2: pdu=DoIpSoAdRxPduTcp_2
      pdu triggering ipt_DoIpSoAdRxPduVehicleIdentificationRequestUdp: pdu=DoIpSoAdRxPduVehicleIdentificationRequestUdp
      pdu triggering ipt_DoIpSoAdTxPduTcp: pdu=DoIpSoAdTxPduTcp
      pdu triggering ipt_DoIpSoAdTxPduTcp_2: pdu=DoIpSoAdTxPduTcp_2
      pdu triggering ipt_DoIpSoAdTxPduVehicleIdentificationResponseUdp: pdu=DoIpSoAdTxPduVehicleIdentificationResponseUdp
      pdu triggering ipt_DoIpSoAdTxPduVehiculeAnnoucementResponseUdp: pdu=DoIpSoAdTxPduVehiculeAnnoucementResponseUdp
      pdu triggering ipt_DoIpSoAdTxPduBroadcastDirectedVehicleIdentificationRequestUdp: pdu=DoIpSoAdTxPduBroadcastDirectedVehicleIdentificationResponseUdp
      pdu triggering ipt_DoIpSoAdRxPduBroadcastDirectedVehicleIdentificationRequestUdp: pdu=DoIpSoAdRxPduBroadcastDirectedVehicleIdentificationRequestUdp
      pdu triggering ipt_DoIpSoAdTxPduBroadcastLimitedVehicleIdentificationRequestUdp: pdu=DoIpSoAdTxPduBroadcastLimitedVehicleIdentificationResponseUdp
      pdu triggering ipt_DoIpSoAdRxPduBroadcastLimitedVehicleIdentificationRequestUdp: pdu=DoIpSoAdRxPduBroadcastLimitedVehicleIdentificationRequestUdp
      4 x network endpoint:
        SocketAddress_OUTIL_DIAG_NEP: fully-qualified-domain-name=IP_OUTIL_DIAG, infrastructure-services=do-ip-entity=do-ip-entity-role=NODE, network-endpoint-addresses=ipv-4-configuration={assignment-priority=1, ip-address-keep-behavior=FORGET, ipv-4-address=192.168.254.2, ipv-4-address-source=FIXED, network-mask=255.255.255.0, ttl=64}
        SocketAddress_VSM_NEP: fully-qualified-domain-name=IP_VSM
          network-endpoint-addresses:
            assignment-priority=1, default-gateway=255.255.255.255, ip-address-keep-behavior=FORGET, ipv-4-address=192.168.254.1, ipv-4-address-source=DHCPV-4, network-mask=255.255.255.0, ttl=64
            assignment-priority=2, default-gateway=255.255.255.255, ip-address-keep-behavior=FORGET, ipv-4-address=192.168.254.1, ipv-4-address-source=FIXED, network-mask=255.255.255.0, ttl=64
            assignment-priority=3, default-gateway=255.255.255.255, ip-address-keep-behavior=FORGET, ipv-4-address=192.168.254.1, ipv-4-address-source=AUTO-IP--DOIP, network-mask=255.255.255.0, ttl=64
        SocketAddress_BroadcastDirectedVSM_NEP: fully-qualified-domain-name=IP_BroadcastDirecteded, network-endpoint-addresses=ipv-4-configuration={assignment-priority=1, default-gateway=255.255.255.255, ip-address-keep-behavior=FORGET, ipv-4-address=192.168.254.255, ipv-4-address-source=FIXED}
        SocketAddress_BroadcastLimitedVSM_NEP: fully-qualified-domain-name=IP_BroadcastLimited, network-endpoint-addresses=ipv-4-configuration={assignment-priority=1, default-gateway=255.255.255.255, ip-address-keep-behavior=FORGET, ipv-4-address=255.255.255.255, ipv-4-address-source=FIXED}
      so-ad-config:
        6 x socket connection bundle:
          SocketConnectionBundleDOIP_BroadcastLimitedVehicleIdentification_UDP:
            socket-connection{autosar-connector=DO-IP, client-ip-addr-from-connection-request=true, client-port-from-connection-request=true, client-port=SocketAddress_OUTIL_DIAG_UDP_BroadcastLimitedVehicleIdentification_DOIP, do-ip-source-address=LogicAddressVSM, do-ip-target-address=LogicAddressTool, local-port=SocketAddress_BroadcastLimitedVSM_UDP_DOIP_VehicleIdentification, pdus=socket-connection-ipdu-identifier={pdu-collection-trigger=ALWAYS, pdu=DoIpSoAdTxPduBroadcastLimitedVehicleIdentificationResponseUdp, pdu-triggering=ipt_DoIpSoAdTxPduBroadcastLimitedVehicleIdentificationRequestUdp}, remote-port=SocketAddress_OUTIL_DIAG_UDP_BroadcastLimitedVehicleIdentification_DOIP, runtime-ip-address-configuration=SD, runtime-port-configuration=SD, short-label=SocketConnectionDOIP_BroadcastLimitedVehicleIdentification_UDP, socket-protocol=UDP}
            pdus=socket-connection-ipdu-identifier={pdu-collection-trigger=ALWAYS, pdu=DoIpSoAdRxPduBroadcastLimitedVehicleIdentificationRequestUdp, pdu-triggering=ipt_DoIpSoAdRxPduBroadcastLimitedVehicleIdentificationRequestUdp}
            server-port=SocketAddress_BroadcastLimitedVSM_UDP_DOIP_VehicleIdentification
          SocketConnectionBundleDOIP_BroadcastDirectedVehicleIdentification_UDP:
            socket-connection{autosar-connector=DO-IP, client-ip-addr-from-connection-request=false, client-port-from-connection-request=false, client-port=SocketAddress_OUTIL_DIAG_UDP_BroadcastDirectedVehicleIdentification_DOIP, do-ip-source-address=LogicAddressVSM, do-ip-target-address=LogicAddressTool, local-port=SocketAddress_BroadcastDirectedVSM_UDP_DOIP_VehicleIdentification, pdus=socket-connection-ipdu-identifier={pdu-collection-trigger=ALWAYS, pdu=DoIpSoAdTxPduBroadcastDirectedVehicleIdentificationResponseUdp, pdu-triggering=ipt_DoIpSoAdTxPduBroadcastDirectedVehicleIdentificationRequestUdp}, remote-port=SocketAddress_OUTIL_DIAG_UDP_BroadcastDirectedVehicleIdentification_DOIP, runtime-ip-address-configuration=NONE, runtime-port-configuration=SD, short-label=SocketConnectionDOIP_BroadcastDirectedVehicleIdentification_UDP, socket-protocol=UDP}
            pdus=socket-connection-ipdu-identifier={pdu-collection-trigger=ALWAYS, pdu=DoIpSoAdRxPduBroadcastDirectedVehicleIdentificationRequestUdp, pdu-triggering=ipt_DoIpSoAdRxPduBroadcastDirectedVehicleIdentificationRequestUdp}
            server-port=SocketAddress_BroadcastDirectedVSM_UDP_DOIP_VehicleIdentification
          SocketConnectionBundleDOIP_VehicleIdentification_UDP:
            socket-connection{autosar-connector=DO-IP, client-ip-addr-from-connection-request=false, client-port-from-connection-request=false, client-port=SocketAddress_OUTIL_DIAG_UDP_VehicleId_DOIP, do-ip-source-address=LogicAddressVSM, do-ip-target-address=LogicAddressTool, local-port=SocketAddress_VSM_UDP_DOIP_VehicleIdentification, pdus=socket-connection-ipdu-identifier={pdu-collection-trigger=ALWAYS, pdu=DoIpSoAdTxPduVehicleIdentificationResponseUdp, pdu-triggering=ipt_DoIpSoAdTxPduVehicleIdentificationResponseUdp}, remote-port=SocketAddress_OUTIL_DIAG_UDP_VehicleId_DOIP, runtime-ip-address-configuration=NONE, runtime-port-configuration=SD, short-label=SocketConnectionDOIP_VehicleIdentification_UDP, socket-protocol=UDP}
            pdus=socket-connection-ipdu-identifier={pdu-collection-trigger=ALWAYS, pdu=DoIpSoAdRxPduVehicleIdentificationRequestUdp, pdu-triggering=ipt_DoIpSoAdRxPduVehicleIdentificationRequestUdp}
            server-port=SocketAddress_VSM_UDP_DOIP_VehicleIdentification
          SocketConnectionBundleDOIP_VehicleAnnouncement_UDP: socket-connection{autosar-connector=DO-IP, client-ip-addr-from-connection-request=false, client-port-from-connection-request=false, client-port=SocketAddress_Broadcast_UDP_VehicleAnnouncement_DOIP, do-ip-source-address=LogicAddressVSM, do-ip-target-address=LogicAddressTool, local-port=SocketAddress_Broadcast_UDP_VehicleAnnouncement_DOIP, pdus=socket-connection-ipdu-identifier={pdu-collection-trigger=ALWAYS, pdu=DoIpSoAdTxPduVehiculeAnnoucementResponseUdp, pdu-triggering=ipt_DoIpSoAdTxPduVehiculeAnnoucementResponseUdp}, remote-port=SocketAddress_Broadcast_UDP_VehicleAnnouncement_DOIP, runtime-ip-address-configuration=NONE, runtime-port-configuration=SD, short-label=SocketConnectionDOIP_VehiculeAnnoucement_UDP, socket-protocol=UDP}, server-port=SocketAddress_VSM_UDP_DOIP_VehicleAnnouncement
          SocketConnectionBundleTCP2_OUTIL_DIAGtoVSM:
            socket-connection{autosar-connector=DO-IP, client-ip-addr-from-connection-request=true, client-port-from-connection-request=true, client-port=SocketAddress_OUTIL_DIAG_TCP2_DOIP, do-ip-source-address=LogicAddressVSM, do-ip-target-address=LogicAddressTool, local-port=SocketAddress_BroadcastVSM_TCP2_DOIP, pdus=socket-connection-ipdu-identifier={pdu-collection-trigger=ALWAYS, pdu=DoIpSoAdTxPduTcp_2, pdu-triggering=ipt_DoIpSoAdTxPduTcp_2}, pdu-collection-max-buffer-size=536, runtime-ip-address-configuration=SD, runtime-port-configuration=SD, short-label=SocketConnectionDOIP_TCP2, socket-protocol=TCP}
            pdus=socket-connection-ipdu-identifier={pdu-collection-trigger=ALWAYS, pdu=DoIpSoAdRxPduTcp_2, pdu-triggering=ipt_DoIpSoAdRxPduTcp2}
            server-port=SocketAddress_BroadcastVSM_TCP2_DOIP
          SocketConnectionBundleTCP_OUTIL_DIAGtoVSM:
            socket-connection{autosar-connector=PDU-R, client-ip-addr-from-connection-request=true, client-port-from-connection-request=true, client-port=SocketAddress_OUTIL_DIAG_TCP_0, do-ip-source-address=LogicAddressVSM, do-ip-target-address=LogicAddressTool, local-port=SocketAddress_VSM_TCP_DOIP, pdus=socket-connection-ipdu-identifier={pdu-collection-trigger=ALWAYS, pdu=DoIpSoAdTxPduTcp, pdu-triggering=ipt_DoIpSoAdTxPduTcp}, pdu-collection-max-buffer-size=536, runtime-ip-address-configuration=SD, runtime-port-configuration=SD, short-label=SocketConnectionDOIP_TCP, socket-protocol=TCP}
            pdus=socket-connection-ipdu-identifier={pdu-collection-trigger=ALWAYS, pdu=DoIpSoAdRxPduTcp, pdu-triggering=ipt_DoIpSoAdRxPduTcp}
            server-port=SocketAddress_VSM_TCP_DOIP
        logic address LogicAddressVSM: address=1874
        logic address LogicAddressTool: address=3712
        19 x socket address:
          SocketAddress_Broadcast_UDP_VehicleAnnouncement_DOIP: connector=cc_VSM_ETH, ip-address=255.255.255.255, multicast-connector=cc_VSM_ETH
            application endpoint SocketAddress_Broadcast_UDP_VehicleAnnouncement_DOIP_AEP: network-endpoint=SocketAddress_BroadcastLimitedVSM_NEP, tp-configuration=udp-tp=udp-tp-port=port-number=13400
          SocketAddress_VSM_UDP: connector=cc_VSM_ETH
            application endpoint SocketAddress_VSM_UDP_50000_AEP: network-endpoint=SocketAddress_VSM_NEP, tp-configuration=udp-tp=udp-tp-port=port-number=50000
          SocketAddress_VSM_UDP_DOIP_VehicleIdentification: connector=cc_VSM_ETH
            application endpoint SocketAddress_VSM_UDP_DOIP_VehicleIdentification_AEP: network-endpoint=SocketAddress_VSM_NEP, tp-configuration=udp-tp=udp-tp-port=port-number=13400
          SocketAddress_BroadcastDirectedVSM_UDP_DOIP_VehicleIdentification: connector=cc_VSM_ETH
            application endpoint SocketAddress_BroadcastDirectedVSM_UDP_DOIP_VehicleIdentification_AEP: network-endpoint=SocketAddress_BroadcastDirectedVSM_NEP, tp-configuration=udp-tp=udp-tp-port=port-number=13400
          SocketAddress_BroadcastLimitedVSM_UDP_DOIP_VehicleIdentification: connector=cc_VSM_ETH
            application endpoint SocketAddress_BroadcastLimitedVSM_UDP_DOIP_VehicleIdentification_AEP: network-endpoint=SocketAddress_BroadcastLimitedVSM_NEP, tp-configuration=udp-tp=udp-tp-port=port-number=13400
          SocketAddress_BroadcastVSM_TCP2_DOIP: connector=cc_VSM_ETH, ip-address=255.255.255.255
            application endpoint SocketAddress_BroadcastVSM_TCP2_DOIP: network-endpoint=SocketAddress_BroadcastLimitedVSM_NEP, tp-configuration=tcp-tp=tcp-tp-port=port-number=13400
          SocketAddress_VSM_UDP_DOIP_VehicleAnnouncement: connector=cc_VSM_ETH
            application endpoint SocketAddress_VSM_UDP_DOIP_VehicleAnnouncement_AEP: network-endpoint=SocketAddress_VSM_NEP, tp-configuration=udp-tp=udp-tp-port=port-number=13400
          SocketAddress_VSM_TCP: connector=cc_VSM_ETH
            application endpoint SocketAddress_VSM_TCP_50020_AEP: network-endpoint=SocketAddress_VSM_NEP, tp-configuration=tcp-tp=tcp-tp-port=port-number=50020
          SocketAddress_VSM_TCP_DOIP: connector=cc_VSM_ETH
            application endpoint SocketAddress_VSM_TCP_DOIP_AEP: network-endpoint=SocketAddress_VSM_NEP, tp-configuration=tcp-tp=tcp-tp-port=port-number=13400
          SocketAddress_Broadcast_TCP2_DOIP: connector=cc_OUTIL_DIAG_ETH, ip-address=255.255.255.255
            application endpoint SocketAdress_Broadcast_TCP2_DOIP_AEP: network-endpoint=SocketAddress_BroadcastLimitedVSM_NEP, tp-configuration=tcp-tp=tcp-tp-port=port-number=13400
          SocketAddress_OUTIL_DIAG_TCP_0: connector=cc_OUTIL_DIAG_ETH
            application endpoint SocketAddress_OUTIL_DIAG_TCP_0_AEP: network-endpoint=SocketAddress_OUTIL_DIAG_NEP, tp-configuration=tcp-tp=tcp-tp-port=port-number=0
          SocketAddress_OUTIL_DIAG_TCP2: connector=cc_OUTIL_DIAG_ETH
            application endpoint SocketAddress_OUTIL_DIAG_TCP2_0_AEP: network-endpoint=SocketAddress_OUTIL_DIAG_NEP, tp-configuration=tcp-tp=tcp-tp-port=port-number=0
          SocketAddress_OUTIL_DIAG_TCP2_DOIP: connector=cc_OUTIL_DIAG_ETH
            application endpoint SocketAddress_OUTIL_DIAG_TCP2_DOIP_AEP: network-endpoint=SocketAddress_OUTIL_DIAG_NEP, tp-configuration=tcp-tp=tcp-tp-port=port-number=13400
          SocketAddress_OUTIL_DIAG_TCP_DOIP: connector=cc_OUTIL_DIAG_ETH
            application endpoint SocketAddress_OUTIL_DIAG_TCP_DOIP_AEP: network-endpoint=SocketAddress_OUTIL_DIAG_NEP, tp-configuration=tcp-tp=tcp-tp-port=port-number=49152
          SocketAddress_OUTIL_DIAG_UDP: connector=cc_OUTIL_DIAG_ETH
            application endpoint SocketAddress_OUTIL_DIAG_UDP_60000_AEP: network-endpoint=SocketAddress_OUTIL_DIAG_NEP, tp-configuration=udp-tp=udp-tp-port=port-number=60000
          SocketAddress_OUTIL_DIAG_UDP_VehicleAnnouncement_DOIP: connector=cc_OUTIL_DIAG_ETH
            application endpoint SocketAddress_OUTIL_DIAG_UDP_VehicleAnnouncement_DOIP_AEP: network-endpoint=SocketAddress_OUTIL_DIAG_NEP, tp-configuration=udp-tp=udp-tp-port=port-number=13400
          SocketAddress_OUTIL_DIAG_UDP_VehicleId_DOIP: connector=cc_OUTIL_DIAG_ETH
            application endpoint SocketAddress_OUTIL_DIAG_UDP_VehicleId_DOIP_AEP: network-endpoint=SocketAddress_OUTIL_DIAG_NEP, tp-configuration=udp-tp=udp-tp-port=port-number=49152
          SocketAddress_OUTIL_DIAG_UDP_BroadcastDirectedVehicleIdentification_DOIP: connector=cc_OUTIL_DIAG_ETH
            application endpoint SocketAddress_OUTIL_DIAG_UDP_BroadcastDirectedVehicleId_DOIP_AEP: network-endpoint=SocketAddress_OUTIL_DIAG_NEP, tp-configuration=udp-tp=udp-tp-port=port-number=49152
          SocketAddress_OUTIL_DIAG_UDP_BroadcastLimitedVehicleIdentification_DOIP: connector=cc_OUTIL_DIAG_ETH
            application endpoint SocketAddress_OUTIL_DIAG_UDP_BroadcastLimitedVehicleId_DOIP_AEP: network-endpoint=SocketAddress_OUTIL_DIAG_NEP, tp-configuration=udp-tp=udp-tp-port=port-number=49152
package /RootP_NetworkDesc/IPDUGROUP
  i signal i pdu group IPDUGROUP_ETH_APPLICATION_RX: communication-direction=IN, communication-mode=IPDUGROUP_ETH_APPLICATION_RX
  i signal i pdu group IPDUGROUP_ETH_APPLICATION_TX: communication-direction=OUT, communication-mode=IPDUGROUP_ETH_APPLICATION_TX
