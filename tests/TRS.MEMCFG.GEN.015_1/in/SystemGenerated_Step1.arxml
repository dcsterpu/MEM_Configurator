AUTOSAR XML (schema 4-2-2)
package /RootP_NetworkDesc
  system VSM_System: system-version=4.0.3
    root-software-compositions:
      root sw composition prototype RootCompositionVSM: software-composition=Compo_VSM
package /RootP_Composition
  composition sw component type Compo_VSM
    260 x component:
      Instance_Aswc_IntDcm: type=Aswc_IntDcm
      Instance_ASWC_DISPATCH_CORE0_SWPQM: type=ASWC_DISPATCH_CORE0_SWPQM
      Instance_ASWC_DISPATCH_CORE1_AppASILA: type=ASWC_DISPATCH_CORE1_AppASILA
      Instance_ASWC_DISPATCH_CORE1_AppASILB: type=ASWC_DISPATCH_CORE1_AppASILB
      Instance_ASWC_SATELLITE_CORE0_SWPQM: type=ASWC_SATELLITE_CORE0_SWPQM
      Instance_ASWC_SATELLITE_CORE1_AppASILA: type=ASWC_SATELLITE_CORE1_AppASILA
      Instance_ASWC_SATELLITE_CORE1_AppASILB: type=ASWC_SATELLITE_CORE1_AppASILB
      Instance_ASWC_SATELLITE_CORE1_MonitoringASILB: type=ASWC_SATELLITE_CORE1_MonitoringASILB
      Instance_ASWC_AccessVehicle: type=ASWC_AccessVehicle
      Instance_PSWC_ParamDefinition: type=PSWC_ParamDefinition
      Instance_ASWC_CLIM: type=ASWC_CLIM
      Instance_ASWC_EclAvant: type=ASWC_EclAvant
      Instance_ASWC_LoiJaugeCarb: type=ASWC_LoiJaugeCarb
      Instance_ASWC_LoiJaugeHuile: type=ASWC_LoiJaugeHuile
      Instance_ASWC_Silhouette: type=ASWC_Silhouette
      Instance_IoHwAb: type=IoHwAb
      Instance_Time: type=Time
      Instance_TRP: type=TRP
      Instance_WipM: type=WipM
      Instance_ASWC_FAST: type=ASWC_FAST
      Instance_BSWC_CCL: type=BSWC_CCL
      Instance_BSWC_CSM: type=BSWC_CSM
      Instance_BSWC_E2EManager_Satellite_CORE0_MonitoringASILB: type=BSWC_E2EManager_Satellite_CORE0_MonitoringASILB
      Instance_BSWC_E2EManager_Satellite_CORE0_SWPQM: type=BSWC_E2EManager_Satellite_CORE0_SWPQM
      Instance_BSWC_E2EManager_Satellite_CORE1_APPASILA: type=BSWC_E2EManager_Satellite_CORE1_APPASILA
      Instance_BSWC_E2EManager_Satellite_CORE1_APPASILB: type=BSWC_E2EManager_Satellite_CORE1_APPASILB
      Instance_BSWC_E2EManager_Satellite_CORE1_MonitoringASILB: type=BSWC_E2EManager_Satellite_CORE1_MonitoringASILB
      Instance_BSWC_NeMo_SAT_CORE0_MonitoringASILB: type=BSWC_NeMo_SAT_CORE0_MonitoringASILB
      Instance_BSWC_NeMo_SAT_CORE0_SWPQM: type=BSWC_NeMo_SAT_CORE0_SWPQM
      Instance_BSWC_NeMo_SAT_CORE1_APPASILA: type=BSWC_NeMo_SAT_CORE1_APPASILA
      Instance_BSWC_NeMo_SAT_CORE1_APPASILB: type=BSWC_NeMo_SAT_CORE1_APPASILB
      Instance_BSWC_NeMo_SAT_CORE1_MonitoringASILB: type=BSWC_NeMo_SAT_CORE1_MonitoringASILB
      Instance_STUB_BSWM_CORE0_MonitoringASILB: type=STUB_BSWM_CORE0_MonitoringASILB
      Instance_STUB_BSWM_CORE1_AppASILA: type=STUB_BSWM_CORE1_AppASILA
      Instance_STUB_BSWM_CORE1_AppASILB: type=STUB_BSWM_CORE1_AppASILB
      Instance_STUB_BSWM_CORE1_MonitoringASILB: type=STUB_BSWM_CORE1_MonitoringASILB
      Instance_BSWC_CFHM_SAT_CORE0_MonitoringASILB: type=BSWC_CFHM_SAT_CORE0_MonitoringASILB
      Instance_BSWC_CFHM_SAT_CORE1_APPASILA: type=BSWC_CFHM_SAT_CORE1_APPASILA
      Instance_BSWC_CFHM_SAT_CORE1_APPASILB: type=BSWC_CFHM_SAT_CORE1_APPASILB
      Instance_BSWC_CFHM_SAT_CORE1_MonitoringASILB: type=BSWC_CFHM_SAT_CORE1_MonitoringASILB
      Instance_BSWC_EnGw: type=BSWC_EnGw
      Instance_BSWC_NvDM_Satellite_CORE0_MonitoringASILB: type=BSWC_NvDM_Satellite_CORE0_MonitoringASILB
      Instance_BSWC_NvDM_Satellite_CORE0_SWPQM: type=BSWC_NvDM_Satellite_CORE0_SWPQM
      Instance_BSWC_NvDM_Satellite_CORE1_APPASILA: type=BSWC_NvDM_Satellite_CORE1_APPASILA
      Instance_BSWC_NvDM_Satellite_CORE1_APPASILB: type=BSWC_NvDM_Satellite_CORE1_APPASILB
      Instance_BSWC_NvDM_Satellite_CORE1_MonitoringASILB: type=BSWC_NvDM_Satellite_CORE1_MonitoringASILB
      Instance_Gliwa_T1_Core0: type=Gliwa_T1_Core0
      Instance_Gliwa_T1_Core1: type=Gliwa_T1_Core1
      Instance_BSWC_CFHM: type=BSWC_CFHM
      Instance_BSWC_LPhM: type=BSWC_LPhM
      Instance_BSWC_NeMo: type=BSWC_NeMo
      Instance_BSWC_NvDM: type=BSWC_NvDM
      Instance_BSWC_E2EManager_Rx: type=BSWC_E2EManager_Rx
      Instance_BSWC_E2EManager_Tx: type=BSWC_E2EManager_Tx
      Instance_ASWC_MCOM: type=ASWC_MCOM
      Instance_ASWC_A11: type=ASWC_A11
      Instance_ASWC_M130: type=ASWC_M130
      Instance_ASWC_M131: type=ASWC_M131
      Instance_ASWC_M{133..137}: type=ASWC_M{133..137}
      Instance_ASWC_M139: type=ASWC_M139
      Instance_ASWC_M13A: type=ASWC_M13A
      Instance_ASWC_M13B: type=ASWC_M13B
      Instance_ASWC_M13C: type=ASWC_M13C
      Instance_ASWC_M150: type=ASWC_M150
      Instance_ASWC_M180: type=ASWC_M180
      Instance_ASWC_P11: type=ASWC_P11
      Instance_ASWC_A{211..214}: type=ASWC_A{211..214}
      Instance_ASWC_A28: type=ASWC_A28
      Instance_ASWC_M220: type=ASWC_M220
      Instance_ASWC_M230: type=ASWC_M230
      Instance_ASWC_M231: type=ASWC_M231
      Instance_ASWC_M{240..244}: type=ASWC_M{240..244}
      Instance_ASWC_M260: type=ASWC_M260
      Instance_ASWC_M261: type=ASWC_M261
      Instance_ASWC_M263: type=ASWC_M263
      Instance_ASWC_M270: type=ASWC_M270
      Instance_ASWC_M271: type=ASWC_M271
      Instance_ASWC_M290: type=ASWC_M290
      Instance_ASWC_P21: type=ASWC_P21
      Instance_ASWC_P28: type=ASWC_P28
      Instance_ASWC_M{300..303}: type=ASWC_M{300..303}
      Instance_ASWC_M{310..312}: type=ASWC_M{310..312}
      Instance_ASWC_M330: type=ASWC_M330
      Instance_ASWC_M340: type=ASWC_M340
      Instance_ASWC_M{350..354}: type=ASWC_M{350..354}
      Instance_ASWC_M{410..419}: type=ASWC_M{410..419}
      Instance_ASWC_M41A: type=ASWC_M41A
      Instance_ASWC_M41E: type=ASWC_M41E
      Instance_ASWC_M{421..424}: type=ASWC_M{421..424}
      Instance_ASWC_M431: type=ASWC_M431
      Instance_ASWC_M432: type=ASWC_M432
      Instance_ASWC_M440: type=ASWC_M440
      Instance_ASWC_M500: type=ASWC_M500
      Instance_ASWC_M501: type=ASWC_M501
      Instance_ASWC_M{510..514}: type=ASWC_M{510..514}
      Instance_ASWC_M520: type=ASWC_M520
      Instance_ASWC_M530: type=ASWC_M530
      Instance_ASWC_M531: type=ASWC_M531
      Instance_ASWC_M539: type=ASWC_M539
      Instance_ASWC_M56B: type=ASWC_M56B
      Instance_ASWC_M570: type=ASWC_M570
      Instance_ASWC_M{610..612}: type=ASWC_M{610..612}
      Instance_ASWC_M{620..627}: type=ASWC_M{620..627}
      Instance_ASWC_M629: type=ASWC_M629
      Instance_ASWC_M631: type=ASWC_M631
      Instance_ASWC_M{633..635}: type=ASWC_M{633..635}
      Instance_ASWC_M{638..642}: type=ASWC_M{638..642}
      Instance_ASWC_A7D{1..3}: type=ASWC_A7D{1..3}
      Instance_ASWC_M700: type=ASWC_M700
      Instance_ASWC_M711: type=ASWC_M711
      Instance_ASWC_M713: type=ASWC_M713
      Instance_ASWC_M{715..717}: type=ASWC_M{715..717}
      Instance_ASWC_M{720..725}: type=ASWC_M{720..725}
      Instance_ASWC_M730: type=ASWC_M730
      Instance_ASWC_M{732..734}: type=ASWC_M{732..734}
      Instance_ASWC_M736: type=ASWC_M736
      Instance_ASWC_M{740..745}: type=ASWC_M{740..745}
      Instance_ASWC_M{750..752}: type=ASWC_M{750..752}
      Instance_ASWC_M{755..757}: type=ASWC_M{755..757}
      Instance_ASWC_M{760..770}: type=ASWC_M{760..770}
      Instance_ASWC_M{785..787}: type=ASWC_M{785..787}
      Instance_ASWC_M{790..799}: type=ASWC_M{790..799}
      Instance_ASWC_M79A: type=ASWC_M79A
      Instance_ASWC_M79B: type=ASWC_M79B
      Instance_ASWC_M79C: type=ASWC_M79C
      Instance_ASWC_M7A0: type=ASWC_M7A0
      Instance_ASWC_M7A2: type=ASWC_M7A2
      Instance_ASWC_M7B0: type=ASWC_M7B0
      Instance_ASWC_M7E{1..4}: type=ASWC_M7E{1..4}
      Instance_ASWC_M7G0: type=ASWC_M7G0
      Instance_ASWC_M7G1: type=ASWC_M7G1
      Instance_ASWC_P7D: type=ASWC_P7D
      Instance_ASWC_M{80..83}: type=ASWC_M{80..83}
      Instance_ASWC_M{841..844}: type=ASWC_M{841..844}
      Instance_ASWC_M846: type=ASWC_M846
      Instance_ASWC_M847: type=ASWC_M847
      Instance_ASWC_M85: type=ASWC_M85
      Instance_ASWC_M86: type=ASWC_M86
      Instance_ASWC_P80: type=ASWC_P80
      Instance_ASWC_M{910..913}: type=ASWC_M{910..913}
      Instance_ASWC_M{920..924}: type=ASWC_M{920..924}
      Instance_ASWC_M926: type=ASWC_M926
      Instance_ASWC_M930: type=ASWC_M930
      Instance_ASWC_M{940..942}: type=ASWC_M{940..942}
      Instance_ASWC_M945: type=ASWC_M945
      Instance_ASWC_M950: type=ASWC_M950
      Instance_ASWC_F1: type=ASWC_F1
      Instance_ASWC_F30: type=ASWC_F30
      Instance_ASWC_F3: type=ASWC_F3
      Instance_ASWC_FuDI: type=ASWC_FuDI
