AUTOSAR XML (schema 4-3-0)
package /RootP_DcmDesc
  diagnostic clear diagnostic information class ClearDiagnosticInformationClass: access-permission-validity=ACCESS-PERMISSION-SERVICE-INSTANCE
  diagnostic control dtc setting class ControlDTCSettingClass: access-permission-validity=ACCESS-PERMISSION-SERVICE-INSTANCE, control-option-record-present=true
  diagnostic ecu reset class DiagnosticEcuResetClass: access-permission-validity=ACCESS-PERMISSION-SERVICE-INSTANCE
  diagnostic security access class DiagnosticSecurityAccessClass: access-permission-validity=ACCESS-PERMISSION-SERVICE-INSTANCE
  diagnostic session control class DiagnosticSessionControlClass: access-permission-validity=ACCESS-PERMISSION-SERVICE-INSTANCE
  diagnostic session control class DiagnosticSessionControlDoIPClass: access-permission-validity=ACCESS-PERMISSION-SERVICE-INSTANCE
  diagnostic io control class IoControlClass: access-permission-validity=ACCESS-PERMISSION-SERVICE-INSTANCE
  diagnostic memory identifier RAM_CPU0: id=0, memory-high-address=0x70038000, memory-high-address-label=0x70038000, memory-low-address=0x70000000, memory-low-address-label=0x70000000
  diagnostic read data by identifier class ReadDataByIdentifierClass: access-permission-validity=ACCESS-PERMISSION-SERVICE-INSTANCE, max-did-to-read=65535
  diagnostic read dtc information class ReadDtcInformationClass: access-permission-validity=ACCESS-PERMISSION-SERVICE-INSTANCE
  diagnostic read memory by address ReadMemoryByAddress: memory-range=RAM_CPU0, read-class=ReadMemoryByAddressClass
  diagnostic read memory by address class ReadMemoryByAddressClass: access-permission-validity=ACCESS-PERMISSION-SERVICE-INSTANCE
  diagnostic routine control class RoutineControlClass: access-permission-validity=ACCESS-PERMISSION-SERVICE-INSTANCE
  diagnostic write data by identifier class WriteDataByIdentifierClass: access-permission-validity=ACCESS-PERMISSION-SERVICE-INSTANCE
  diagnostic write memory by address WriteMemoryByAddress: memory-range=RAM_CPU0, write-class=WriteMemoryByAddressClass
  diagnostic write memory by address class WriteMemoryByAddressClass: access-permission-validity=ACCESS-PERMISSION-SERVICE-INSTANCE
package /RootP_DiagDesc
  diagnostic access permission AP_All: diagnostic-session=[DCM_DEFAULT_SESSION, DCM_EXTENDED_DIAGNOSTIC_SESSION, DCM_PROGRAMMING_SESSION, DCM_SAFETY_SYSTEM_DIAGNOSTIC_SESSION]
  4 x diagnostic session, all with jump-to-boot-loader=NO-BOOT, p-2-server-max=0.2, p-2-star-server-max=0.2:
    DCM_DEFAULT_SESSION: id=1
    DCM_EXTENDED_DIAGNOSTIC_SESSION: id=3
    DCM_PROGRAMMING_SESSION: id=2
    DCM_SAFETY_SYSTEM_DIAGNOSTIC_SESSION: id=4
  diagnostic connection DiagConnectionDcm: physical-request=DcmIPdu_RxDcmIPduDcm, response=DcmIPdu_TxDcmIPduDcm
  diagnostic contribution set DiagContributionSet: category=DIAGNOSTICS_ECU_EXTRACT, ecu-instance=VSM, service-tables=[VSM_ServicesTable, VSM_ServicesTable_DoIP]
    elements:
      WriteDataByIdentifierClass
      ReadDataByIdentifierClass
      IoControlClass
      RoutineControlClass
      ReadDtcInformationClass
      DiagnosticSessionControlClass
      ReadMemoryByAddress
      ReadMemoryByAddressClass
      WriteMemoryByAddressClass
      WriteMemoryByAddress
      DiagnosticSessionControlDefaultSession
      DiagnosticSessionControlExtendedSession
      DiagnosticSessionControlProgrammingSession
      DiagnosticSessionControlSafetySystemDiagnosticSession
      DiagnosticSessionControlDefaultSession_DoIP
      DiagnosticSessionControlExtendedSession_DoIP
      DiagnosticSessionControlProgrammingSession_DoIP
      DiagnosticSessionControlSafetySystemDiagnosticSession_DoIP
      DCM_DEFAULT_SESSION
      DCM_EXTENDED_DIAGNOSTIC_SESSION
      DCM_PROGRAMMING_SESSION
      DCM_SAFETY_SYSTEM_DIAGNOSTIC_SESSION
      AP_All
      RAM_CPU0
      ControlDTCSettingClass
      ClearDiagnosticInformationClass
      DiagnosticEcuHardReset
      DiagnosticEcuSoftReset
      DiagnosticEcuResetClass
      DiagnosticControlDTCSettingEnableLog
      DiagnosticControlDTCSettingDisableLog
  diagnostic clear diagnostic information DiagnosticClearDiagnosticInformation: clear-diagnostic-information-class=ClearDiagnosticInformationClass
  diagnostic control dtc setting DiagnosticControlDTCSettingDisableLog: dtc-setting-class=ControlDTCSettingClass, dtc-setting-parameter=2
  diagnostic control dtc setting DiagnosticControlDTCSettingEnableLog: dtc-setting-class=ControlDTCSettingClass, dtc-setting-parameter=1
  diagnostic ecu reset DiagnosticEcuHardReset: category=HARD_RESET, ecu-reset-class=DiagnosticEcuResetClass, respond-to-reset=RESPOND-BEFORE-RESET
  diagnostic ecu reset DiagnosticEcuSoftReset: category=SOFT_RESET, ecu-reset-class=DiagnosticEcuResetClass, respond-to-reset=RESPOND-BEFORE-RESET
  4 x diagnostic read dtc information, all with read-dtc-information-class=ReadDtcInformationClass:
    DiagnosticReadDTCInformation0x01: category=REPORT_NUMBER_OF_DTC_BY_STATUS_MASK
    DiagnosticReadDTCInformation0x02: category=REPORT_DTC_BY_STATUS_MASK
    DiagnosticReadDTCInformation0x04: category=REPORT_DTC_SNAPSHOT_RECORD_BY_DTC_NUMBER
    DiagnosticReadDTCInformation0x06: category=REPORT_DTC_EXT_DATA_RECORD_BY_DTC_NUMBER
  8 x diagnostic session control:
    DiagnosticSessionControlDefaultSession: diagnostic-session=DCM_DEFAULT_SESSION, session-control-class=DiagnosticSessionControlClass
    DiagnosticSessionControlDefaultSession_DoIP: diagnostic-session=DCM_DEFAULT_SESSION, session-control-class=DiagnosticSessionControlDoIPClass
    DiagnosticSessionControlExtendedSession: diagnostic-session=DCM_EXTENDED_DIAGNOSTIC_SESSION, session-control-class=DiagnosticSessionControlClass
    DiagnosticSessionControlExtendedSession_DoIP: diagnostic-session=DCM_EXTENDED_DIAGNOSTIC_SESSION, session-control-class=DiagnosticSessionControlDoIPClass
    DiagnosticSessionControlProgrammingSession: diagnostic-session=DCM_PROGRAMMING_SESSION, session-control-class=DiagnosticSessionControlClass
    DiagnosticSessionControlProgrammingSession_DoIP: diagnostic-session=DCM_PROGRAMMING_SESSION, session-control-class=DiagnosticSessionControlDoIPClass
    DiagnosticSessionControlSafetySystemDiagnosticSession: diagnostic-session=DCM_SAFETY_SYSTEM_DIAGNOSTIC_SESSION, session-control-class=DiagnosticSessionControlClass
    DiagnosticSessionControlSafetySystemDiagnosticSession_DoIP: diagnostic-session=DCM_SAFETY_SYSTEM_DIAGNOSTIC_SESSION, session-control-class=DiagnosticSessionControlDoIPClass
  diagnostic security access SecurityLevelConfiguration: access-permission=AP_All, request-seed-id=1, security-access-class=DiagnosticSecurityAccessClass, security-level=SecurityLevel_1
  diagnostic security access SecurityLevelDownload: access-permission=AP_All, request-seed-id=2, security-access-class=DiagnosticSecurityAccessClass, security-level=SecurityLevel_2
  diagnostic security level SecurityLevel_1: access-data-record-size=0, key-size=4, num-failed-security-access=1, security-delay-time=10.0, seed-size=4
  diagnostic security level SecurityLevel_2: access-data-record-size=0, key-size=4, num-failed-security-access=1, security-delay-time=10.0, seed-size=4
