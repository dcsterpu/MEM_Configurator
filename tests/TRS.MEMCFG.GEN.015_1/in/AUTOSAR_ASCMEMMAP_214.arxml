AUTOSAR XML (schema 4-0-3)
package /AUTOSAR_MemMap/SwAddrMethods
  4 x sw addr method:
    VAR_LOCAL: memory-allocation-keyword-policy=ADDR-METHOD-SHORT-NAME-AND-ALIGNMENT, options=coreLocal, section-initialization-policy=INIT, section-type=VAR-POWER-ON-INIT
    VAR_GLOBAL: memory-allocation-keyword-policy=ADDR-METHOD-SHORT-NAME-AND-ALIGNMENT, section-initialization-policy=INIT, section-type=VAR-POWER-ON-INIT
    CONFIG_DATA_LOCAL: memory-allocation-keyword-policy=ADDR-METHOD-SHORT-NAME-AND-ALIGNMENT, options=coreLocal, section-initialization-policy=INIT, section-type=CONFIG-DATA
    CODE_LOCAL: memory-allocation-keyword-policy=ADDR-METHOD-SHORT-NAME, options=coreLocal, section-type=CODE
