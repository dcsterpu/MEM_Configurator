AUTOSAR XML (schema 4-2-2)
package /RootP_NetworkDesc/CONFIG
  diagnostic connection DiagConnectionDoIP: functional-request=Ident_DoIpDcmRxPduRequestFunctional, physical-request=Ident_DoIpDcmRxPduRequest, response=Ident_DoIpDcmTxPduResponse
  do ip tp config DoIPTpConfig: communication-cluster=ETH_DIAG
    do ip logic address LogicFunctionalAddressVSM: address=58368
    do ip logic address LogicTesterAddressTool: address=3712
    do ip logic address LogicPhysAddressVSM: address=1874
    do-ip-tp-connection do-ip-source-address=LogicTesterAddressTool, do-ip-target-address=LogicFunctionalAddressVSM, tp-sdu=ipt_DoIpDcmRxPduRequestFunc:
      ident Ident_DoIpDcmRxPduRequestFunctional
    do-ip-tp-connection do-ip-source-address=LogicTesterAddressTool, do-ip-target-address=LogicPhysAddressVSM, tp-sdu=ipt_DoIpDcmRxPduRequest:
      ident Ident_DoIpDcmRxPduRequest
    do-ip-tp-connection do-ip-source-address=LogicPhysAddressVSM, do-ip-target-address=LogicTesterAddressTool, tp-sdu=ipt_DoIpDcmTxPduResponse:
      ident Ident_DoIpDcmTxPduResponse
