AUTOSAR XML (schema 4-3-0)
package /RootP_DiagDesc
  diagnostic trouble code group BODY_DTCS: group-number=6
  diagnostic trouble code group CHASSIS_DTCS: group-number=4
  6 x diagnostic data identifier:
    DID_CONTEXTE_0xE812: id=0xe812
      diagnostic-parameter bit-offset=0:
        diagnostic data element param_E812: base-type=uint8
    DID_CONTEXTE_0xE814: id=0xe814
      diagnostic-parameter bit-offset=0:
        diagnostic data element param_E814: base-type=uint8
    DID_CONTEXTE_0xE912: id=0xe912
      diagnostic-parameter bit-offset=0:
        diagnostic data element param_E912: base-type=uint8
    DID_CONTEXTE_0xEA12: id=0xea12
      diagnostic-parameter bit-offset=0:
        diagnostic data element param_EA12: base-type=uint8
    DID_CONTEXTE_0xEB12: id=0xeb12
      diagnostic-parameter bit-offset=0:
        diagnostic data element param_EB12: base-type=uint8
    DID_CONTEXTE_0xED12: id=0xed12
      diagnostic-parameter bit-offset=0:
        diagnostic data element param_ED12: base-type=uint8
  diagnostic aging DaigAging: aging-cycles=DEM_OPCYC_POWER, threshold=10
  diagnostic contribution set DiagContributionSet: category=DIAGNOSTICS_ECU_EXTRACT, ecu-instance=VSM
    elements:
      DID_CONTEXTE_0xEB12
      DID_CONTEXTE_0xE812
      DID_CONTEXTE_0xE814
      DID_CONTEXTE_0xE912
      DID_CONTEXTE_0xEA12
      DID_CONTEXTE_0xED12
      FreezeFrames_VSM_1
      PrimaryMemory
      DiagnosticECUInstanceProps
      DiagIndicator
      BODY_DTCS
      CHASSIS_DTCS
      EMISSION_REL_DTCS
      NETWORK_COM_DTCS
      POWERTRAIN_DTCS
      DaigAging
  diagnostic indicator DiagIndicator: healing-cycle-counter-threshold=3, type=MALFUNCTION
  diagnostic trouble code group EMISSION_REL_DTCS: group-number=0
  diagnostic freeze frame FreezeFrames_VSM_1: record-number=239, trigger=CONFIRMED, update=true
  diagnostic trouble code group NETWORK_COM_DTCS: group-number=8
  diagnostic trouble code group POWERTRAIN_DTCS: group-number=2
  diagnostic memory destination primary PrimaryMemory
