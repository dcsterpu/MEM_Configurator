AUTOSAR XML (schema 4-2-1)
package /RootP_SR_Data
  54 x sender receiver interface:
    SR_AlimEmbCompCylFixe_IoFromDcm
      data AlimEmbCompCylFixe: type=tLOG, init-value=0
    SR_PilotageRechauffeurEau_IoFromDcm
      data PilotageRechauffeurEau: type=tLOG, init-value=0
    SR_AutorisationCdePulseurAR_IoFromDcm
      data AutorisationCdePulseurAR: type=tLOG, init-value=0
    SR_AutorisationCdePulseur_IoFromDcm
      data AutorisationCdePulseur: type=tLOG, init-value=0
    SR_BSI_Emb_Cde_IoFromDcm
      data BSI_Emb_Cde: type=tLOG, init-value=0
    SR_BSI_Ivanne_Cde_IoFromDcm
      data BSI_Ivanne_Cde: type=tBYTE, init-value=0
    SR_BSI_CTP_Cde_IoFromDcm
      data BSI_CTP_Cde: type=tBYTE, init-value=0
    SR_BSM_Ivanne_Cde_IoFromDcm
      data BSM_Ivanne_Cde: type=tBYTE, init-value=0
    SR_DdeVoyFARC_IoFromDcm
      data DdeVoyFARC: type=t_cVoyFARC, init-value=0
    SR_RC_PWM_LEDPushSCP_IoFromDcm
      data RC_PWM_LEDPushSCP: type=tBYTE, init-value=0
    SR_DdeLEDPushSCP_IoFromDcm
      data DdeLEDPushSCP: type=tLOG, init-value=0
    SR_PiloterLEDSAM_IoFromDcm
      data PiloterLEDSAM: type=tLOG, init-value=0
    SR_EcsStateHmiDcu_IoFromDcm
      data EcsStateHmiDcu: type=t_EcsStateHmiDcu, init-value=0
    SR_DdeDelestageChauffeNuque_IoFromDcm
      data DdeDelestageChauffeNuque: type=t_cChNuque, init-value=0
    SR_AutorAllumLecteurCle_IoFromDcm
      data AutorAllumLecteurCle: type=tLOG, init-value=0
    SR_AutorAllumPushDem_IoFromDcm
      data AutorAllumPushDem: type=tLOG, init-value=0
    SR_PWMLightLevel_IoFromDcm
      data PWMLightLevel: type=tBYTE, init-value=0
    SR_CdePWMEclCoffre_IoFromDcm
      data CdePWMEclCoffre: type=tBYTE, init-value=0
    SR_ConditionAllumage_AllSeuilsAR_IoFromDcm
      data ConditionAllumage_AllSeuilsAR: type=tBYTE, init-value=0
    SR_CdePWMEclSeuilsAV_IoFromDcm
      data CdePWMEclSeuilsAV: type=tBYTE, init-value=0
    SR_CdePWMPlafonnierAV_IoFromDcm
      data CdePWMPlafonnierAV: type=tBYTE, init-value=0
    SR_CdePWMPlafonnierRg23_IoFromDcm
      data CdePWMPlafonnierRg23: type=tBYTE, init-value=0
    SR_RearFogBeamCmd_IoFromDcm
      data RearFogBeamCmd: type=tLOG, init-value=0
    SR_FrontFogBeamCmd_IoFromDcm
      data FrontFogBeamCmd: type=tLOG, init-value=0
    SR_CmdDRL_IoFromDcm
      data CmdDRL: type=tLOG, init-value=0
    SR_CmdFxPosLeft_IoFromDcm
      data CmdFxPosLeft: type=tBYTE, init-value=0
    SR_CmdFxPosRight_IoFromDcm
      data CmdFxPosRight: type=tBYTE, init-value=0
    SR_CmdLicensePlate_IoFromDcm
      data CmdLicensePlate: type=tLOG, init-value=0
    SR_CmdAvertSonore_IoFromDcm
      data CmdAvertSonore: type=tLOG, init-value=0
    SR_CmdMainReverseLight_IoFromDcm
      data CmdMainReverseLight: type=tLOG, init-value=0
    SR_CmdStopLight_IoFromDcm
      data CmdStopLight: type=tLOG, init-value=0
    SR_CmdPushLedWarning_IoFromDcm
      data CmdPushLedWarning: type=tLOG, init-value=0
    SR_CmdTurnIndicatorLeft_IoFromDcm
      data CmdTurnIndicatorLeft: type=tLOG, init-value=0
    SR_CmdTurnIndicatorRight_IoFromDcm
      data CmdTurnIndicatorRight: type=tLOG, init-value=0
    SR_AutorWireDriverSeatMvt_IoFromDcm
      data AutorWireDriverSeatMvt: type=tLOG, init-value=0
    SR_AutorisationSiegeChauff_IoFromDcm
      data AutorisationSiegeChauff: type=tLOG, init-value=0
    SR_AutorAlimSiegeChauffant_IoFromDcm
      data AutorAlimSiegeChauffant: type=tLOG, init-value=0
    SR_CdePBCZone1_IoFromDcm
      data CdePBCZone1: type=tLOG, init-value=0
    SR_CdePBCZone2_IoFromDcm
      data CdePBCZone2: type=tLOG, init-value=0
    SR_EtatActivationPBC_IoFromDcm
      data EtatActivationPBC: type=tLOG, init-value=0
    SR_CdeDegivrageLuch_IoFromDcm
      data CdeDegivrageLuch: type=tLOG, init-value=0
    SR_RearWiperCmd_VSM_IoFromDcm
      data RearWipingCommand: type=t_cWiper, init-value=105
    SR_FrontWipingCmd_VSM_IoFromDcm
      data FrontWipingCommand: type=t_cWiper, init-value=105
    SR_RearWashingCmd_VSM_IoFromDcm
      data RearWashingCommand: type=tLOG, init-value=0
    SR_FrontWashingCmd_VSM_IoFromDcm
      data FrontWashingCommand: type=tLOG, init-value=0
    SR_AffMenuEclAmbi_IoFromDcm
      data AffMenuEclAmbi: type=tLOG, init-value=0
    SR_CdeAlerteSonoreKlaxon_IoFromDcm
      data CdeAlerteSonoreKlaxon: type=tLOG, init-value=0
    SR_CmdActivationSurvAS_IoFromDcm
      data CmdActivationSurvAS: type=tBYTE, init-value=4
    SR_CmdActivationSurvSIR_IoFromDcm
      data CmdActivationSurvSIR: type=t_cASIR, init-value=0
    SR_CmdActivationSurvVOL_IoFromDcm
      data CmdActivationSurvVOL: type=t_cActiSurv, init-value=4
    SR_DdeSignalEffractionInterne_IoFromDcm
      data DdeSignalEffractionInterne: type=tLOG, init-value=0
    SR_SAV_RC_LEDPushAlarme_IoFromDcm
      data SAV_RC_LEDPushAlarme: type=tBYTE, init-value=0
    SR_SignalActivAlarmeInterne_IoFromDcm
      data SignalActivAlarmeInterne: type=tLOG, init-value=0
    SR_SignalDesactivAlarmeInterne_IoFromDcm
      data SignalDesactivAlarmeInterne: type=tLOG, init-value=0
