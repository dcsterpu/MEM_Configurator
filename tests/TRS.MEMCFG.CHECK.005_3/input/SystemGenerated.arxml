AUTOSAR XML (schema 4-2-2)
package /RootP_CS
  8 x client server interface:
    CS_ProgReveilAbs
      operation Release
        arg AlarmID: type=tBYTE, direction=IN
      operation Request
        arg AlarmeID: type=tBYTE, direction=IN
        arg DdeProg: type=tWORD, direction=IN
    CS_ProgReveilRel
      operation Release
        arg AlarmID: type=tBYTE, direction=IN
      operation Request
        arg AlarmeID: type=tBYTE, direction=IN
        arg DdeProg: type=tWORD, direction=IN
    CS_ShuntParc: is-service=true
      operation OP_GET
        arg ShuntParc: type=IoHwAb_uint8, direction=OUT
    CS_TS_AbsoluteAlarm: is-service=true
      operation AbsAlarm_Clear
        arg AlarmId: type=TS_AlarmIdType, direction=IN
      operation AbsAlarm_ClearAll
      operation AbsAlarm_Set
        6 x arg:
          AlarmId: type=TS_AlarmIdType, direction=IN
          Hour: type=TS_HourType, direction=IN
          Minutes: type=TS_MinuteType, direction=IN
          AckAlarmID: type=TS_AlarmIdType, direction=OUT
          AckHour: type=TS_HourType, direction=OUT
          AckMinutes: type=TS_MinuteType, direction=OUT
    CS_TS_Counter: is-service=true
      operation Cnt_Get
        arg CounterVal: type=TS_TimeCounterType, direction=OUT
        arg cnt_unused: type=TS_TimeCounterType, direction=OUT
      operation Cnt_Set
        arg CounterVal: type=TS_TimeCounterType, direction=IN
    CS_TS_DateTime: is-service=true
      4 x operation:
        Date_Get
          arg Year: type=TS_YearType, direction=OUT
          arg Month: type=TS_MonthType, direction=OUT
          arg Day: type=TS_DayType, direction=OUT
        Date_Set
          arg Year: type=TS_YearType, direction=IN
          arg Month: type=TS_MonthType, direction=IN
          arg Day: type=TS_DayType, direction=IN
        Time_Get
          6 x arg, all with direction=OUT:
            Hour: type=TS_HourType
            Minutes: type=TS_MinuteType
            Seconds: type=TS_SecondType
            h_unused: type=TS_HourType
            m_unused: type=TS_MinuteType
            s_unused: type=TS_SecondType
        Time_Set
          arg Hour: type=TS_HourType, direction=IN
          arg Minutes: type=TS_MinuteType, direction=IN
          arg Seconds: type=TS_SecondType, direction=IN
    CS_TS_RelativeAlarm: is-service=true
      operation RelAlarm_Clear
        arg AlarmId: type=TS_AlarmIdType, direction=IN
      operation RelAlarm_ClearAll
      operation RelAlarm_Set
        arg AlarmId: type=TS_AlarmIdType, direction=IN
        arg RelMinutes: type=TS_RelMinutesType, direction=IN
    CS_IsDataUpdated
      operation Get_IsDataEnabled
        arg DataIndex: type=tWORD, direction=IN
        arg EnablingStatus: type=tBYTE, direction=OUT
        arg FilterdEcuState: type=tBYTE, direction=OUT
package /RootP_SR_Data
  543 x sender receiver interface:
    SR_Autonomie
      data Autonomie: type=tWORD, init-value=CONST_tWORD_0xFFFF:65535
    SR_AutonomieGPL
      data AutonomieGPL: type=tWORD, init-value=CONST_tWORD_0x7FF:2047
    SR_AutonomieInvalide
      data AutonomieInvalide: type=tLOG, init-value=CONST_tLOG_0:0
    SR_AutonomieTOTAL
      data AutonomieTOTAL: type=tWORD, init-value=CONST_tWORD_0x7FF:2047
    SR_ConsoAutonomieGM
      data ConsoAutonomieGM: type=tDWORD, init-value=CONST_tDWORD_0:0
    SR_ConsoGPLInvalide
      data ConsoGPLInvalide: type=tLOG, init-value=CONST_tLOG_0:0
    SR_ConsoInst
      data ConsoInst: type=tWORD, init-value=CONST_tWORD_0xFFFF:65535
    SR_ConsoInstGPL
      data ConsoInstGPL: type=tWORD, init-value=CONST_tWORD_0x1FF:511
    SR_ConsoLissee
      data ConsoLissee: type=tWORD, init-value=CONST_tWORD_0:0
    SR_ConsoMoyenneGPLT1
      data ConsoMoyenneGPLT1: type=tWORD, init-value=CONST_tWORD_0:0
    SR_ConsoMoyenneGPLT2
      data ConsoMoyenneGPLT2: type=tWORD, init-value=CONST_tWORD_0:0
    SR_ConsoMoyenneHY1
      data ConsoMoyenneHY1: type=tBYTE, init-value=CONST_tBYTE_0:0
    SR_ConsoMoyenneHY2
      data ConsoMoyenneHY2: type=tBYTE, init-value=CONST_tBYTE_0:0
    SR_ConsoMoyenneHY3
      data ConsoMoyenneHY3: type=tBYTE, init-value=CONST_tBYTE_0:0
    SR_ConsoMoyenneHY4
      data ConsoMoyenneHY4: type=tBYTE, init-value=CONST_tBYTE_0:0
    SR_ConsoMoyenneHY5
      data ConsoMoyenneHY5: type=tBYTE, init-value=CONST_tBYTE_0:0
    SR_ConsoMoyenneHY6
      data ConsoMoyenneHY6: type=tBYTE, init-value=CONST_tBYTE_0:0
    SR_ConsoMoyenneT1
      data ConsoMoyenneT1: type=tWORD, init-value=CONST_tWORD_0:0
    SR_ConsoMoyenneT2
      data ConsoMoyenneT2: type=tWORD, init-value=CONST_tWORD_0:0
    SR_ConsoReelleInvalide
      data ConsoReelleInvalide: type=tLOG, init-value=CONST_tLOG_0:0
    SR_Conso_WH_Gain1
      data Conso_WH_Gain1: type=tBYTE, init-value=CONST_tBYTE_0:0
    SR_Conso_WH_Gain2
      data Conso_WH_Gain2: type=tBYTE, init-value=CONST_tBYTE_0:0
    SR_Conso_WH_Gain3
      data Conso_WH_Gain3: type=tBYTE, init-value=CONST_tBYTE_0:0
    SR_Conso_WH_Gain4
      data Conso_WH_Gain4: type=tBYTE, init-value=CONST_tBYTE_0:0
    SR_Conso_WH_Gain5
      data Conso_WH_Gain5: type=tBYTE, init-value=CONST_tBYTE_0:0
    SR_Conso_WH_Gain6
      data Conso_WH_Gain6: type=tBYTE, init-value=CONST_tBYTE_0:0
    SR_DistAutonomieGM
      data DistAutonomieGM: type=tDWORD, init-value=CONST_tDWORD_0:0
    SR_NbDemiMedaillesBarre1
      data NbDemiMedaillesBarre1: type=tWORD, init-value=CONST_tWORD_0:0
    SR_NbDemiMedaillesBarre2
      data NbDemiMedaillesBarre2: type=tWORD, init-value=CONST_tWORD_0:0
    SR_NbDemiMedaillesBarre3
      data NbDemiMedaillesBarre3: type=tWORD, init-value=CONST_tWORD_0:0
    SR_NbDemiMedaillesBarre4
      data NbDemiMedaillesBarre4: type=tWORD, init-value=CONST_tWORD_0:0
    SR_NbDemiMedaillesBarre5
      data NbDemiMedaillesBarre5: type=tWORD, init-value=CONST_tWORD_0:0
    SR_NbDemiMedaillesBarre6
      data NbDemiMedaillesBarre6: type=tWORD, init-value=CONST_tWORD_0:0
    SR_PseudoConsoInvalide
      data PseudoConsoInvalide: type=tLOG, init-value=CONST_tLOG_0:0
    SR_RazOkDeAuCoVersOdo
      data RazOkDeAuCoVersOdo: type=tLOG, init-value=CONST_tLOG_0:0
    SR_SAV_ConsoGPLLisse
      data SAV_ConsoGPLLisse: type=tWORD, init-value=CONST_tWORD_100:100
    SR_SAV_ConsoLisse
      data SAV_ConsoLisse: type=tWORD, init-value=CONST_tWORD_100:100
    SR_ApportCarbDetecte
      data ApportCarbDetecte: type=tLOG, init-value=CONST_tLOG_0:0
    SR_CMMMuet_P26
      data CMMMuet_P26: type=tFLOAT, init-value=CONST_tFLOAT_0:0
    SR_ConsommationCarbReelle_P26
      data ConsommationCarbReelle_P26: type=tBYTE, init-value=CONST_tBYTE_0:0
    SR_ConsommationGPL
      data ConsommationGPL: type=tBYTE, init-value=CONST_tBYTE_0:0
    SR_DdeRazDeOdometre
      data DdeRazDeOdometre: type=tLOG, init-value=CONST_tLOG_0:0
    SR_DdeRazT1_P26
      data DdeRazT1_P26: type=tLOG, init-value=CONST_tLOG_0:0
    SR_DdeRazT2_P26
      data DdeRazT2_P26: type=tLOG, init-value=CONST_tLOG_0:0
    SR_DefautJaugeCarbConfirme
      data DefautJaugeCarbConfirme: type=t_cSDF_Defaut, init-value=CONST_DefautJaugeCarbConfirme_t_cSDF_Defaut_cSDF_DefautAbsent:105
    SR_DistanceParcourue
      data DistanceParcourue: type=tWORD, init-value=CONST_tWORD_0:0
    SR_DistanceParcourueFigee
      data DistanceParcourueFigee: type=tLOG, init-value=CONST_tLOG_0:0
    SR_DistanceParcourueValide
      data DistanceParcourueValide: type=tLOG, init-value=CONST_tLOG_1:1
    SR_DistanceT1
      data DistanceT1: type=tWORD, init-value=CONST_tWORD_0:0
    SR_DistanceT2
      data DistanceT2: type=tWORD, init-value=CONST_tWORD_0:0
    SR_DysfVitesseVehicule
      data DysfVitesseVehicule: type=t_cVitv, init-value=CONST_t_cVitv_0:0  # Vitesse utilisée pour décrire l'état de la vitesse vehicule
    SR_EtatGMP
      data EtatGMP: type=t_GM_GMP, init-value=CONST_t_GM_GMP_1:1
    SR_EtatGMPDeHY
      data EtatGMPDeHY: type=t_cGM_HY, init-value=CONST_t_cGM_HY_0:0
    SR_EtatModeGaz
      data EtatModeGaz: type=t_, init-value=CONST_t_7:7
    SR_EtatPrincipalSEV
      data EtatPrincipalSEV: type=t_SEV, init-value=CONST_t_SEV_0x69:105
    SR_GAZMuet_P26
      data GAZMuet_P26: type=tLOG, init-value=CONST_tLOG_0:0
    SR_GPLModeINFO
      data GPLModeINFO: type=t_e_0, init-value=CONST_t_e_0_0:0
    SR_GPLtankCapacity
      data GPLtankCapacity: type=tBYTE, init-value=CONST_tBYTE_0:0
    SR_ModeFonctMotGAZ
      data ModeFonctMotGAZ: type=t_cModeFonctMotGAZ, init-value=CONST_t_cModeFonctMotGAZ_0x07:7
    SR_NivGPLAffiche
      data NivGPLAffiche: type=tBYTE, init-value=CONST_tBYTE_0:0
    SR_PhaseVieLS
      data PhaseVieLS: type=t_cCANLS, init-value=CONST_t_cCANLS_0:0
    SR_PremiereMesureJC_OK
      data PremiereMesureJC_OK: type=t_cSDF_Mesure, init-value=CONST_PremiereMesureJC_OK_t_cSDF_Mesure_cSDF_MesureNonRealisee:105
    SR_PseudoConsommationCarb
      data PseudoConsommationCarb: type=tBYTE, init-value=CONST_tBYTE_0:0
    SR_QteEnergieRecup
      data QteEnergieRecup: type=tBYTE, init-value=CONST_tBYTE_0:0
    SR_RegimeMoteur_P26
      data RegimeMoteur_P26: type=tWORD, init-value=CONST_tWORD_0:0
    SR_SAV_DistancePreciseT1
      data SAV_DistancePreciseT1: type=tDWORD, init-value=CONST_tDWORD_0:0
    SR_SAV_DistancePreciseT2
      data SAV_DistancePreciseT2: type=tDWORD, init-value=CONST_tDWORD_0:0
    SR_SAV_EtatReseauElectrique
      data SAV_EtatReseauElectrique: type=t_cGEE_1, init-value=CONST_t_cGEE_1_0:0
    SR_SAV_NivCarbAffiche
      data SAV_NivCarbAffiche: type=tWORD, init-value=CONST_tWORD_0xFFFF:65535
    SR_VitesseVehicule
      data VitesseVehicule: type=tWORD, init-value=CONST_tWORD_0:0
    SR_ZoomConsoIHM
      data ZoomConsoIHM: type=tBILOG, init-value=CONST_tBILOG_0:0
    SR_Annee
      data Annee: type=t_cAnnee, init-value=CONST_t_cAnnee_0x84E:2126
    SR_AnneePourAff
      data AnneePourAff: type=t_cAnneeAff, init-value=CONST_AnneePourAff_t_cAnneeAff_cAnneeAff_Indisponible:126
    SR_CptTempVehicule
      data CptTempVehicule: type=tDWORD, init-value=CONST_tDWORD_0xFFFFFFFE:4294967294
    SR_DatationDefaut
      data DatationDefaut: type=tDWORD, init-value=CONST_tDWORD_0:0
    SR_Heure
      data Heure: type=t_cHeure, init-value=CONST_Heure_t_cHeure_cHeure_Indisponible:30
    SR_HeureCAN
      data HeureCAN: type=t_cHeure, init-value=CONST_HeureCAN_t_cHeure_cHeure_Indisponible:30
    SR_Jour
      data Jour: type=t_cJour, init-value=CONST_t_cJour_0x3E:62
    SR_JourSemaine
      data JourSemaine: type=t_cJourSemaine, init-value=CONST_JourSemaine_t_cJourSemaine_cJourSemaine_Indisponible:14
    SR_Minute
      data Minute: type=t_cMinute, init-value=CONST_Minute_t_cMinute_cMinute_Indisponible:62
    SR_MinuteCAN
      data MinuteCAN: type=t_cMinute, init-value=CONST_MinuteCAN_t_cMinute_cMinute_Indisponible:62
    SR_Mois
      data Mois: type=t_cMois, init-value=CONST_Mois_t_cMois_cMois_Indisponible:14
    SR_SEC_Affichage
      data SEC_Affichage: type=tLOG, init-value=CONST_tLOG_1:1
    SR_SEC_CptRAZGCT
      data SEC_CptRAZGCT: type=t_cCptRAZ, init-value=CONST_SEC_CptRAZGCT_t_cCptRAZ_cCptRAZ_Indisponible:254
    SR_SEC_EtatProgRevGEEAQEB
      data SEC_EtatProgRevGEEAQEB: type=t_cEtatProgRev, init-value=CONST_SEC_EtatProgRevGEEAQEB_t_cEtatProgRev_cEtatProgRev_ReveilNonProg:60
    SR_SEC_EtatProgRevGEEDCM
      data SEC_EtatProgRevGEEDCM: type=t_cEtatProgRev, init-value=CONST_SEC_EtatProgRevGEEDCM_t_cEtatProgRev_cEtatProgRev_ReveilNonProg:60
    SR_SEC_EtatProgRevPrecond
      data SEC_EtatProgRevPrecond: type=t_cEtatProgRev, init-value=CONST_t_cEtatProgRev_0x96:150
    SR_SEC_EtatProgRevPrecondElec
      data SEC_EtatProgRevPrecondElec: type=tFLOAT, init-value=CONST_tFLOAT_0x96:150
    SR_SEC_EtatProgRevPrecondTherm
      data SEC_EtatProgRevPrecondTherm: type=t_cEtatProgRev, init-value=CONST_t_cEtatProgRev_0x96:150
    SR_SEC_EtatProgRevRTAB
      data SEC_EtatProgRevRTAB: type=t_cEtatProgRev, init-value=CONST_SEC_EtatProgRevRTAB_t_cEtatProgRev_cEtatProgRev_ReveilNonProg:60
    SR_SEC_HProgRevPrecondTherm
      data SEC_HProgRevPrecondTherm: type=t_cHProgPrecondTherm, init-value=CONST_SEC_HProgRevPrecondTherm_t_cHProgPrecondTherm_cHProgPrecondTherm_Aucun:65534
    SR_SEC_TypeAffichageHorloge
      data SEC_TypeAffichageHorloge: type=t_cTypeAffichHor, init-value=CONST_SEC_TypeAffichageHorloge_t_cTypeAffichHor_cTypeAffichHor_24H:1
    SR_ToggleEnvCptTempVhl
      data ToggleEnvCptTempVhl: type=tLOG, init-value=CONST_tLOG_0:0
    SR_ToggleMAJDateHeure
      data ToggleMAJDateHeure: type=tLOG, init-value=CONST_tLOG_0:0
    SR_WSParTimerGEEAQEB
      data WSParTimerGEEAQEB: type=tLOG, init-value=CONST_tLOG_0:0
    SR_WSParTimerGEEDCM
      data WSParTimerGEEDCM: type=tLOG, init-value=CONST_tLOG_0:0
    SR_WSParTimerPrecElec
      data WSParTimerPrecElec: type=tLOG, init-value=CONST_tLOG_0:0
    SR_WSParTimerPrecond
      data WSParTimerPrecond: type=tLOG, init-value=CONST_tLOG_0:0
    SR_WSParTimerPrecTherm
      data WSParTimerPrecTherm: type=tLOG, init-value=CONST_tLOG_0:0
    SR_WSParTimerRTAB
      data WSParTimerRTAB: type=tLOG, init-value=CONST_tLOG_0:0
    SR_CANISActivePartialWakeUp
      data CANISActivePartialWakeUp: type=t_cCANISPartialWakeUp, init-value=CONST_t_cCANISPartialWakeUp_0:0
    SR_DmdMAJAnnee
      data DmdMAJAnnee: type=t_cAnnee, init-value=CONST_DmdMAJAnnee_t_cAnnee_cAnnee_Indisponible:2126
    SR_DmdMAJHeure
      data DmdMAJHeure: type=t_cHeure, init-value=CONST_DmdMAJHeure_t_cHeure_cHeure_Indisponible:30
    SR_DmdMAJJour
      data DmdMAJJour: type=t_cJour, init-value=CONST_DmdMAJJour_t_cJour_cJour_Indisponible:62
    SR_DmdMAJMinute
      data DmdMAJMinute: type=t_cMinute, init-value=CONST_DmdMAJMinute_t_cMinute_cMinute_Indisponible:62
    SR_DmdMAJMois
      data DmdMAJMois: type=t_cMois, init-value=CONST_DmdMAJMois_t_cMois_cMois_Indisponible:14
    SR_DmdMAJTypeAffHorloge
      data DmdMAJTypeAffHorloge: type=t_cTypeAffichHor, init-value=CONST_DmdMAJTypeAffHorloge_t_cTypeAffichHor_cTypeAffichHor_24H:1
    SR_InterMemoDefauts
      data InterMemoDefauts: type=tLOG, init-value=CONST_tLOG_0:0
    SR_PhaseVieIS
      data PhaseVieIS: type=t_cCANIS, init-value=CONST_PhaseVieIS_t_cCANIS_cCANIS_OFF:0
    SR_SEC_ConfigSEV
      data SEC_ConfigSEV: type=t_cCSEV, init-value=CONST_t_cCSEV_4:4
    SR_ToggleDmdMAJHorloge
      data ToggleDmdMAJHorloge: type=tLOG, init-value=CONST_tLOG_0:0
    SR_TS_AbsAlarm_0_Notification: is-service=true
      data AbsAlarm_0_State: type=t_cAlarm, init-value=CONST_t_cAlarm_0:0
    SR_TS_RelAlarm_0_Notification: is-service=true
      data RelAlarm_0_State: type=t_cAlarm, init-value=CONST_t_cAlarm_0:0
    SR_TS_RelAlarm_1_Notification: is-service=true
      data RelAlarm_1_State: type=t_cAlarm, init-value=CONST_t_cAlarm_0:0
    SR_TS_RelAlarm_2_Notification: is-service=true
      data RelAlarm_2_State: type=t_cAlarm, init-value=CONST_t_cAlarm_0:0
    SR_TS_RelAlarm_3_Notification: is-service=true
      data RelAlarm_3_State: type=t_cAlarm, init-value=CONST_t_cAlarm_0:0
    SR_TS_RelAlarm_4_Notification: is-service=true
      data RelAlarm_4_State: type=t_cAlarm, init-value=CONST_t_cAlarm_0:0
    SR_ButeeXvv1DeMenuPerso
      data ButeeXvv1DeMenuPerso: type=tBYTE, init-value=CONST_tBYTE_0:0
    SR_ButeeXvv2DeMenuPerso
      data ButeeXvv2DeMenuPerso: type=tBYTE, init-value=CONST_tBYTE_0:0
    SR_ButeeXvv3DeMenuPerso
      data ButeeXvv3DeMenuPerso: type=tBYTE, init-value=CONST_tBYTE_0:0
    SR_ButeeXvv4DeMenuPerso
      data ButeeXvv4DeMenuPerso: type=tBYTE, init-value=CONST_tBYTE_0:0
    SR_ButeeXvv5DeMenuPerso
      data ButeeXvv5DeMenuPerso: type=tBYTE, init-value=CONST_tBYTE_0:0
    SR_DdeAccesJDADeVMF
      data DdeAccesJDADeVMF: type=tLOG, init-value=CONST_tLOG_0:0
    SR_DdeAllumPlafDeVMF
      data DdeAllumPlafDeVMF: type=tLOG, init-value=CONST_tLOG_0:0
    SR_DdeBlackPanelDeVMF
      data DdeBlackPanelDeVMF: type=tLOG, init-value=CONST_tLOG_0:0
    SR_DdeCheckTcfg
      data DdeCheckTcfg: type=tLOG, init-value=CONST_tLOG_0:0
    SR_DdeColorisationCMBDeVMF
      data DdeColorisationCMBDeVMF: type=tLOG, init-value=CONST_tLOG_0:0
    SR_DdeConfigToucheDeVMF
      data DdeConfigToucheDeVMF: type=tLOG, init-value=CONST_tLOG_0:0
    SR_DdePersoCMBDeVMF
      data DdePersoCMBDeVMF: type=tLOG, init-value=CONST_tLOG_0:0
    SR_DispoDmdMenuPrecond
      data DispoDmdMenuPrecond: type=tWORD, init-value=CONST_tWORD_0:0
    SR_DispoDmdMenuRecharge
      data DispoDmdMenuRecharge: type=tBYTE, init-value=CONST_tBYTE_0b01:0b01
    SR_DispoEtatMenuPrgPem
      data DispoEtatMenuPrgPem: type=tLOG, init-value=CONST_tLOG_0:0
    SR_DispoEtatMenuReserveZEV
      data DispoEtatMenuReserveZEV: type=tLOG, init-value=CONST_tLOG_0:0
    SR_DmdmCGEPVReserveZEV
      data DmdmCGEPVReserveZEV: type=tLOG, init-value=CONST_tLOG_0:0
    SR_DmdMenuSelPrgDi
      data DmdMenuSelPrgDi: type=tLOG, init-value=CONST_tLOG_0:0
    SR_DmdMenuSelPrgJe
      data DmdMenuSelPrgJe: type=tLOG, init-value=CONST_tLOG_0:0
    SR_DmdMenuSelPrgLu
      data DmdMenuSelPrgLu: type=tLOG, init-value=CONST_tLOG_0:0
    SR_DmdMenuSelPrgMa
      data DmdMenuSelPrgMa: type=tLOG, init-value=CONST_tLOG_0:0
    SR_DmdMenuSelPrgMe
      data DmdMenuSelPrgMe: type=tLOG, init-value=CONST_tLOG_0:0
    SR_DmdMenuSelPrgSa
      data DmdMenuSelPrgSa: type=tLOG, init-value=CONST_tLOG_0:0
    SR_DmdMenuSelPrgVe
      data DmdMenuSelPrgVe: type=tLOG, init-value=CONST_tLOG_0:0
    SR_DmdmPrgHcEnd
      data DmdmPrgHcEnd: type=tDWORD, init-value=CONST_tDWORD_0:0
    SR_DmdmPrgHcStart
      data DmdmPrgHcStart: type=tDWORD, init-value=CONST_tDWORD_0:0
    SR_DmdmPrgPemDi
      data DmdmPrgPemDi: type=tDWORD, init-value=CONST_tDWORD_0:0
    SR_DmdmPrgPemJe
      data DmdmPrgPemJe: type=tDWORD, init-value=CONST_tDWORD_0:0
    SR_DmdmPrgPemLu
      data DmdmPrgPemLu: type=tDWORD, init-value=CONST_tDWORD_0:0
    SR_DmdmPrgPemMa
      data DmdmPrgPemMa: type=tDWORD, init-value=CONST_tDWORD_0:0
    SR_DmdmPrgPemMe
      data DmdmPrgPemMe: type=tDWORD, init-value=CONST_tDWORD_0:0
    SR_DmdmPrgPemSa
      data DmdmPrgPemSa: type=tDWORD, init-value=CONST_tDWORD_0:0
    SR_DmdmPrgPemVe
      data DmdmPrgPemVe: type=tDWORD, init-value=CONST_tDWORD_0:0
    SR_EclAccompDeMenuPerso
      data EclAccompDeMenuPerso: type=t_cAccomp, init-value=CONST_t_cAccomp_0:0
    SR_EclDecondaDeMenuPerso
      data EclDecondaDeMenuPerso: type=t_cDeconda, init-value=CONST_t_cDeconda_0:0
    SR_EtatMenuAccueilCond
      data EtatMenuAccueilCond: type=tLOG, init-value=CONST_tLOG_0:0
    SR_EtatMenuActButee1XVV
      data EtatMenuActButee1XVV: type=tLOG, init-value=CONST_tLOG_0:0
    SR_EtatMenuActButee2XVV
      data EtatMenuActButee2XVV: type=tLOG, init-value=CONST_tLOG_0:0
    SR_EtatMenuActButee3XVV
      data EtatMenuActButee3XVV: type=tLOG, init-value=CONST_tLOG_0:0
    SR_EtatMenuActButee4XVV
      data EtatMenuActButee4XVV: type=tLOG, init-value=CONST_tLOG_0:0
    SR_EtatMenuActButee5XVV
      data EtatMenuActButee5XVV: type=tLOG, init-value=CONST_tLOG_0:0
    SR_EtatMenuActButeeGenXVV
      data EtatMenuActButeeGenXVV: type=tLOG, init-value=CONST_tLOG_0:0
    SR_EtatMenuARCSensNiv
      data EtatMenuARCSensNiv: type=tBILOG, init-value=CONST_tBILOG_2:2
    SR_EtatMenuBAAActivation
      data EtatMenuBAAActivation: type=tLOG, init-value=CONST_tLOG_0:0
    SR_EtatMenuBAAAutolocking
      data EtatMenuBAAAutolocking: type=tLOG, init-value=CONST_tLOG_0:0
    SR_EtatMenuCLIM_PrecondASAP
      data EtatMenuCLIM_PrecondASAP: type=tLOG, init-value=CONST_tLOG_0:0
    SR_EtatMenuCLIM_PrecondDi1
      data EtatMenuCLIM_PrecondDi1: type=tLOG, init-value=CONST_tLOG_0:0
    SR_EtatMenuCLIM_PrecondDi2
      data EtatMenuCLIM_PrecondDi2: type=tLOG, init-value=CONST_tLOG_0:0
    SR_EtatMenuCLIM_PrecondDi3
      data EtatMenuCLIM_PrecondDi3: type=tLOG, init-value=CONST_tLOG_0:0
    SR_EtatMenuCLIM_PrecondDi4
      data EtatMenuCLIM_PrecondDi4: type=tLOG, init-value=CONST_tLOG_0:0
    SR_EtatMenuCLIM_PrecondH1
      data EtatMenuCLIM_PrecondH1: type=tWORD, init-value=CONST_tWORD_0:0
    SR_EtatMenuCLIM_PrecondH2
      data EtatMenuCLIM_PrecondH2: type=tWORD, init-value=CONST_tWORD_0:0
    SR_EtatMenuCLIM_PrecondH3
      data EtatMenuCLIM_PrecondH3: type=tWORD, init-value=CONST_tWORD_0:0
    SR_EtatMenuCLIM_PrecondH4
      data EtatMenuCLIM_PrecondH4: type=tWORD, init-value=CONST_tWORD_0:0
    SR_EtatMenuCLIM_PrecondJe1
      data EtatMenuCLIM_PrecondJe1: type=tLOG, init-value=CONST_tLOG_0:0
    SR_EtatMenuCLIM_PrecondJe2
      data EtatMenuCLIM_PrecondJe2: type=tLOG, init-value=CONST_tLOG_0:0
    SR_EtatMenuCLIM_PrecondJe3
      data EtatMenuCLIM_PrecondJe3: type=tLOG, init-value=CONST_tLOG_0:0
    SR_EtatMenuCLIM_PrecondJe4
      data EtatMenuCLIM_PrecondJe4: type=tLOG, init-value=CONST_tLOG_0:0
    SR_EtatMenuCLIM_PrecondLu1
      data EtatMenuCLIM_PrecondLu1: type=tLOG, init-value=CONST_tLOG_0:0
    SR_EtatMenuCLIM_PrecondLu2
      data EtatMenuCLIM_PrecondLu2: type=tLOG, init-value=CONST_tLOG_0:0
    SR_EtatMenuCLIM_PrecondLu3
      data EtatMenuCLIM_PrecondLu3: type=tLOG, init-value=CONST_tLOG_0:0
    SR_EtatMenuCLIM_PrecondLu4
      data EtatMenuCLIM_PrecondLu4: type=tLOG, init-value=CONST_tLOG_0:0
    SR_EtatMenuCLIM_PrecondMa1
      data EtatMenuCLIM_PrecondMa1: type=tLOG, init-value=CONST_tLOG_0:0
    SR_EtatMenuCLIM_PrecondMa2
      data EtatMenuCLIM_PrecondMa2: type=tLOG, init-value=CONST_tLOG_0:0
    SR_EtatMenuCLIM_PrecondMa3
      data EtatMenuCLIM_PrecondMa3: type=tLOG, init-value=CONST_tLOG_0:0
    SR_EtatMenuCLIM_PrecondMa4
      data EtatMenuCLIM_PrecondMa4: type=tLOG, init-value=CONST_tLOG_0:0
    SR_EtatMenuCLIM_PrecondMe1
      data EtatMenuCLIM_PrecondMe1: type=tLOG, init-value=CONST_tLOG_0:0
    SR_EtatMenuCLIM_PrecondMe2
      data EtatMenuCLIM_PrecondMe2: type=tLOG, init-value=CONST_tLOG_0:0
    SR_EtatMenuCLIM_PrecondMe3
      data EtatMenuCLIM_PrecondMe3: type=tLOG, init-value=CONST_tLOG_0:0
    SR_EtatMenuCLIM_PrecondMe4
      data EtatMenuCLIM_PrecondMe4: type=tLOG, init-value=CONST_tLOG_0:0
    SR_EtatMenuCLIM_PrecondOn1
      data EtatMenuCLIM_PrecondOn1: type=tLOG, init-value=CONST_tLOG_0:0
    SR_EtatMenuCLIM_PrecondOn2
      data EtatMenuCLIM_PrecondOn2: type=tLOG, init-value=CONST_tLOG_0:0
    SR_EtatMenuCLIM_PrecondOn3
      data EtatMenuCLIM_PrecondOn3: type=tLOG, init-value=CONST_tLOG_0:0
    SR_EtatMenuCLIM_PrecondOn4
      data EtatMenuCLIM_PrecondOn4: type=tLOG, init-value=CONST_tLOG_0:0
    SR_EtatMenuCLIM_PrecondSa1
      data EtatMenuCLIM_PrecondSa1: type=tLOG, init-value=CONST_tLOG_0:0
    SR_EtatMenuCLIM_PrecondSa2
      data EtatMenuCLIM_PrecondSa2: type=tLOG, init-value=CONST_tLOG_0:0
    SR_EtatMenuCLIM_PrecondSa3
      data EtatMenuCLIM_PrecondSa3: type=tLOG, init-value=CONST_tLOG_0:0
    SR_EtatMenuCLIM_PrecondSa4
      data EtatMenuCLIM_PrecondSa4: type=tLOG, init-value=CONST_tLOG_0:0
    SR_EtatMenuCLIM_PrecondVe1
      data EtatMenuCLIM_PrecondVe1: type=tLOG, init-value=CONST_tLOG_0:0
    SR_EtatMenuCLIM_PrecondVe2
      data EtatMenuCLIM_PrecondVe2: type=tLOG, init-value=CONST_tLOG_0:0
    SR_EtatMenuCLIM_PrecondVe3
      data EtatMenuCLIM_PrecondVe3: type=tLOG, init-value=CONST_tLOG_0:0
    SR_EtatMenuCLIM_PrecondVe4
      data EtatMenuCLIM_PrecondVe4: type=tLOG, init-value=CONST_tLOG_0:0
    SR_EtatMenuDAAActivation
      data EtatMenuDAAActivation: type=tLOG, init-value=CONST_tLOG_0:0
    SR_EtatMenuDSG
      data EtatMenuDSG: type=tLOG, init-value=CONST_tLOG_0:0
    SR_EtatMenuEclAccomp
      data EtatMenuEclAccomp: type=tLOG, init-value=CONST_tLOG_0:0
    SR_EtatMenuEclAccompTempo
      data EtatMenuEclAccompTempo: type=tBILOG, init-value=CONST_tBILOG_0:0
    SR_EtatMenuEclAdapt
      data EtatMenuEclAdapt: type=tLOG, init-value=CONST_tLOG_0:0
    SR_EtatMenuEclAmbi
      data EtatMenuEclAmbi: type=tLOG, init-value=CONST_tLOG_0:0
    SR_EtatMenuEclAmbiNiv
      data EtatMenuEclAmbiNiv: type=tBYTE, init-value=CONST_tBYTE_6:6
    SR_EtatMenuEclAuto
      data EtatMenuEclAuto: type=tLOG, init-value=CONST_tLOG_0:0
    SR_EtatMenuEclAutoroute
      data EtatMenuEclAutoroute: type=tLOG, init-value=CONST_tLOG_0:0
    SR_EtatMenuEclCaland
      data EtatMenuEclCaland: type=tLOG, init-value=CONST_tLOG_0:0
    SR_EtatMenuEclDeconda
      data EtatMenuEclDeconda: type=tLOG, init-value=CONST_tLOG_0:0
    SR_EtatMenuEclDecondaTempo
      data EtatMenuEclDecondaTempo: type=tBILOG, init-value=CONST_tBILOG_0:0
    SR_EtatMenuECLI_PPC_ANIM
      data EtatMenuECLI_PPC_ANIM: type=tBYTE, init-value=CONST_tBYTE_0:0
    SR_EtatMenuECLI_PPC_BLOC1
      data EtatMenuECLI_PPC_BLOC1: type=tLOG, init-value=CONST_tLOG_0:0
    SR_EtatMenuECLI_PPC_COL1
      data EtatMenuECLI_PPC_COL1: type=tBYTE, init-value=CONST_tBYTE_0:0
    SR_EtatMenuECLX_AFS
      data EtatMenuECLX_AFS: type=tLOG, init-value=CONST_tLOG_0:0
    SR_EtatMenuECLX_ARS
      data EtatMenuECLX_ARS: type=tLOG, init-value=CONST_tLOG_0:0
    SR_EtatMenuECLX_ECL_CAFR
      data EtatMenuECLX_ECL_CAFR: type=tLOG, init-value=CONST_tLOG_0:0
    SR_EtatMenuEssuiVitMar
      data EtatMenuEssuiVitMar: type=tLOG, init-value=CONST_tLOG_0:0
    SR_EtatMenuFARC
      data EtatMenuFARC: type=tLOG, init-value=CONST_tLOG_0:0
    SR_EtatMenuFeuxDiurne
      data EtatMenuFeuxDiurne: type=tLOG, init-value=CONST_tLOG_0:0
    SR_EtatMenuFSEAuto
      data EtatMenuFSEAuto: type=tLOG, init-value=CONST_tLOG_0:0
    SR_EtatMenuGAV_AMLA
      data EtatMenuGAV_AMLA: type=tLOG, init-value=CONST_tLOG_0:0
    SR_EtatMenuILV
      data EtatMenuILV: type=tLOG, init-value=CONST_tLOG_0:0
    SR_EtatMenuILV_ETSR
      data EtatMenuILV_ETSR: type=tLOG, init-value=CONST_tLOG_0:0
    SR_EtatMenuIMA
      data EtatMenuIMA: type=tLOG, init-value=CONST_tLOG_0:0
    SR_EtatMenuInfoParamDispo
      data EtatMenuInfoParamDispo: type=tLOG, init-value=CONST_tLOG_0:0
    SR_EtatMenuInfoUniteLangueDispo
      data EtatMenuInfoUniteLangueDispo: type=tLOG, init-value=CONST_tLOG_0:0
    SR_EtatMenuInfoVitLvvDispo
      data EtatMenuInfoVitLvvDispo: type=tLOG, init-value=CONST_tLOG_0:0
    SR_EtatMenuInfoVitRvvDispo
      data EtatMenuInfoVitRvvDispo: type=tLOG, init-value=CONST_tLOG_0:0
    SR_EtatMenuInfoXVVDispo
      data EtatMenuInfoXVVDispo: type=tLOG, init-value=CONST_tLOG_0:0
    SR_EtatMenuINV_ADSD
      data EtatMenuINV_ADSD: type=tLOG, init-value=CONST_tLOG_0:0
    SR_EtatMenuLangueVehicule
      data EtatMenuLangueVehicule: type=tBYTE, init-value=CONST_tBYTE_0:0
    SR_EtatMenuMotoVolAr
      data EtatMenuMotoVolAr: type=tLOG, init-value=CONST_tLOG_0:0
    SR_EtatMenuPresenceARC
      data EtatMenuPresenceARC: type=tLOG, init-value=CONST_tLOG_0:0
    SR_EtatMenuPRV_MODE
      data EtatMenuPRV_MODE: type=tBYTE, init-value=CONST_tBYTE_0:0
    SR_EtatMenuReserveZEV
      data EtatMenuReserveZEV: type=tLOG, init-value=CONST_tLOG_0:0
    SR_EtatMenuRTAB_EnergyRec
      data EtatMenuRTAB_EnergyRec: type=tBYTE, init-value=CONST_tBYTE_0b01:0b01
    SR_EtatMenuRTAB_RechargeHDeb
      data EtatMenuRTAB_RechargeHDeb: type=tWORD, init-value=CONST_tWORD_0:0
    SR_EtatMenuRTAB_TypeRec
      data EtatMenuRTAB_TypeRec: type=tLOG, init-value=CONST_tLOG_0:0
    SR_EtatMenuSelecArriere
      data EtatMenuSelecArriere: type=tLOG, init-value=CONST_tLOG_0:0
    SR_EtatMenuSelecCabine
      data EtatMenuSelecCabine: type=tLOG, init-value=CONST_tLOG_0:0
    SR_EtatMenuSelecOuvPlip
      data EtatMenuSelecOuvPlip: type=tLOG, init-value=CONST_tLOG_0:0
    SR_EtatMenuSelReserveZEV
      data EtatMenuSelReserveZEV: type=tLOG, init-value=CONST_tLOG_0:0
    SR_EtatMenuSonPoly
      data EtatMenuSonPoly: type=tBILOG, init-value=CONST_tBILOG_0:0
    SR_EtatMenuStatusAAS
      data EtatMenuStatusAAS: type=tLOG, init-value=CONST_tLOG_0:0
    SR_EtatMenuStatusSAM
      data EtatMenuStatusSAM: type=tLOG, init-value=CONST_tLOG_0:0
    SR_EtatMenuTCFG
      data EtatMenuTCFG: type=tBYTE, init-value=CONST_tBYTE_0:0
    SR_EtatMenuUniteConso
      data EtatMenuUniteConso: type=tLOG, init-value=CONST_tLOG_0:0
    SR_EtatMenuUniteDistance
      data EtatMenuUniteDistance: type=tLOG, init-value=CONST_tLOG_0:0
    SR_EtatMenuUniteTemperature
      data EtatMenuUniteTemperature: type=tLOG, init-value=CONST_tLOG_0:0
    SR_EtatMenuUniteVolume
      data EtatMenuUniteVolume: type=tLOG, init-value=CONST_tLOG_0:0
    SR_EtatMenuVitesse1XVV
      data EtatMenuVitesse1XVV: type=tBYTE, init-value=CONST_tBYTE_0:0
    SR_EtatMenuVitesse2XVV
      data EtatMenuVitesse2XVV: type=tBYTE, init-value=CONST_tBYTE_0:0
    SR_EtatMenuVitesse3XVV
      data EtatMenuVitesse3XVV: type=tBYTE, init-value=CONST_tBYTE_0:0
    SR_EtatMenuVitesse4XVV
      data EtatMenuVitesse4XVV: type=tBYTE, init-value=CONST_tBYTE_0:0
    SR_EtatMenuVitesse5XVV
      data EtatMenuVitesse5XVV: type=tBYTE, init-value=CONST_tBYTE_0:0
    SR_EtatMenuVitLvv1
      data EtatMenuVitLvv1: type=tBYTE, init-value=CONST_tBYTE_0xFF:255
    SR_EtatMenuVitLvv2
      data EtatMenuVitLvv2: type=tBYTE, init-value=CONST_tBYTE_0xFF:255
    SR_EtatMenuVitLvv3
      data EtatMenuVitLvv3: type=tBYTE, init-value=CONST_tBYTE_0xFF:255
    SR_EtatMenuVitLvv4
      data EtatMenuVitLvv4: type=tBYTE, init-value=CONST_tBYTE_0xFF:255
    SR_EtatMenuVitLvv5
      data EtatMenuVitLvv5: type=tBYTE, init-value=CONST_tBYTE_0xFF:255
    SR_EtatMenuVitLvv6
      data EtatMenuVitLvv6: type=tBYTE, init-value=CONST_tBYTE_0xFF:255
    SR_EtatMenuVitRvv1
      data EtatMenuVitRvv1: type=tBYTE, init-value=CONST_tBYTE_0xFF:255
    SR_EtatMenuVitRvv2
      data EtatMenuVitRvv2: type=tBYTE, init-value=CONST_tBYTE_0xFF:255
    SR_EtatMenuVitRvv3
      data EtatMenuVitRvv3: type=tBYTE, init-value=CONST_tBYTE_0xFF:255
    SR_EtatMenuVitRvv4
      data EtatMenuVitRvv4: type=tBYTE, init-value=CONST_tBYTE_0xFF:255
    SR_EtatMenuVitRvv5
      data EtatMenuVitRvv5: type=tBYTE, init-value=CONST_tBYTE_0xFF:255
    SR_EtatMenuVitRvv6
      data EtatMenuVitRvv6: type=tBYTE, init-value=CONST_tBYTE_0xFF:255
    SR_EtatMenuVTOR_IRV
      data EtatMenuVTOR_IRV: type=tLOG, init-value=CONST_tLOG_0:0
    SR_S360_Envoi
      data S360_Envoi: type=tBILOG, init-value=CONST_tBILOG_0:0
    SR_S360_OCTET_1
      data S360_OCTET_1: type=tBYTE, init-value=CONST_tBYTE_0:0
    SR_S360_OCTET_2
      data S360_OCTET_2: type=tBYTE, init-value=CONST_tBYTE_0:0
    SR_S360_OCTET_3
      data S360_OCTET_3: type=tBYTE, init-value=CONST_tBYTE_0:0
    SR_S360_OCTET_4
      data S360_OCTET_4: type=tBYTE, init-value=CONST_tBYTE_0:0
    SR_S360_OCTET_5
      data S360_OCTET_5: type=tBYTE, init-value=CONST_tBYTE_0:0
    SR_S360_OCTET_6
      data S360_OCTET_6: type=tBYTE, init-value=CONST_tBYTE_0:0
    SR_S360_OCTET_7
      data S360_OCTET_7: type=tBYTE, init-value=CONST_tBYTE_0:0
    SR_S360_OCTET_8
      data S360_OCTET_8: type=tBYTE, init-value=CONST_tBYTE_0:0
    SR_S3A0_Recu
      data S3A0_Recu: type=tBILOG, init-value=CONST_tBILOG_0:0
    SR_SEC_AccueilDeMenuPerso
      data SEC_AccueilDeMenuPerso: type=tLOG, init-value=CONST_tLOG_0:0
    SR_SEC_ActButee1XVV
      data SEC_ActButee1XVV: type=tLOG, init-value=CONST_tLOG_0:0
    SR_SEC_ActButee2XVV
      data SEC_ActButee2XVV: type=tLOG, init-value=CONST_tLOG_0:0
    SR_SEC_ActButee3XVV
      data SEC_ActButee3XVV: type=tLOG, init-value=CONST_tLOG_0:0
    SR_SEC_ActButee4XVV
      data SEC_ActButee4XVV: type=tLOG, init-value=CONST_tLOG_0:0
    SR_SEC_ActButee5XVV
      data SEC_ActButee5XVV: type=tLOG, init-value=CONST_tLOG_0:0
    SR_SEC_ActButeeGenXVV
      data SEC_ActButeeGenXVV: type=tLOG, init-value=CONST_tLOG_0:0
    SR_SEC_ActivationARCDeMenuPerso
      data SEC_ActivationARCDeMenuPerso: type=tLOG, init-value=CONST_tLOG_1:1
    SR_SEC_BAAActivationDeMenuPerso
      data SEC_BAAActivationDeMenuPerso: type=tLOG, init-value=CONST_tLOG_0:0
    SR_SEC_BAAAutolockingDeMenuPerso
      data SEC_BAAAutolockingDeMenuPerso: type=tLOG, init-value=CONST_tLOG_0:0
    SR_SEC_CLIM_PrecASAPDeMenuPerso
      data SEC_CLIM_PrecASAPDeMenuPerso: type=tLOG, init-value=CONST_tLOG_0:0
    SR_SEC_CLIM_PrecH1DeMenuPerso
      data SEC_CLIM_PrecH1DeMenuPerso: type=tWORD, init-value=CONST_tWORD_0:0
    SR_SEC_CLIM_PrecH2DeMenuPerso
      data SEC_CLIM_PrecH2DeMenuPerso: type=tWORD, init-value=CONST_tWORD_0:0
    SR_SEC_CLIM_PrecH3DeMenuPerso
      data SEC_CLIM_PrecH3DeMenuPerso: type=tWORD, init-value=CONST_tWORD_0:0
    SR_SEC_CLIM_PrecH4DeMenuPerso
      data SEC_CLIM_PrecH4DeMenuPerso: type=tWORD, init-value=CONST_tWORD_0:0
    SR_SEC_CLIM_PrecOn1DeMenuPerso
      data SEC_CLIM_PrecOn1DeMenuPerso: type=tLOG, init-value=CONST_tLOG_0:0
    SR_SEC_CLIM_PrecOn2DeMenuPerso
      data SEC_CLIM_PrecOn2DeMenuPerso: type=tLOG, init-value=CONST_tLOG_0:0
    SR_SEC_CLIM_PrecOn3DeMenuPerso
      data SEC_CLIM_PrecOn3DeMenuPerso: type=tLOG, init-value=CONST_tLOG_0:0
    SR_SEC_CLIM_PrecOn4DeMenuPerso
      data SEC_CLIM_PrecOn4DeMenuPerso: type=tLOG, init-value=CONST_tLOG_0:0
    SR_SEC_CLIMPrecPrg1DeMenuPerso
      data SEC_CLIMPrecPrg1DeMenuPerso: type=tWORD, init-value=CONST_tWORD_0:0
    SR_SEC_CLIMPrecPrg2DeMenuPerso
      data SEC_CLIMPrecPrg2DeMenuPerso: type=tWORD, init-value=CONST_tWORD_0:0
    SR_SEC_CLIMPrecPrg3DeMenuPerso
      data SEC_CLIMPrecPrg3DeMenuPerso: type=tWORD, init-value=CONST_tWORD_0:0
    SR_SEC_CLIMPrecPrg4DeMenuPerso
      data SEC_CLIMPrecPrg4DeMenuPerso: type=tWORD, init-value=CONST_tWORD_0:0
    SR_SEC_CLIMPrecSem1DeMenuPerso
      data SEC_CLIMPrecSem1DeMenuPerso: type=tBYTE, init-value=CONST_tBYTE_0:0
    SR_SEC_CLIMPrecSem2DeMenuPerso
      data SEC_CLIMPrecSem2DeMenuPerso: type=tBYTE, init-value=CONST_tBYTE_0:0
    SR_SEC_CLIMPrecSem3DeMenuPerso
      data SEC_CLIMPrecSem3DeMenuPerso: type=tBYTE, init-value=CONST_tBYTE_0:0
    SR_SEC_CLIMPrecSem4DeMenuPerso
      data SEC_CLIMPrecSem4DeMenuPerso: type=tBYTE, init-value=CONST_tBYTE_0:0
    SR_SEC_CMDM_DAE_4WDDeMenuPerso
      data SEC_CMDM_DAE_4WDDeMenuPerso: type=t_cDAE, init-value=CONST_t_cDAE_0:0
    SR_SEC_CMDM_DAEDeMenuPerso
      data SEC_CMDM_DAEDeMenuPerso: type=t_cDAE, init-value=CONST_t_cDAE_0:0
    SR_SEC_DAAActivationDeMenuPerso
      data SEC_DAAActivationDeMenuPerso: type=tLOG, init-value=CONST_tLOG_0:0
    SR_SEC_DecondaSelectDeMenuPerso
      data SEC_DecondaSelectDeMenuPerso: type=tLOG, init-value=CONST_tLOG_0:0
    SR_SEC_DSGDeMenuPerso
      data SEC_DSGDeMenuPerso: type=tLOG, init-value=CONST_tLOG_0:0
    SR_SEC_EclAccomp
      data SEC_EclAccomp: type=tLOG, init-value=CONST_tLOG_0:0
    SR_SEC_EclAccompTempo
      data SEC_EclAccompTempo: type=tBYTE, init-value=CONST_tBYTE_0:0
    SR_SEC_EclAdaptDeMenuPerso
      data SEC_EclAdaptDeMenuPerso: type=tLOG, init-value=CONST_tLOG_0:0
    SR_SEC_EclAFSDeMenuPerso
      data SEC_EclAFSDeMenuPerso: type=tLOG, init-value=CONST_tLOG_0:0
    SR_SEC_EclAmbiDeMenuPerso
      data SEC_EclAmbiDeMenuPerso: type=tLOG, init-value=CONST_tLOG_0:0
    SR_SEC_EclAmbiNivDeMenuPerso
      data SEC_EclAmbiNivDeMenuPerso: type=tBYTE, init-value=CONST_tBYTE_3:3
    SR_SEC_EclARSDeMenuPerso
      data SEC_EclARSDeMenuPerso: type=tLOG, init-value=CONST_tLOG_0:0
    SR_SEC_EclAutoDeMenuPerso
      data SEC_EclAutoDeMenuPerso: type=tLOG, init-value=CONST_tLOG_0:0
    SR_SEC_EclAutorouteDeMenuPerso
      data SEC_EclAutorouteDeMenuPerso: type=tLOG, init-value=CONST_tLOG_0:0
    SR_SEC_EclCalandDeMenuPerso
      data SEC_EclCalandDeMenuPerso: type=tBILOG, init-value=CONST_tBILOG_0:0
    SR_SEC_EclDeconda
      data SEC_EclDeconda: type=tLOG, init-value=CONST_tLOG_0:0
    SR_SEC_EclDecondaTempo
      data SEC_EclDecondaTempo: type=tBYTE, init-value=CONST_tBYTE_0:0
    SR_SEC_ECLI_PPC_ANIMDeMenuPerso
      data SEC_ECLI_PPC_ANIMDeMenuPerso: type=tBYTE, init-value=CONST_tBYTE_0:0
    SR_SEC_ECLI_PPC_BLOC1DeMenuPerso
      data SEC_ECLI_PPC_BLOC1DeMenuPerso: type=tLOG, init-value=CONST_tLOG_0:0
    SR_SEC_ECLI_PPC_COL1DeMenuPerso
      data SEC_ECLI_PPC_COL1DeMenuPerso: type=tBYTE, init-value=CONST_tBYTE_1:1
    SR_SEC_ECLX_ECL_CAFRDeMenuPerso
      data SEC_ECLX_ECL_CAFRDeMenuPerso: type=tLOG, init-value=CONST_tLOG_0:0
    SR_SEC_EssuiVitMarDeMenuPerso
      data SEC_EssuiVitMarDeMenuPerso: type=tLOG, init-value=CONST_tLOG_0:0
    SR_SEC_FARCDeMenuPerso
      data SEC_FARCDeMenuPerso: type=tLOG, init-value=CONST_tLOG_0:0
    SR_SEC_FctToucheCfgDeMenuPerso
      data SEC_FctToucheCfgDeMenuPerso: type=t_cFTCG, init-value=CONST_t_cFTCG_0:0
    SR_SEC_FeuxDiurneDeMenuPerso
      data SEC_FeuxDiurneDeMenuPerso: type=tLOG, init-value=CONST_tLOG_0:0
    SR_SEC_FSEAutoDeMenuPerso
      data SEC_FSEAutoDeMenuPerso: type=tLOG, init-value=CONST_tLOG_0:0
    SR_SEC_GAV_AMLADeMenuPerso
      data SEC_GAV_AMLADeMenuPerso: type=tLOG, init-value=CONST_tLOG_0:0
    SR_SEC_ILVDeMenuPerso
      data SEC_ILVDeMenuPerso: type=tLOG, init-value=CONST_tLOG_0:0
    SR_SEC_ILV_ETSRDeMenuPerso
      data SEC_ILV_ETSRDeMenuPerso: type=tLOG, init-value=CONST_tLOG_0:0
    SR_SEC_IMADeMenuPerso
      data SEC_IMADeMenuPerso: type=tLOG, init-value=CONST_tLOG_0:0
    SR_SEC_InhibitionAASDeMenuPerso
      data SEC_InhibitionAASDeMenuPerso: type=tLOG, init-value=CONST_tLOG_0:0
    SR_SEC_InhibitionSAMDeMenuPerso
      data SEC_InhibitionSAMDeMenuPerso: type=tLOG, init-value=CONST_tLOG_0:0
    SR_SEC_INV_ADSDDeMenuPerso
      data SEC_INV_ADSDDeMenuPerso: type=tLOG, init-value=CONST_tLOG_0:0
    SR_SEC_LangueVehicule
      data SEC_LangueVehicule: type=tBYTE, init-value=CONST_tBYTE_0:0
    SR_SEC_MotoVolArDeMenuPerso
      data SEC_MotoVolArDeMenuPerso: type=tLOG, init-value=CONST_tLOG_0:0
    SR_SEC_PrgPemDiDeMenuPerso
      data SEC_PrgPemDiDeMenuPerso: type=tDWORD, init-value=CONST_tDWORD_0:0
    SR_SEC_PrgPemJeDeMenuPerso
      data SEC_PrgPemJeDeMenuPerso: type=tDWORD, init-value=CONST_tDWORD_0:0
    SR_SEC_PrgPemLuDeMenuPerso
      data SEC_PrgPemLuDeMenuPerso: type=tDWORD, init-value=CONST_tDWORD_0:0
    SR_SEC_PrgPemMaDeMenuPerso
      data SEC_PrgPemMaDeMenuPerso: type=tDWORD, init-value=CONST_tDWORD_0:0
    SR_SEC_PrgPemMeDeMenuPerso
      data SEC_PrgPemMeDeMenuPerso: type=tDWORD, init-value=CONST_tDWORD_0:0
    SR_SEC_PrgPemSaDeMenuPerso
      data SEC_PrgPemSaDeMenuPerso: type=tDWORD, init-value=CONST_tDWORD_0:0
    SR_SEC_PrgPemVeDeMenuPerso
      data SEC_PrgPemVeDeMenuPerso: type=tDWORD, init-value=CONST_tDWORD_0:0
    SR_SEC_PRV_MODEDeMenuPerso
      data SEC_PRV_MODEDeMenuPerso: type=tBYTE, init-value=CONST_tBYTE_0:0
    SR_SEC_ReserveZEVDeMenuPerso
      data SEC_ReserveZEVDeMenuPerso: type=tBYTE, init-value=CONST_tBYTE_0:0
    SR_SEC_RTABDeMenuPerso
      data SEC_RTABDeMenuPerso: type=tLOG, init-value=CONST_tLOG_0:0
    SR_SEC_RTAB_EnergyRecDeMenuPerso
      data SEC_RTAB_EnergyRecDeMenuPerso: type=tBYTE, init-value=CONST_tBYTE_0b01:0b01
    SR_SEC_RTAB_RecHDebDeMenuPerso
      data SEC_RTAB_RecHDebDeMenuPerso: type=tWORD, init-value=CONST_tWORD_0:0
    SR_SEC_RTAB_TypeRecDeMenuPerso
      data SEC_RTAB_TypeRecDeMenuPerso: type=tLOG, init-value=CONST_tLOG_0:0
    SR_SEC_SelectOuvARDeMenuPerso
      data SEC_SelectOuvARDeMenuPerso: type=tLOG, init-value=CONST_tLOG_0:0
    SR_SEC_SelReserveZEVDeMenuPerso
      data SEC_SelReserveZEVDeMenuPerso: type=tLOG, init-value=CONST_tLOG_0:0
    SR_SEC_SensibiliteARCDeMenuPerso
      data SEC_SensibiliteARCDeMenuPerso: type=tQUARTET, init-value=CONST_tQUARTET_3:3
    SR_SEC_SonPolyphDeMenuPerso
      data SEC_SonPolyphDeMenuPerso: type=tBILOG, init-value=CONST_tBILOG_0:0
    SR_SEC_UniteConso
      data SEC_UniteConso: type=tLOG, init-value=CONST_tLOG_0:0
    SR_SEC_UniteDistance
      data SEC_UniteDistance: type=tLOG, init-value=CONST_tLOG_0:0
    SR_SEC_UniteTemperature
      data SEC_UniteTemperature: type=tLOG, init-value=CONST_tLOG_0:0
    SR_SEC_UniteVolume
      data SEC_UniteVolume: type=tLOG, init-value=CONST_tLOG_0:0
    SR_SEC_VAM_ECS_MODEDeMenuPerso
      data SEC_VAM_ECS_MODEDeMenuPerso: type=tLOG, init-value=CONST_tLOG_0:0
    SR_SEC_Vitesse1XVV
      data SEC_Vitesse1XVV: type=tBYTE, init-value=CONST_tBYTE_0:0
    SR_SEC_Vitesse2XVV
      data SEC_Vitesse2XVV: type=tBYTE, init-value=CONST_tBYTE_0:0
    SR_SEC_Vitesse3XVV
      data SEC_Vitesse3XVV: type=tBYTE, init-value=CONST_tBYTE_0:0
    SR_SEC_Vitesse4XVV
      data SEC_Vitesse4XVV: type=tBYTE, init-value=CONST_tBYTE_0:0
    SR_SEC_Vitesse5XVV
      data SEC_Vitesse5XVV: type=tBYTE, init-value=CONST_tBYTE_0:0
    SR_SEC_VitLvv1DeMenuPerso
      data SEC_VitLvv1DeMenuPerso: type=tBYTE, init-value=CONST_tBYTE_0:0
    SR_SEC_VitLvv1MilesDeMenuPerso
      data SEC_VitLvv1MilesDeMenuPerso: type=tBYTE, init-value=CONST_tBYTE_0:0
    SR_SEC_VitLvv2DeMenuPerso
      data SEC_VitLvv2DeMenuPerso: type=tBYTE, init-value=CONST_tBYTE_0:0
    SR_SEC_VitLvv2MilesDeMenuPerso
      data SEC_VitLvv2MilesDeMenuPerso: type=tBYTE, init-value=CONST_tBYTE_0:0
    SR_SEC_VitLvv3DeMenuPerso
      data SEC_VitLvv3DeMenuPerso: type=tBYTE, init-value=CONST_tBYTE_0:0
    SR_SEC_VitLvv3MilesDeMenuPerso
      data SEC_VitLvv3MilesDeMenuPerso: type=tBYTE, init-value=CONST_tBYTE_0:0
    SR_SEC_VitLvv4DeMenuPerso
      data SEC_VitLvv4DeMenuPerso: type=tBYTE, init-value=CONST_tBYTE_0:0
    SR_SEC_VitLvv4MilesDeMenuPerso
      data SEC_VitLvv4MilesDeMenuPerso: type=tBYTE, init-value=CONST_tBYTE_0:0
    SR_SEC_VitLvv5DeMenuPerso
      data SEC_VitLvv5DeMenuPerso: type=tBYTE, init-value=CONST_tBYTE_0:0
    SR_SEC_VitLvv5MilesDeMenuPerso
      data SEC_VitLvv5MilesDeMenuPerso: type=tBYTE, init-value=CONST_tBYTE_0:0
    SR_SEC_VitLvv6DeMenuPerso
      data SEC_VitLvv6DeMenuPerso: type=tBYTE, init-value=CONST_tBYTE_0:0
    SR_SEC_VitLvv6MilesDeMenuPerso
      data SEC_VitLvv6MilesDeMenuPerso: type=tBYTE, init-value=CONST_tBYTE_0:0
    SR_SEC_VitRvv1DeMenuPerso
      data SEC_VitRvv1DeMenuPerso: type=tBYTE, init-value=CONST_tBYTE_0:0
    SR_SEC_VitRvv1MilesDeMenuPerso
      data SEC_VitRvv1MilesDeMenuPerso: type=tBYTE, init-value=CONST_tBYTE_0:0
    SR_SEC_VitRvv2DeMenuPerso
      data SEC_VitRvv2DeMenuPerso: type=tBYTE, init-value=CONST_tBYTE_0:0
    SR_SEC_VitRvv2MilesDeMenuPerso
      data SEC_VitRvv2MilesDeMenuPerso: type=tBYTE, init-value=CONST_tBYTE_0:0
    SR_SEC_VitRvv3DeMenuPerso
      data SEC_VitRvv3DeMenuPerso: type=tBYTE, init-value=CONST_tBYTE_0:0
    SR_SEC_VitRvv3MilesDeMenuPerso
      data SEC_VitRvv3MilesDeMenuPerso: type=tBYTE, init-value=CONST_tBYTE_0:0
    SR_SEC_VitRvv4DeMenuPerso
      data SEC_VitRvv4DeMenuPerso: type=tBYTE, init-value=CONST_tBYTE_0:0
    SR_SEC_VitRvv4MilesDeMenuPerso
      data SEC_VitRvv4MilesDeMenuPerso: type=tBYTE, init-value=CONST_tBYTE_0:0
    SR_SEC_VitRvv5DeMenuPerso
      data SEC_VitRvv5DeMenuPerso: type=tBYTE, init-value=CONST_tBYTE_0:0
    SR_SEC_VitRvv5MilesDeMenuPerso
      data SEC_VitRvv5MilesDeMenuPerso: type=tBYTE, init-value=CONST_tBYTE_0:0
    SR_SEC_VitRvv6DeMenuPerso
      data SEC_VitRvv6DeMenuPerso: type=tBYTE, init-value=CONST_tBYTE_0:0
    SR_SEC_VitRvv6MilesDeMenuPerso
      data SEC_VitRvv6MilesDeMenuPerso: type=tBYTE, init-value=CONST_tBYTE_0:0
    SR_SEC_VTOR_IRVDeMenuPerso
      data SEC_VTOR_IRVDeMenuPerso: type=tLOG, init-value=CONST_tLOG_0:0
    SR_SEC_ZCSelectDeMenuPerso
      data SEC_ZCSelectDeMenuPerso: type=tLOG, init-value=CONST_tLOG_0:0
    SR_ToggleNewFrame15B
      data ToggleNewFrame15B: type=tLOG, init-value=CONST_tLOG_0:0
    SR_AffMenuPrgPem
      data AffMenuPrgPem: type=tLOG, init-value=CONST_tLOG_0:0
    SR_AffMenuReserveZEV
      data AffMenuReserveZEV: type=tLOG, init-value=CONST_tLOG_0:0
    SR_AppuiPushBEPR
      data AppuiPushBEPR: type=tLOG, init-value=CONST_tLOG_0:0
    SR_AppuiPushMPDParHDC
      data AppuiPushMPDParHDC: type=tLOG, init-value=CONST_tLOG_0:0
    SR_AppuiToucheConfigDeVMF
      data AppuiToucheConfigDeVMF: type=tLOG, init-value=CONST_tLOG_0:0
    SR_CondaRealiseePourCAN
      data CondaRealiseePourCAN: type=tBYTE, init-value=CONST_tBYTE_0:0
    SR_DispoDmdMenuPrgPem
      data DispoDmdMenuPrgPem: type=tLOG, init-value=CONST_tLOG_0:0
    SR_DmdDispoDmdMenuReserveZEV
      data DmdDispoDmdMenuReserveZEV: type=tLOG, init-value=CONST_tLOG_0:0
    SR_DmdmCGEPVOffReserveZEV
      data DmdmCGEPVOffReserveZEV: type=tLOG, init-value=CONST_tLOG_0:0
    SR_DmdMenuAccueilCond
      data DmdMenuAccueilCond: type=tLOG, init-value=CONST_tLOG_0:0
    SR_DmdMenuActButee1XVV
      data DmdMenuActButee1XVV: type=tLOG, init-value=CONST_tLOG_0:0
    SR_DmdMenuActButee2XVV
      data DmdMenuActButee2XVV: type=tLOG, init-value=CONST_tLOG_0:0
    SR_DmdMenuActButee3XVV
      data DmdMenuActButee3XVV: type=tLOG, init-value=CONST_tLOG_0:0
    SR_DmdMenuActButee4XVV
      data DmdMenuActButee4XVV: type=tLOG, init-value=CONST_tLOG_0:0
    SR_DmdMenuActButee5XVV
      data DmdMenuActButee5XVV: type=tLOG, init-value=CONST_tLOG_0:0
    SR_DmdMenuActButeeGenXVV
      data DmdMenuActButeeGenXVV: type=tLOG, init-value=CONST_tLOG_0:0
    SR_DmdMenuARCSensNiv
      data DmdMenuARCSensNiv: type=tBILOG, init-value=CONST_tBILOG_2:2
    SR_DmdMenuBAAActivation
      data DmdMenuBAAActivation: type=tLOG, init-value=CONST_tLOG_0:0
    SR_DmdMenuBAAAutolocking
      data DmdMenuBAAAutolocking: type=tLOG, init-value=CONST_tLOG_0:0
    SR_DmdMenuClim_PrecondASAP
      data DmdMenuClim_PrecondASAP: type=tLOG, init-value=CONST_tLOG_0:0
    SR_DmdMenuCLIM_PrecondDi1
      data DmdMenuCLIM_PrecondDi1: type=tLOG, init-value=CONST_tLOG_0:0
    SR_DmdMenuCLIM_PrecondDi2
      data DmdMenuCLIM_PrecondDi2: type=tLOG, init-value=CONST_tLOG_0:0
    SR_DmdMenuCLIM_PrecondDi3
      data DmdMenuCLIM_PrecondDi3: type=tLOG, init-value=CONST_tLOG_0:0
    SR_DmdMenuCLIM_PrecondDi4
      data DmdMenuCLIM_PrecondDi4: type=tLOG, init-value=CONST_tLOG_0:0
    SR_DmdMenuCLIM_PrecondH1
      data DmdMenuCLIM_PrecondH1: type=tWORD, init-value=CONST_tWORD_0:0
    SR_DmdMenuCLIM_PrecondH2
      data DmdMenuCLIM_PrecondH2: type=tWORD, init-value=CONST_tWORD_0:0
    SR_DmdMenuCLIM_PrecondH3
      data DmdMenuCLIM_PrecondH3: type=tWORD, init-value=CONST_tWORD_0:0
    SR_DmdMenuCLIM_PrecondH4
      data DmdMenuCLIM_PrecondH4: type=tWORD, init-value=CONST_tWORD_0:0
    SR_DmdMenuCLIM_PrecondJe1
      data DmdMenuCLIM_PrecondJe1: type=tLOG, init-value=CONST_tLOG_0:0
    SR_DmdMenuCLIM_PrecondJe2
      data DmdMenuCLIM_PrecondJe2: type=tLOG, init-value=CONST_tLOG_0:0
    SR_DmdMenuCLIM_PrecondJe3
      data DmdMenuCLIM_PrecondJe3: type=tLOG, init-value=CONST_tLOG_0:0
    SR_DmdMenuCLIM_PrecondJe4
      data DmdMenuCLIM_PrecondJe4: type=tLOG, init-value=CONST_tLOG_0:0
    SR_DmdMenuCLIM_PrecondLu1
      data DmdMenuCLIM_PrecondLu1: type=tLOG, init-value=CONST_tLOG_0:0
    SR_DmdMenuCLIM_PrecondLu2
      data DmdMenuCLIM_PrecondLu2: type=tLOG, init-value=CONST_tLOG_0:0
    SR_DmdMenuCLIM_PrecondLu3
      data DmdMenuCLIM_PrecondLu3: type=tLOG, init-value=CONST_tLOG_0:0
    SR_DmdMenuCLIM_PrecondLu4
      data DmdMenuCLIM_PrecondLu4: type=tLOG, init-value=CONST_tLOG_0:0
    SR_DmdMenuCLIM_PrecondMa1
      data DmdMenuCLIM_PrecondMa1: type=tLOG, init-value=CONST_tLOG_0:0
    SR_DmdMenuCLIM_PrecondMa2
      data DmdMenuCLIM_PrecondMa2: type=tLOG, init-value=CONST_tLOG_0:0
    SR_DmdMenuCLIM_PrecondMa3
      data DmdMenuCLIM_PrecondMa3: type=tLOG, init-value=CONST_tLOG_0:0
    SR_DmdMenuCLIM_PrecondMa4
      data DmdMenuCLIM_PrecondMa4: type=tLOG, init-value=CONST_tLOG_0:0
    SR_DmdMenuCLIM_PrecondMe1
      data DmdMenuCLIM_PrecondMe1: type=tLOG, init-value=CONST_tLOG_0:0
    SR_DmdMenuCLIM_PrecondMe2
      data DmdMenuCLIM_PrecondMe2: type=tLOG, init-value=CONST_tLOG_0:0
    SR_DmdMenuCLIM_PrecondMe3
      data DmdMenuCLIM_PrecondMe3: type=tLOG, init-value=CONST_tLOG_0:0
    SR_DmdMenuCLIM_PrecondMe4
      data DmdMenuCLIM_PrecondMe4: type=tLOG, init-value=CONST_tLOG_0:0
    SR_DmdMenuCLIM_PrecondOn1
      data DmdMenuCLIM_PrecondOn1: type=tLOG, init-value=CONST_tLOG_0:0
    SR_DmdMenuCLIM_PrecondOn2
      data DmdMenuCLIM_PrecondOn2: type=tLOG, init-value=CONST_tLOG_0:0
    SR_DmdMenuCLIM_PrecondOn3
      data DmdMenuCLIM_PrecondOn3: type=tLOG, init-value=CONST_tLOG_0:0
    SR_DmdMenuCLIM_PrecondOn4
      data DmdMenuCLIM_PrecondOn4: type=tLOG, init-value=CONST_tLOG_0:0
    SR_DmdMenuCLIM_PrecondSa1
      data DmdMenuCLIM_PrecondSa1: type=tLOG, init-value=CONST_tLOG_0:0
    SR_DmdMenuCLIM_PrecondSa2
      data DmdMenuCLIM_PrecondSa2: type=tLOG, init-value=CONST_tLOG_0:0
    SR_DmdMenuCLIM_PrecondSa3
      data DmdMenuCLIM_PrecondSa3: type=tLOG, init-value=CONST_tLOG_0:0
    SR_DmdMenuCLIM_PrecondSa4
      data DmdMenuCLIM_PrecondSa4: type=tLOG, init-value=CONST_tLOG_0:0
    SR_DmdMenuCLIM_PrecondVe1
      data DmdMenuCLIM_PrecondVe1: type=tLOG, init-value=CONST_tLOG_0:0
    SR_DmdMenuCLIM_PrecondVe2
      data DmdMenuCLIM_PrecondVe2: type=tLOG, init-value=CONST_tLOG_0:0
    SR_DmdMenuCLIM_PrecondVe3
      data DmdMenuCLIM_PrecondVe3: type=tLOG, init-value=CONST_tLOG_0:0
    SR_DmdMenuCLIM_PrecondVe4
      data DmdMenuCLIM_PrecondVe4: type=tLOG, init-value=CONST_tLOG_0:0
    SR_DmdMenuCMDM_DAE
      data DmdMenuCMDM_DAE: type=tLOG, init-value=CONST_tLOG_0:0
    SR_DmdMenuCMDM_DAE_4WD
      data DmdMenuCMDM_DAE_4WD: type=tLOG, init-value=CONST_tLOG_0:0
    SR_DmdMenuDAAActivation
      data DmdMenuDAAActivation: type=tLOG, init-value=CONST_tLOG_0:0
    SR_DmdMenuDSG
      data DmdMenuDSG: type=tLOG, init-value=CONST_tLOG_0:0
    SR_DmdMenuEclAccomp
      data DmdMenuEclAccomp: type=tLOG, init-value=CONST_tLOG_0:0
    SR_DmdMenuEclAccompTempo
      data DmdMenuEclAccompTempo: type=tBILOG, init-value=CONST_tBILOG_0:0
    SR_DmdMenuEclAdapt
      data DmdMenuEclAdapt: type=tLOG, init-value=CONST_tLOG_0:0
    SR_DmdMenuEclAmbi
      data DmdMenuEclAmbi: type=tLOG, init-value=CONST_tLOG_0:0
    SR_DmdMenuEclAmbiNiv
      data DmdMenuEclAmbiNiv: type=tBYTE, init-value=CONST_tBYTE_3:3
    SR_DmdMenuEclAuto
      data DmdMenuEclAuto: type=tLOG, init-value=CONST_tLOG_0:0
    SR_DmdMenuEclAutoroute
      data DmdMenuEclAutoroute: type=tLOG, init-value=CONST_tLOG_0:0
    SR_DmdMenuEclCaland
      data DmdMenuEclCaland: type=tLOG, init-value=CONST_tLOG_0:0
    SR_DmdMenuEclDeconda
      data DmdMenuEclDeconda: type=tLOG, init-value=CONST_tLOG_0:0
    SR_DmdMenuEclDecondaTempo
      data DmdMenuEclDecondaTempo: type=tBILOG, init-value=CONST_tBILOG_0:0
    SR_DmdMenuECLI_PPC_ANIM
      data DmdMenuECLI_PPC_ANIM: type=tBYTE, init-value=CONST_tBYTE_0:0
    SR_DmdMenuECLI_PPC_BLOC1
      data DmdMenuECLI_PPC_BLOC1: type=tLOG, init-value=CONST_tLOG_0:0
    SR_DmdMenuECLI_PPC_COL1
      data DmdMenuECLI_PPC_COL1: type=tBYTE, init-value=CONST_tBYTE_0:0
    SR_DmdMenuECLX_AFS
      data DmdMenuECLX_AFS: type=tLOG, init-value=CONST_tLOG_0:0
    SR_DmdMenuECLX_ARS
      data DmdMenuECLX_ARS: type=tLOG, init-value=CONST_tLOG_0:0
    SR_DmdMenuECLX_ECL_CAFR
      data DmdMenuECLX_ECL_CAFR: type=tLOG, init-value=CONST_tLOG_0:0
    SR_DmdMenuEssuiVitMar
      data DmdMenuEssuiVitMar: type=tLOG, init-value=CONST_tLOG_0:0
    SR_DmdMenuFARC
      data DmdMenuFARC: type=tLOG, init-value=CONST_tLOG_0:0
    SR_DmdMenuFeuxDiurne
      data DmdMenuFeuxDiurne: type=tLOG, init-value=CONST_tLOG_0:0
    SR_DmdMenuFSEAuto
      data DmdMenuFSEAuto: type=tLOG, init-value=CONST_tLOG_0:0
    SR_DmdMenuGAV_AMLA
      data DmdMenuGAV_AMLA: type=tLOG, init-value=CONST_tLOG_0:0
    SR_DmdMenuILV
      data DmdMenuILV: type=tLOG, init-value=CONST_tLOG_0:0
    SR_DmdMenuILV_ETSR
      data DmdMenuILV_ETSR: type=tLOG, init-value=CONST_tLOG_0:0
    SR_DmdMenuIMA
      data DmdMenuIMA: type=tLOG, init-value=CONST_tLOG_0:0
    SR_DmdMenuInfoLvvDispo
      data DmdMenuInfoLvvDispo: type=tLOG, init-value=CONST_tLOG_0:0
    SR_DmdMenuInfoParamDispo
      data DmdMenuInfoParamDispo: type=tLOG, init-value=CONST_tLOG_0:0
    SR_DmdMenuInfoPrecondDispo
      data DmdMenuInfoPrecondDispo: type=tLOG, init-value=CONST_tLOG_0:0
    SR_DmdMenuInfoRechargeDispo
      data DmdMenuInfoRechargeDispo: type=tLOG, init-value=CONST_tLOG_0:0
    SR_DmdMenuInfoRvvDispo
      data DmdMenuInfoRvvDispo: type=tLOG, init-value=CONST_tLOG_0:0
    SR_DmdMenuInfoUniteLangueDispo
      data DmdMenuInfoUniteLangueDispo: type=tLOG, init-value=CONST_tLOG_0:0
    SR_DmdMenuInfoXVVDispo
      data DmdMenuInfoXVVDispo: type=tLOG, init-value=CONST_tLOG_0:0
    SR_DmdMenuINV_ADSD
      data DmdMenuINV_ADSD: type=tLOG, init-value=CONST_tLOG_0:0
    SR_DmdMenuLangueVehicule
      data DmdMenuLangueVehicule: type=tBYTE, init-value=CONST_tBYTE_0:0
    SR_DmdMenuMotoVolAr
      data DmdMenuMotoVolAr: type=tLOG, init-value=CONST_tLOG_0:0
    SR_DmdMenuPresenceARC
      data DmdMenuPresenceARC: type=tLOG, init-value=CONST_tLOG_0:0
    SR_DmdMenuPrgHcEnd
      data DmdMenuPrgHcEnd: type=tDWORD, init-value=CONST_tDWORD_0:0
    SR_DmdMenuPrgHcStart
      data DmdMenuPrgHcStart: type=tDWORD, init-value=CONST_tDWORD_0:0
    SR_DmdMenuPrgPemDi
      data DmdMenuPrgPemDi: type=tDWORD, init-value=CONST_tDWORD_0:0
    SR_DmdMenuPrgPemJe
      data DmdMenuPrgPemJe: type=tDWORD, init-value=CONST_tDWORD_0:0
    SR_DmdMenuPrgPemLu
      data DmdMenuPrgPemLu: type=tDWORD, init-value=CONST_tDWORD_0:0
    SR_DmdMenuPrgPemMa
      data DmdMenuPrgPemMa: type=tDWORD, init-value=CONST_tDWORD_0:0
    SR_DmdMenuPrgPemMe
      data DmdMenuPrgPemMe: type=tDWORD, init-value=CONST_tDWORD_0:0
    SR_DmdMenuPrgPemSa
      data DmdMenuPrgPemSa: type=tDWORD, init-value=CONST_tDWORD_0:0
    SR_DmdMenuPrgPemVe
      data DmdMenuPrgPemVe: type=tDWORD, init-value=CONST_tDWORD_0:0
    SR_DmdMenuPRV_MODE
      data DmdMenuPRV_MODE: type=tBYTE, init-value=CONST_tBYTE_0:0
    SR_DmdMenuReserveZEV
      data DmdMenuReserveZEV: type=tBILOG, init-value=CONST_tBILOG_0:0
    SR_DmdMenuRTAB_EnergyRec
      data DmdMenuRTAB_EnergyRec: type=tBYTE, init-value=CONST_tBYTE_0b01:0b01
    SR_DmdMenuRTAB_RechargeHDeb
      data DmdMenuRTAB_RechargeHDeb: type=tWORD, init-value=CONST_tWORD_0:0
    SR_DmdMenuRTAB_TypeRec
      data DmdMenuRTAB_TypeRec: type=tLOG, init-value=CONST_tLOG_0:0
    SR_DmdMenuSelecArriere
      data DmdMenuSelecArriere: type=tLOG, init-value=CONST_tLOG_0:0
    SR_DmdMenuSelecCabine
      data DmdMenuSelecCabine: type=tLOG, init-value=CONST_tLOG_0:0
    SR_DmdMenuSelecOuvPlip
      data DmdMenuSelecOuvPlip: type=tLOG, init-value=CONST_tLOG_0:0
    SR_DmdMenuSelPrgHc
      data DmdMenuSelPrgHc: type=tLOG, init-value=CONST_tLOG_0:0
    SR_DmdMenuSelReserveZEV
      data DmdMenuSelReserveZEV: type=tLOG, init-value=CONST_tLOG_0:0
    SR_DmdMenuSonPoly
      data DmdMenuSonPoly: type=tBILOG, init-value=CONST_tBILOG_0:0
    SR_DmdMenuStatusAAS
      data DmdMenuStatusAAS: type=tLOG, init-value=CONST_tLOG_0:0
    SR_DmdMenuStatusSAM
      data DmdMenuStatusSAM: type=tLOG, init-value=CONST_tLOG_0:0
    SR_DmdMenuTCFG
      data DmdMenuTCFG: type=tBYTE, init-value=CONST_tBYTE_0:0
    SR_DmdMenuUniteConso
      data DmdMenuUniteConso: type=tLOG, init-value=CONST_tLOG_0:0
    SR_DmdMenuUniteDistance
      data DmdMenuUniteDistance: type=tLOG, init-value=CONST_tLOG_0:0
    SR_DmdMenuUniteTemperature
      data DmdMenuUniteTemperature: type=tLOG, init-value=CONST_tLOG_0:0
    SR_DmdMenuUniteVolume
      data DmdMenuUniteVolume: type=tLOG, init-value=CONST_tLOG_0:0
    SR_DmdMenuVAM_ECS_MODE
      data DmdMenuVAM_ECS_MODE: type=tLOG, init-value=CONST_tLOG_0:0
    SR_DmdMenuVitesse1XVV
      data DmdMenuVitesse1XVV: type=tBYTE, init-value=CONST_tBYTE_0:0
    SR_DmdMenuVitesse2XVV
      data DmdMenuVitesse2XVV: type=tBYTE, init-value=CONST_tBYTE_0:0
    SR_DmdMenuVitesse3XVV
      data DmdMenuVitesse3XVV: type=tBYTE, init-value=CONST_tBYTE_0:0
    SR_DmdMenuVitesse4XVV
      data DmdMenuVitesse4XVV: type=tBYTE, init-value=CONST_tBYTE_0:0
    SR_DmdMenuVitesse5XVV
      data DmdMenuVitesse5XVV: type=tBYTE, init-value=CONST_tBYTE_0:0
    SR_DmdMenuVitLvv1
      data DmdMenuVitLvv1: type=tBYTE, init-value=CONST_tBYTE_0:0
    SR_DmdMenuVitLvv2
      data DmdMenuVitLvv2: type=tBYTE, init-value=CONST_tBYTE_0:0
    SR_DmdMenuVitLvv3
      data DmdMenuVitLvv3: type=tBYTE, init-value=CONST_tBYTE_0:0
    SR_DmdMenuVitLvv4
      data DmdMenuVitLvv4: type=tBYTE, init-value=CONST_tBYTE_0:0
    SR_DmdMenuVitLvv5
      data DmdMenuVitLvv5: type=tBYTE, init-value=CONST_tBYTE_0:0
    SR_DmdMenuVitLvv6
      data DmdMenuVitLvv6: type=tBYTE, init-value=CONST_tBYTE_0:0
    SR_DmdMenuVitRvv1
      data DmdMenuVitRvv1: type=tBYTE, init-value=CONST_tBYTE_0:0
    SR_DmdMenuVitRvv2
      data DmdMenuVitRvv2: type=tBYTE, init-value=CONST_tBYTE_0:0
    SR_DmdMenuVitRvv3
      data DmdMenuVitRvv3: type=tBYTE, init-value=CONST_tBYTE_0:0
    SR_DmdMenuVitRvv4
      data DmdMenuVitRvv4: type=tBYTE, init-value=CONST_tBYTE_0:0
    SR_DmdMenuVitRvv5
      data DmdMenuVitRvv5: type=tBYTE, init-value=CONST_tBYTE_0:0
    SR_DmdMenuVitRvv6
      data DmdMenuVitRvv6: type=tBYTE, init-value=CONST_tBYTE_0:0
    SR_DmdMenuVTOR_IRV
      data DmdMenuVTOR_IRV: type=tLOG, init-value=CONST_tLOG_0:0
    SR_MenuPersoMuet
      data MenuPersoMuet: type=tLOG, init-value=CONST_tLOG_0:0
    SR_RechargeTypeStatus
      data RechargeTypeStatus: type=tBYTE, init-value=CONST_tBYTE_0:0
    SR_ToggleNewFrame19B
      data ToggleNewFrame19B: type=tLOG, init-value=CONST_tLOG_0:0
    SR_ToggleNewFrame1DB
      data ToggleNewFrame1DB: type=tLOG, init-value=CONST_tLOG_0:0
    SR_ToggleNewFrame25B29B
      data ToggleNewFrame25B29B: type=tLOG, init-value=CONST_tLOG_0:0
    SR_ToggleNewFrame2DB
      data ToggleNewFrame2DB: type=tLOG, init-value=CONST_tLOG_0:0
    SR_IndexTableInPartition
      data IndexConfig_Menu: type=tBYTE, init-value=CONST_tBYTE_0:0
      data IndexPrecond: type=tBYTE, init-value=CONST_tBYTE_0:0
      data IndexTempo_Histo: type=tBYTE, init-value=CONST_tBYTE_0:0
package /RootP_SR_Param
  266 x sender receiver interface:
    SR_C26_ALT_FR_DISTANCE_SEED
      data C26_ALT_FR_DISTANCE_SEED: type=t_C26_ALT_FR_DISTANCE_SEED, init-value=CONST_t_C26_ALT_FR_DISTANCE_SEED_240:240  # GEN-VHL-DCINT-CONSO.0104(0)
    SR_C26_ALT_FR_FUEL_USED_SEED
      data C26_ALT_FR_FUEL_USED_SEED: type=t_C26_ALT_FR_FUEL_USED_SEED, init-value=CONST_t_C26_ALT_FR_FUEL_USED_SEED_20:20  # GEN-VHL-DCINT-CONSO.0105(0)
    SR_C26_AUTONOMIE_MAX
      data C26_AUTONOMIE_MAX: type=tWORD, init-value=CONST_tWORD_1280:1280  # Valeur maximale pour l'autonomie .AUTONCONSO.PAR.26(1)
    SR_C26_AUTONOMIE_MAX_GM
      data C26_AUTONOMIE_MAX_GM: type=tWORD, init-value=CONST_tWORD_2000:2000  # Valeur maximale pour l'autonomie
    SR_C26_AUTONOMIE_MAX_PSA
      data C26_AUTONOMIE_MAX_PSA: type=tWORD, init-value=CONST_tWORD_1280:1280  # Valeur maximale pour l'autonomie
    SR_C26_BORNE_AUTONOMIE_1
      data C26_BORNE_AUTONOMIE_1: type=tWORD, init-value=CONST_tWORD_200:200  # Donnée entrant dans le calcul de l'hystérésis d'affichage qui évite les bagotements intempestifs. Borne inférieure de l'autonomie calculée corrigée. (Res: 10 Kms) .AUTONCONSO.PAR.21(0)
    SR_C26_BORNE_AUTONOMIE_2
      data C26_BORNE_AUTONOMIE_2: type=tWORD, init-value=CONST_tWORD_500:500  # Donnée entrant dans le calcul de l'hystérésis d'affichage qui évite les bagotements intempestifs. Borne supérieure de l'autonomie calculée corrigée. (Res: 10 Kms) .AUTONCONSO.PAR.22(0)
    SR_C26_COEF_HYST_MOINS
      data C26_COEF_HYST_MOINS: type=tBYTE, init-value=CONST_tBYTE_10:10  # Donnée entrant dans le calcul de Autonomie_Hyst. Coefficient qui définit un seuil bas de l'hystérésis pour une évolution dynamique de ce seuil. (Res: 0,1) .AUTONCONSO.PAR.20(0)
    SR_C26_COEF_HYST_PLUS
      data C26_COEF_HYST_PLUS: type=tBYTE, init-value=CONST_tBYTE_15:15  # Donnée entrant dans le calcul de Autonomie_Hyst. Coefficient qui définit un seuil haut de l'hystérésis pour une évolution dynamique de ce seuil. (Res: 0.1) .AUTONCONSO.PAR.19(0)
    SR_C26_CONSO_INST_MAX
      data C26_CONSO_INST_MAX: type=tBYTE, init-value=CONST_tBYTE_30:30  # Valeur maximale pour la consommation instantanée pendant un trajet. (Res: 0.1 l/100Km)
    SR_C26_CONSO_MOY_MAX
      data C26_CONSO_MOY_MAX: type=tBYTE, init-value=CONST_tBYTE_30:30  # Valeur maximale pour la consommation moyenne pendant un trajet. (Res: 0.1l/100Km)
    SR_C26_DISTANCE_MAX
      data C26_DISTANCE_MAX: type=tWORD, init-value=CONST_tWORD_9999:9999  # Distance maximale depuis dernière RAZ. (Res: Km) .AUTONCONSO.PAR.30(0)
    SR_C26_DISTANCE_MINI
      data C26_DISTANCE_MINI: type=tWORD, init-value=CONST_tWORD_400:400  # Distance minimum pour qu'un trajet soit VALIDE. (Res: 10cm (0.1m)) .AUTONCONSO.PAR.01(2)
    SR_C26_DISTANCE_MINI_HY
      data C26_DISTANCE_MINI_HY: type=t_C26_DISTANCE_MINI_HY, init-value=CONST_t_C26_DISTANCE_MINI_HY_250:250  # Distance minimum à prendre en compte pour avoir une valeur cohérente dans le calcul de consommation moyenne HY .AUTONCONSO.PAR.39(0)
    SR_C26_FILTER_GM
      data C26_FILTER_GM: type=t_C26_FILTER_GM, init-value=CONST_t_C26_FILTER_GM_351:351  # Coefficient 0,351
    SR_C26_HYST_AUTONOMIE_MAX
      data C26_HYST_AUTONOMIE_MAX: type=tBYTE, init-value=CONST_tBYTE_100:100  # Seuil pour sortie de l'état invalide de l'autonomie .AUTONCONSO.PAR.37(0)
    SR_C26_IDLING_TIMEGPL
      data C26_IDLING_TIMEGPL: type=tBYTE, init-value=CONST_tBYTE_40:40  # Temps minimin pour arreter le calcul de l'autonomie GPL
    SR_C26_LIMITE_DETECTION_PIED_LEVE
      data C26_LIMITE_DETECTION_PIED_LEVE: type=tBYTE, init-value=CONST_tBYTE_5:5  # Seuil de quantité de carburant consommé pendant T24_DELTA_MES_CONSO_CARB permettant de détecter un pied levé. (Res : 80 mm3) .AUTONCONSO.PAR.09(1)
    SR_C26_LIMITE_DETECTION_PIED_LEVE_GPL
      data C26_LIMITE_DETECTION_PIED_LEVE_GPL: type=tBYTE, init-value=CONST_tBYTE_5:5  # Seuil de quantité de carburant consommé pendant T24_DELTA_MES_CONSO_CARB permettant de détecter un pied levé. (Res : 80 mm3)
    SR_C26_MAXDIST_GM
      data C26_MAXDIST_GM: type=t_C26_MAXDIST_GM, init-value=CONST_t_C26_MAXDIST_GM_240:240  # 240 km
    SR_C26_MAXFUEL_GM
      data C26_MAXFUEL_GM: type=t_C26_MAXFUEL_GM, init-value=CONST_t_C26_MAXFUEL_GM_20:20  # 20 litres
    SR_C26_MAX_WORD_VALUE
      data C26_MAX_WORD_VALUE: type=tWORD, init-value=CONST_tWORD_65535:65535  # Constante correspondant à la valeur max d'un word = 0xffff .AUTONCONSO.PAR.38(0)
    SR_C26_MOTEUR_MIN
      data C26_MOTEUR_MIN: type=tWORD, init-value=CONST_tWORD_100:100  # Regime moteur au dessus duquel le diagnostique des informations \Pseudo consommation carburant\ et \Consommation carburant reelle\ est effectué. (Res:tr/min) .AUTONCONSO.PAR.02(1)
    SR_C26_OFFSET_GM
      data C26_OFFSET_GM: type=tBYTE, init-value=CONST_tBYTE_0:0  # Offset à modifier, init zero
    SR_C26_PAS_AUTONOMIE_1
      data C26_PAS_AUTONOMIE_1: type=tBYTE, init-value=CONST_tBYTE_5:5  # Donnée entrant dans le calcul de l'hystérésis d'affichage qui évite les bagotements intempestifs. Pas d'affichage si l'autonomie calculée corrigée est inférieur ou égale à C26_BORNE_AUTONOMIE_1. (Res : 1 Km) .AUTONCONSO.PAR.23(0)
    SR_C26_PAS_AUTONOMIE_2
      data C26_PAS_AUTONOMIE_2: type=tBYTE, init-value=CONST_tBYTE_10:10  # Donnée entrant dans le calcul de l'hystérésis d'affichage qui évite les bagotements intempestifs. Pas d'affichage si l'autonomie calculée corrigée est strictement supérieure à C26_BORNE_AUTONOMIE_1 et inférieure ou égale à C26_BORNE_AUTONOMIE_2. (Res: 1 Km) .AUTONCONSO.PAR.24(0)
    SR_C26_PAS_AUTONOMIE_3
      data C26_PAS_AUTONOMIE_3: type=tBYTE, init-value=CONST_tBYTE_20:20  # Donnée entrant dans le calcul de l'hystérésis d'affichage qui évite les bagotements intempestifs. Pas d'affichage si l'autonomie calculée corrigée est strictement supérieure à C26_BORNE_AUTONOMIE_2. (Res: 1 Km) .AUTONCONSO.PAR.25(0)
    SR_C26_RANGE_SCALEGPL
      data C26_RANGE_SCALEGPL: type=t_C26_RANGE_SCALEGPL, init-value=CONST_t_C26_RANGE_SCALEGPL_875:875  # Coefficient 0,875
    SR_C26_SECUR_AUTONOMIE
      data C26_SECUR_AUTONOMIE: type=tBYTE, init-value=CONST_tBYTE_0:0  # Marge de sécurité sur l'autonomie afin d'éviter des pannes sèches. (Res: litre) .AUTONCONSO.PAR.18(1)
    SR_C26_SECUR_AUTONOMIE_GPL
      data C26_SECUR_AUTONOMIE_GPL: type=tBYTE, init-value=CONST_tBYTE_0:0  # Marge de sécurité sur l'autonomie afin d'éviter des pannes sèches. (Res: litre) .AUTONCONSO.PAR.18(1)
    SR_C26_SEUIL_AUTONOMIE
      data C26_SEUIL_AUTONOMIE: type=tBYTE, init-value=CONST_tBYTE_100:100  # Valeur seuil d'autonomie pour choisir la constante de temps de filtrage pour la conso lissée. (Res: Km) .AUTONCONSO.PAR.13(1)
    SR_C26_SEUIL_AUTONOMIE_INVALIDE
      data C26_SEUIL_AUTONOMIE_INVALIDE: type=tBYTE, init-value=CONST_tBYTE_30:30  # Valeur de seuil sous laquelle l'autonomie devient invalide. (Res: Km) .AUTONCONSO.PAR.36(0)
    SR_C26_SEUIL_VITESSE_CONSO_MOY
      data C26_SEUIL_VITESSE_CONSO_MOY: type=tBYTE, init-value=CONST_tBYTE_10:10  # Valeur seuil de vitesse véhicule pour figer le calcul de la conso moy (pour autonomie). (Res:Km/h) .AUTONCONSO.PAR.12(1)
    SR_C26_SEUIL_VIT_FAIBLE_CONSO_LISSEE
      data C26_SEUIL_VIT_FAIBLE_CONSO_LISSEE: type=tBYTE, init-value=CONST_tBYTE_30:30  # Valeur seuil de vitesse faible véhicule pour choisir la constante de temps de filtrage pour la conso lissée. (Res: Km/h) .AUTONCONSO.PAR.11(1)
    SR_C26_SEUIL_VIT_FIGEAGE_CONSO_INST
      data C26_SEUIL_VIT_FIGEAGE_CONSO_INST: type=tBYTE, init-value=CONST_tBYTE_30:30  # Valeur seuil de vitesse véhicule pour figer le calcul de la conso instantanée. (Res: Km/h) .AUTONCONSO.PAR.10(3)
    SR_C26_SEUIL_VIT_TRES_FAIBLE_CONSO_LISSEE
      data C26_SEUIL_VIT_TRES_FAIBLE_CONSO_LISSEE: type=tBYTE, init-value=CONST_tBYTE_10:10  # Valeur seuil de vitesse très faible véhicule pour choisir la constante de temps de filtrage pour la conso lissée. (Res: Km/h) .AUTONCONSO.PAR.04(1)
    SR_C26_VAL_MAX_CONSO_MOYENNE_HY
      data C26_VAL_MAX_CONSO_MOYENNE_HY: type=tWORD, init-value=CONST_tWORD_250:250  # Valeur maximale de l'historique des consommations en HY .AUTONCONSO.PAR.35(0)
    SR_C_CONSO_AUTONOMIE_MAX
      data C_CONSO_AUTONOMIE_MAX: type=tWORD, init-value=CONST_tWORD_1280:1280  # Valeur maximale pour l'autonomie .AUTONCONSO.PAR.26(1)
    SR_C_CONSO_BORNE_AUTONOMIE_1
      data C_CONSO_BORNE_AUTONOMIE_1: type=tWORD, init-value=CONST_tWORD_200:200  # Donnée entrant dans le calcul de l'hystérésis d'affichage qui évite les bagotements intempestifs. Borne inférieure de l'autonomie calculée corrigée. (Res: 10 Kms) .AUTONCONSO.PAR.21(0)
    SR_C_CONSO_BORNE_AUTONOMIE_2
      data C_CONSO_BORNE_AUTONOMIE_2: type=tWORD, init-value=CONST_tWORD_500:500  # Donnée entrant dans le calcul de l'hystérésis d'affichage qui évite les bagotements intempestifs. Borne supérieure de l'autonomie calculée corrigée. (Res: 10 Kms) .AUTONCONSO.PAR.22(0)
    SR_C_CONSO_COEF_HYST_MOINS
      data C_CONSO_COEF_HYST_MOINS: type=tBYTE, init-value=CONST_tBYTE_10:10  # Donnée entrant dans le calcul de Autonomie_Hyst. Coefficient qui définit un seuil bas de l'hystérésis pour une évolution dynamique de ce seuil. (Res: 0,1) .AUTONCONSO.PAR.20(0)
    SR_C_CONSO_COEF_HYST_PLUS
      data C_CONSO_COEF_HYST_PLUS: type=tBYTE, init-value=CONST_tBYTE_15:15  # Donnée entrant dans le calcul de Autonomie_Hyst. Coefficient qui définit un seuil haut de l'hystérésis pour une évolution dynamique de ce seuil. (Res: 0.1) .AUTONCONSO.PAR.19(0)
    SR_C_CONSO_DISTANCE_MAX
      data C_CONSO_DISTANCE_MAX: type=tWORD, init-value=CONST_tWORD_9999:9999  # Distance maximale depuis dernière RAZ. (Res: Km) .AUTONCONSO.PAR.30(0)
    SR_C_CONSO_DISTANCE_MINI
      data C_CONSO_DISTANCE_MINI: type=tWORD, init-value=CONST_tWORD_400:400  # Distance minimum pour qu'un trajet soit VALIDE. (Res: 10cm (0.1m)) .AUTONCONSO.PAR.01(2)
    SR_C_CONSO_HYST_AUTONOMIE_MAX
      data C_CONSO_HYST_AUTONOMIE_MAX: type=tBYTE, init-value=CONST_tBYTE_100:100  # Seuil pour sortie de l'état invalide de l'autonomie .AUTONCONSO.PAR.37(0)
    SR_C_CONSO_LIMITE_DETECTION_PIED_LEVE
      data C_CONSO_LIMITE_DETECTION_PIED_LEVE: type=tBYTE, init-value=CONST_tBYTE_5:5  # Seuil de quantité de carburant consommé pendant T24_DELTA_MES_CONSO_CARB permettant de détecter un pied levé. (Res : 80 mm3) .AUTONCONSO.PAR.09(1)
    SR_C_CONSO_MOTEUR_MIN
      data C_CONSO_MOTEUR_MIN: type=tWORD, init-value=CONST_tWORD_100:100  # Regime moteur au dessus duquel le diagnostique des informations \Pseudo consommation carburant\ et \Consommation carburant reelle\ est effectué. (Res:tr/min) .AUTONCONSO.PAR.02(1)
    SR_C_CONSO_PAS_AUTONOMIE_1
      data C_CONSO_PAS_AUTONOMIE_1: type=tBYTE, init-value=CONST_tBYTE_5:5  # Donnée entrant dans le calcul de l'hystérésis d'affichage qui évite les bagotements intempestifs. Pas d'affichage si l'autonomie calculée corrigée est inférieur ou égale à C26_BORNE_AUTONOMIE_1. (Res : 1 Km) .AUTONCONSO.PAR.23(0)
    SR_C_CONSO_PAS_AUTONOMIE_2
      data C_CONSO_PAS_AUTONOMIE_2: type=tBYTE, init-value=CONST_tBYTE_10:10  # Donnée entrant dans le calcul de l'hystérésis d'affichage qui évite les bagotements intempestifs. Pas d'affichage si l'autonomie calculée corrigée est strictement supérieure à C26_BORNE_AUTONOMIE_1 et inférieure ou égale à C26_BORNE_AUTONOMIE_2. (Res: 1 Km) .AUTONCONSO.PAR.24(0)
    SR_C_CONSO_PAS_AUTONOMIE_3
      data C_CONSO_PAS_AUTONOMIE_3: type=tBYTE, init-value=CONST_tBYTE_20:20  # Donnée entrant dans le calcul de l'hystérésis d'affichage qui évite les bagotements intempestifs. Pas d'affichage si l'autonomie calculée corrigée est strictement supérieure à C26_BORNE_AUTONOMIE_2. (Res: 1 Km) .AUTONCONSO.PAR.25(0)
    SR_C_CONSO_SECUR_AUTONOMIE
      data C_CONSO_SECUR_AUTONOMIE: type=tBYTE, init-value=CONST_tBYTE_0:0  # Marge de sécurité sur l'autonomie afin d'éviter des pannes sèches. (Res: litre) .AUTONCONSO.PAR.18(1)
    SR_C_CONSO_SEUIL_AUTONOMIE
      data C_CONSO_SEUIL_AUTONOMIE: type=tBYTE, init-value=CONST_tBYTE_100:100  # Valeur seuil d'autonomie pour choisir la constante de temps de filtrage pour la conso lissée. (Res: Km) .AUTONCONSO.PAR.13(1)
    SR_C_CONSO_SEUIL_AUTONOMIE_INVALIDE
      data C_CONSO_SEUIL_AUTONOMIE_INVALIDE: type=tBYTE, init-value=CONST_tBYTE_30:30  # Valeur de seuil sous laquelle l'autonomie devient invalide. (Res: Km) .AUTONCONSO.PAR.36(0)
    SR_C_CONSO_SEUIL_VITESSE_CONSO_MOY
      data C_CONSO_SEUIL_VITESSE_CONSO_MOY: type=tBYTE, init-value=CONST_tBYTE_10:10  # Valeur seuil de vitesse véhicule pour figer le calcul de la conso moy (pour autonomie). (Res:Km/h) .AUTONCONSO.PAR.12(1)
    SR_C_CONSO_SEUIL_VIT_FAIBLE_CONSO_LISSEE
      data C_CONSO_SEUIL_VIT_FAIBLE_CONSO_LISSEE: type=tBYTE, init-value=CONST_tBYTE_30:30  # Valeur seuil de vitesse faible véhicule pour choisir la constante de temps de filtrage pour la conso lissée. (Res: Km/h) .AUTONCONSO.PAR.11(1)
    SR_C_CONSO_SEUIL_VIT_FIGEAGE_CONSO_INST
      data C_CONSO_SEUIL_VIT_FIGEAGE_CONSO_INST: type=tBYTE, init-value=CONST_tBYTE_30:30  # Valeur seuil de vitesse véhicule pour figer le calcul de la conso instantanée. (Res: Km/h) .AUTONCONSO.PAR.10(3)
    SR_C_CONSO_SEUIL_VIT_TRES_FAIBLE_CONSO_LISSEE
      data C_CONSO_SEUIL_VIT_TRES_FAIBLE_CONSO_LISSEE: type=tBYTE, init-value=CONST_tBYTE_10:10  # Valeur seuil de vitesse très faible véhicule pour choisir la constante de temps de filtrage pour la conso lissée. (Res: Km/h) .AUTONCONSO.PAR.04(1)
    SR_CFG_CAPACITE_RESERVOIR
      data CFG_CAPACITE_RESERVOIR: type=tBYTE, init-value=CONST_tBYTE_50:50  # Donne la capacité maximum du réservoir
    SR_CFG_DISPO_PSEUDO_CONSO_CARB
      data CFG_DISPO_PSEUDO_CONSO_CARB: type=tLOG, init-value=CONST_tLOG_0:0  # Présence de la gestion de la pseudo-consommation de carburant ENUM 0 "Pas de gestion de la pseudo-consommation" ENUM 1 "Gestion de la pseudo-consommation présente"
    SR_CFG_PRESENCE_GAZ
      data CFG_PRESENCE_GAZ: type=tLOG, init-value=CONST_tLOG_0:0  # Indique la présence d'un équipement GAZ ENUM 0 "équipement GAZ absent" ENUM 1 "équipement GAZ présent"
    SR_CFG_PRESENCE_ODB
      data CFG_PRESENCE_ODB: type=tLOG, init-value=CONST_tLOG_0:0  # Présence d'un Ordinateur De Bord (ODB) ENUM 0 "ODB absent" ENUM 1 "ODB présent"
    SR_CFG_TYPE_CHAINE_TRACTION
      data CFG_TYPE_CHAINE_TRACTION: type=t_cTCT, init-value=CONST_t_cTCT_0:0  # Type de la chaine de traction ENUM 0 "Chaine de traction classique moteur thermique cTCT_MTH" ENUM 1 "Chaine de traction hybride HY cTCT_HY" ENUM 2 "Chaine de traction électrique cTCT_ELEC"
    SR_CFG_TYPE_GPL_IHM
      data CFG_TYPE_GPL_IHM: type=t_cIHM, init-value=CONST_t_cIHM_0:0  # Indiquer le type d'IHM pour GPL ENUM 0 "without" cIHM_without ENUM 1 "current" cIHM_currentAutonomy ENUM 2 "TOTAL" cIHM_totalAutonomy
    SR_CFG_TYPE_HY
      data CFG_TYPE_HY: type=t_H, init-value=CONST_t_H_0:0  # Indique le type d'hybride équipant le véhicule ENUM 0 "HY PHASE 1" ENUM 1 "HY PHASE 2" ENUM 2 "HY E35" ENUM 3 "HY4PREMIUM" ENUM 4 "PHEV"
    SR_CONSO_DELTA_MES_CONSO_CARB
      data CONSO_DELTA_MES_CONSO_CARB: type=tBYTE, init-value=CONST_tBYTE_10:10  # Intervalle de temps permettant de définir la variation de la quantité de carburant consommé pour le choix de T26_FILTR_CONSO_INST_1 ou T26_FILTR_CONSO_INST_2. (Res: 0.1s) .AUTONCONSO.PAR.08(1)
    SR_T26_DELTA_MES_CONSO_CARB
      data T26_DELTA_MES_CONSO_CARB: type=tBYTE, init-value=CONST_tBYTE_10:10  # Intervalle de temps permettant de définir la variation de la quantité de carburant consommé pour le choix de T26_FILTR_CONSO_INST_1 ou T26_FILTR_CONSO_INST_2. (Res: 0.1s) .AUTONCONSO.PAR.08(1)
    SR_T26_FILTR_CONSO_INST_1
      data T26_FILTR_CONSO_INST_1: type=tBYTE, init-value=CONST_tBYTE_5:5  # Constante de temps 1 de filtrage pour la conso instantannée (pied non levé). (Res: s) .AUTONCONSO.PAR.06(1)
    SR_T26_FILTR_CONSO_INST_2
      data T26_FILTR_CONSO_INST_2: type=tBYTE, init-value=CONST_tBYTE_1:1  # Constante de temps 2 de filtrage pour la conso instantannée (pied levé). (Res: s) .AUTONCONSO.PAR.05(1)
    SR_T26_FILTR_CONSO_INST_GPL_1
      data T26_FILTR_CONSO_INST_GPL_1: type=tBYTE, init-value=CONST_tBYTE_5:5  # Constante de temps 1 de filtrage pour la conso instantannée (pied non levé). (Res: s)
    SR_T26_FILTR_CONSO_INST_GPL_2
      data T26_FILTR_CONSO_INST_GPL_2: type=tBYTE, init-value=CONST_tBYTE_1:1  # Constante de temps utilisée en nominal pour le calcul de la conso instantanée de GPL unité: s
    SR_T26_FILTR_CONSO_LISSEE_1
      data T26_FILTR_CONSO_LISSEE_1: type=tWORD, init-value=CONST_tWORD_900:900  # Constante de temps de filtrage pour la conso lissée dans le cas : Autonomie > C26_SEUIL_AUTONOMIE et VitesseVehicule > C26_SEUIL_VIT_FAIBLE_CONSO_LISSEE. (Res: s) .AUTONCONSO.PAR.15(1)
    SR_T26_FILTR_CONSO_LISSEE_1_GPL
      data T26_FILTR_CONSO_LISSEE_1_GPL: type=tWORD, init-value=CONST_tWORD_900:900  # Constante de temps de filtrage pour la conso lissée dans le cas : Autonomie > C26_SEUIL_AUTONOMIE et VitesseVehicule > C26_SEUIL_VIT_FAIBLE_CONSO_LISSEE. (Res: s)
    SR_T26_FILTR_CONSO_LISSEE_2
      data T26_FILTR_CONSO_LISSEE_2: type=tWORD, init-value=CONST_tWORD_200:200  # Constante de temps de filtrage pour la conso lissée dans le cas : Autonomie > C26_SEUIL_AUTONOMIE et VitesseVehicule > C26_SEUIL_VIT_FAIBLE_CONSO_LISSEE. (Res: s) .AUTONCONSO.PAR.14(1)
    SR_T26_FILTR_CONSO_LISSEE_2_GPL
      data T26_FILTR_CONSO_LISSEE_2_GPL: type=tWORD, init-value=CONST_tWORD_200:200  # Constante de temps de filtrage pour la conso lissée dans le cas : Autonomie > C26_SEUIL_AUTONOMIE et VitesseVehicule > C26_SEUIL_VIT_FAIBLE_CONSO_LISSEE. (Res: s)
    SR_T26_FILTR_CONSO_LISSEE_3
      data T26_FILTR_CONSO_LISSEE_3: type=tWORD, init-value=CONST_tWORD_2000:2000  # Constante de temps de filtrage pour la conso lissée dans le cas : VitesseVehicule > C26_SEUIL_VIT_FAIBLE_CONSO_LISSEE. (Res : s) .AUTONCONSO.PAR.16(1)
    SR_T26_FILTR_CONSO_LISSEE_3_GPL
      data T26_FILTR_CONSO_LISSEE_3_GPL: type=tWORD, init-value=CONST_tWORD_2000:2000  # Constante de temps de filtrage pour la conso lissée dans le cas : VitesseVehicule > C26_SEUIL_VIT_FAIBLE_CONSO_LISSEE. (Res : s)
    SR_T26_FILTR_CONSO_MOY
      data T26_FILTR_CONSO_MOY: type=tWORD, init-value=CONST_tWORD_2700:2700  # Constante de temps de filtrage pour la conso moy dans le cas : VitesseVehicule > C26_SEUIL_VITESSE_CONSO_MOY. (Res: s) .AUTONCONSO.PAR.17(1)
    SR_T26_FILTR_CONSO_MOY_GPL
      data T26_FILTR_CONSO_MOY_GPL: type=tWORD, init-value=CONST_tWORD_2700:2700  # Constante de temps de filtrage pour la conso moy dans le cas : VitesseVehicule > C26_SEUIL_VITESSE_CONSO_MOY. (Res: s)
    SR_T26_TEMPO_CONFIRMATION_DEFAUT
      data T26_TEMPO_CONFIRMATION_DEFAUT: type=tBYTE, init-value=CONST_tBYTE_10:10  # Tempo à partir de laquelle on a confirmation du defaut jauge carbu et donc passage en autonomie INVALIDE. (Res: sec) .AUTONCONSO.PAR.07(1)
    SR_T26_TEMPO_CONSO_INVALIDE
      data T26_TEMPO_CONSO_INVALIDE: type=tWORD, init-value=CONST_tWORD_600:600  # Tempo entrant dans le test de la validite des consommations de carburant. (Res: 1 s) .AUTONCONSO.PAR.03(2)
    SR_T26_TEMPO_HISTO_HY
      data T26_TEMPO_HISTO_HY: type=t_T26_TEMPO_HISTO_HY, init-value=CONST_t_T26_TEMPO_HISTO_HY_300:300  # Durée de chaque barre de l'histogramme .AUTONCONSO.PAR.34(0)
    SR_T26_TEMPO_HISTO_ZOOM1
      data T26_TEMPO_HISTO_ZOOM1: type=t_T26_TEMPO_HISTO_ZOOM1, init-value=CONST_t_T26_TEMPO_HISTO_ZOOM1_5:5  # Durée de chaque barre de l'histogramme
    SR_T26_TEMPO_HISTO_ZOOM2
      data T26_TEMPO_HISTO_ZOOM2: type=t_T26_TEMPO_HISTO_ZOOM2, init-value=CONST_t_T26_TEMPO_HISTO_ZOOM2_10:10  # Durée de chaque barre de l'histogramme
    SR_T26_TEMPO_HISTO_ZOOM3
      data T26_TEMPO_HISTO_ZOOM3: type=t_T26_TEMPO_HISTO_ZOOM3, init-value=CONST_t_T26_TEMPO_HISTO_ZOOM3_30:30  # Durée de chaque barre de l'histogramme
    SR_T26_TEMPO_HISTO_ZOOM4
      data T26_TEMPO_HISTO_ZOOM4: type=t_T26_TEMPO_HISTO_ZOOM4, init-value=CONST_t_T26_TEMPO_HISTO_ZOOM4_60:60  # Durée de chaque barre de l'histogramme
    SR_T_CONSO_FILTR_CONSO_INST_1
      data T_CONSO_FILTR_CONSO_INST_1: type=tBYTE, init-value=CONST_tBYTE_5:5  # Constante de temps 1 de filtrage pour la conso instantannée (pied non levé). (Res: s) .AUTONCONSO.PAR.06(1)
    SR_T_CONSO_FILTR_CONSO_INST_2
      data T_CONSO_FILTR_CONSO_INST_2: type=tBYTE, init-value=CONST_tBYTE_1:1  # Constante de temps 2 de filtrage pour la conso instantannée (pied levé). (Res: s) .AUTONCONSO.PAR.05(1)
    SR_T_CONSO_FILTR_CONSO_LISSEE_1
      data T_CONSO_FILTR_CONSO_LISSEE_1: type=tWORD, init-value=CONST_tWORD_900:900  # Constante de temps de filtrage pour la conso lissée dans le cas : Autonomie > C26_SEUIL_AUTONOMIE et VitesseVehicule > C26_SEUIL_VIT_FAIBLE_CONSO_LISSEE. (Res: s) .AUTONCONSO.PAR.15(1)
    SR_T_CONSO_FILTR_CONSO_LISSEE_2
      data T_CONSO_FILTR_CONSO_LISSEE_2: type=tWORD, init-value=CONST_tWORD_200:200  # Constante de temps de filtrage pour la conso lissée dans le cas : Autonomie > C26_SEUIL_AUTONOMIE et VitesseVehicule > C26_SEUIL_VIT_FAIBLE_CONSO_LISSEE. (Res: s) .AUTONCONSO.PAR.14(1)
    SR_T_CONSO_FILTR_CONSO_LISSEE_3
      data T_CONSO_FILTR_CONSO_LISSEE_3: type=tWORD, init-value=CONST_tWORD_2000:2000  # Constante de temps de filtrage pour la conso lissée dans le cas : VitesseVehicule > C26_SEUIL_VIT_FAIBLE_CONSO_LISSEE. (Res : s) .AUTONCONSO.PAR.16(1)
    SR_T_CONSO_FILTR_CONSO_MOY
      data T_CONSO_FILTR_CONSO_MOY: type=tWORD, init-value=CONST_tWORD_2700:2700  # Constante de temps de filtrage pour la conso moy dans le cas : VitesseVehicule > C26_SEUIL_VITESSE_CONSO_MOY. (Res: s) .AUTONCONSO.PAR.17(1)
    SR_T_CONSO_TEMPO_CONFIRMATION_DEFAUT
      data T_CONSO_TEMPO_CONFIRMATION_DEFAUT: type=tBYTE, init-value=CONST_tBYTE_10:10  # Tempo à partir de laquelle on a confirmation du defaut jauge carbu et donc passage en autonomie INVALIDE. (Res: sec) .AUTONCONSO.PAR.07(1)
    SR_T_CONSO_TEMPO_CONSO_INVALIDE
      data T_CONSO_TEMPO_CONSO_INVALIDE: type=tWORD, init-value=CONST_tWORD_600:600  # Tempo entrant dans le test de la validite des consommations de carburant. (Res: 1 s) .AUTONCONSO.PAR.03(2)
    SR_VAL_MEDAILLE
      data VAL_MEDAILLE: type=t_VAL_MEDAILLE, init-value=CONST_t_VAL_MEDAILLE_30:30  # Valeur en Wh d'une demi-médaille présentée sur l'historique de conso
    SR_C27_ECART_MAJ_HORLOGE
      data C27_ECART_MAJ_HORLOGE: type=t_C27_ECART_MAJ_HORLOGE, init-value=CONST_t_C27_ECART_MAJ_HORLOGE_60:60  # Ecart pour la prise en compte de la demande de mise à jour de l'horloge 1 LSB = 1 mn .GCTEMP.PAR.06(0)
    SR_C27_ECART_VALIDITE_REVEIL_PRECOND_THERM
      data C27_ECART_VALIDITE_REVEIL_PRECOND_THERM: type=tBYTE, init-value=CONST_tBYTE_60:60  # Ecart pour valider le passage de l'état de réveil programmé de programmé à demandé. 1 LSB = 1 mn .GCTEMP.PAR.04(0)
    SR_T27_DUREE_DDE_ANNUL_REVEIL_CPTVHL
      data T27_DUREE_DDE_ANNUL_REVEIL_CPTVHL: type=tBYTE, init-value=CONST_tBYTE_20:20  # Durée pour le maintien de la demande d'annulation des réveils programmés. 1 LSB = 100ms .GCTEMP.PAR.01(1)
    SR_T27_DUREE_DDE_ANNUL_REVEIL_HORLOGE
      data T27_DUREE_DDE_ANNUL_REVEIL_HORLOGE: type=tBYTE, init-value=CONST_tBYTE_20:20  # Durée pour le maintien de la demande d'annulation des réveils programmés. 1 LSB = 100ms .GCTEMP.PAR.05(0)
    SR_TA27_FILTRAGE_REVEIL_BSI
      data TA27_FILTRAGE_REVEIL_BSI: type=tBYTE, init-value=CONST_tBYTE_2:2  # Filtrage temporel après un réveil BSI pour commencer à prendre en compte la position du shunt pour produire le compteur de RAZ. 1 LSB = 100 ms .GCTEMP.PAR.08(0)
    SR_C28_VAL_CONS_VIT_LVV_MIN
      data C28_VAL_CONS_VIT_LVV_MIN: type=t_C28_VAL_CONS_VIT_LVV_MIN, init-value=CONST_t_C28_VAL_CONS_VIT_LVV_MIN_30:30  # Valeur de la vitesse minimale que le client peut donner à ses vitesses préprogrammées LVV
    SR_C28_VAL_CONS_VIT_LVV_MIN_MILES
      data C28_VAL_CONS_VIT_LVV_MIN_MILES: type=t_C28_VAL_CONS_VIT_LVV_MIN_MILES, init-value=CONST_t_C28_VAL_CONS_VIT_LVV_MIN_MILES_50:50  # Valeur de la vitesse minimale que le client peut donner à ses vitesses préprogrammées LVV
    SR_C28_VAL_CONS_VIT_RVV_MIN
      data C28_VAL_CONS_VIT_RVV_MIN: type=t_C28_VAL_CONS_VIT_RVV_MIN, init-value=CONST_t_C28_VAL_CONS_VIT_RVV_MIN_40:40  # Valeur de la vitesse minimale que le client peut donner à ses vitesses préprogrammées RVV
    SR_C28_VAL_CONS_VIT_RVV_MIN_MILES
      data C28_VAL_CONS_VIT_RVV_MIN_MILES: type=t_C28_VAL_CONS_VIT_RVV_MIN_MILES, init-value=CONST_t_C28_VAL_CONS_VIT_RVV_MIN_MILES_50:50  # Valeur de la vitesse minimale que le client peut donner à ses vitesses préprogrammées RVV
    SR_CFG_INIT_AAS
      data CFG_INIT_AAS: type=tLOG, init-value=CONST_tLOG_1:1  # Valeur d'init de l'AAS ENUM 0 "Désactiver" ENUM 1 "Activer"
    SR_CFG_INIT_ACCUEIL_COND
      data CFG_INIT_ACCUEIL_COND: type=tLOG, init-value=CONST_tLOG_1:1  # Valeur d'init de l'accueil conducteur ENUM 0 "Désactiver" ENUM 1 "Activer"
    SR_CFG_INIT_BAAACTIVATION
      data CFG_INIT_BAAACTIVATION: type=tLOG, init-value=CONST_tLOG_1:1  # Valeur du paramétrage en sortie d'usine menu BAA ENUM 0 "Fonction inactive" ENUM 1 "Fonction active"
    SR_CFG_INIT_BAAAUTOLOCKING
      data CFG_INIT_BAAAUTOLOCKING: type=tLOG, init-value=CONST_tLOG_1:1  # Valeur du paramétrage en sortie d'usine menu BAA Autolocking ENUM 0 "Fonction inactive" ENUM 1 "Fonction active"
    SR_CFG_INIT_BUTEE_1
      data CFG_INIT_BUTEE_1: type=tLOG, init-value=CONST_tLOG_1:1  # Valeur d'init de la butee XVV 1 ENUM 0 "Désactiver" ENUM 1 "Activer"
    SR_CFG_INIT_BUTEE_2
      data CFG_INIT_BUTEE_2: type=tLOG, init-value=CONST_tLOG_1:1  # Valeur d'init de la butee XVV 2 ENUM 0 "Désactiver" ENUM 1 "Activer"
    SR_CFG_INIT_BUTEE_3
      data CFG_INIT_BUTEE_3: type=tLOG, init-value=CONST_tLOG_1:1  # Valeur d'init de la butee XVV 3 ENUM 0 "Désactiver" ENUM 1 "Activer"
    SR_CFG_INIT_BUTEE_4
      data CFG_INIT_BUTEE_4: type=tLOG, init-value=CONST_tLOG_1:1  # Valeur d'init de la butee XVV 4 ENUM 0 "Désactiver" ENUM 1 "Activer"
    SR_CFG_INIT_BUTEE_5
      data CFG_INIT_BUTEE_5: type=tLOG, init-value=CONST_tLOG_1:1  # Valeur d'init de la butee XVV 5 ENUM 0 "Désactiver" ENUM 1 "Activer"
    SR_CFG_INIT_BUTEE_GENERALE
      data CFG_INIT_BUTEE_GENERALE: type=tLOG, init-value=CONST_tLOG_0:0  # Valeur d'init de la butee generale XVV ENUM 0 "Désactiver" ENUM 1 "Activer"
    SR_CFG_INIT_CALAND
      data CFG_INIT_CALAND: type=tLOG, init-value=CONST_tLOG_1:1  # Valeur du paramétrage en sortie d'usine ENUM 0 "Fonction inactive" ENUM 1 "Fonction active"
    SR_CFG_INIT_CLIM_PRECOND_ASAP
      data CFG_INIT_CLIM_PRECOND_ASAP: type=tLOG, init-value=CONST_tLOG_0:0  # Valeur d'Init de la fonction CLIM ENUM 0 "Fonction inactive" ENUM 1 "Fonction active"
    SR_CFG_INIT_CLIM_PRECOND_DI_1
      data CFG_INIT_CLIM_PRECOND_DI_1: type=tLOG, init-value=CONST_tLOG_0:0  # Configuration en sortie d'usine du paramètre \CLIM_PRECOND_DI_1 au menu perso
    SR_CFG_INIT_CLIM_PRECOND_DI_2
      data CFG_INIT_CLIM_PRECOND_DI_2: type=tLOG, init-value=CONST_tLOG_0:0  # Configuration en sortie d'usine du paramètre \CLIM_PRECOND_DI_2 au menu perso
    SR_CFG_INIT_CLIM_PRECOND_DI_3
      data CFG_INIT_CLIM_PRECOND_DI_3: type=tLOG, init-value=CONST_tLOG_0:0  # Configuration en sortie d'usine du paramètre \CLIM_PRECOND_DI_3 au menu perso
    SR_CFG_INIT_CLIM_PRECOND_DI_4
      data CFG_INIT_CLIM_PRECOND_DI_4: type=tLOG, init-value=CONST_tLOG_0:0  # Configuration en sortie d'usine du paramètre \CLIM_PRECOND_DI_4 au menu perso
    SR_CFG_INIT_CLIM_PRECOND_H_1
      data CFG_INIT_CLIM_PRECOND_H_1: type=tWORD, init-value=CONST_tWORD_0:0  # Configuration en sortie d'usine du paramètre \CLIM_PRECOND_H_1 au menu perso
    SR_CFG_INIT_CLIM_PRECOND_H_2
      data CFG_INIT_CLIM_PRECOND_H_2: type=tWORD, init-value=CONST_tWORD_0:0  # Configuration en sortie d'usine du paramètre \CLIM_PRECOND_H_2 au menu perso
    SR_CFG_INIT_CLIM_PRECOND_H_3
      data CFG_INIT_CLIM_PRECOND_H_3: type=tWORD, init-value=CONST_tWORD_0:0  # Configuration en sortie d'usine du paramètre \CLIM_PRECOND_H_3 au menu perso
    SR_CFG_INIT_CLIM_PRECOND_H_4
      data CFG_INIT_CLIM_PRECOND_H_4: type=tWORD, init-value=CONST_tWORD_0:0  # Configuration en sortie d'usine du paramètre \CLIM_PRECOND_H_4 au menu perso
    SR_CFG_INIT_CLIM_PRECOND_JE_1
      data CFG_INIT_CLIM_PRECOND_JE_1: type=tLOG, init-value=CONST_tLOG_0:0  # Configuration en sortie d'usine du paramètre \CLIM_PRECOND_JE_1 au menu perso
    SR_CFG_INIT_CLIM_PRECOND_JE_2
      data CFG_INIT_CLIM_PRECOND_JE_2: type=tLOG, init-value=CONST_tLOG_0:0  # Configuration en sortie d'usine du paramètre \CLIM_PRECOND_JE_2 au menu perso
    SR_CFG_INIT_CLIM_PRECOND_JE_3
      data CFG_INIT_CLIM_PRECOND_JE_3: type=tLOG, init-value=CONST_tLOG_0:0  # Configuration en sortie d'usine du paramètre \CLIM_PRECOND_JE_3 au menu perso
    SR_CFG_INIT_CLIM_PRECOND_JE_4
      data CFG_INIT_CLIM_PRECOND_JE_4: type=tLOG, init-value=CONST_tLOG_0:0  # Configuration en sortie d'usine du paramètre \CLIM_PRECOND_JE_4 au menu perso
    SR_CFG_INIT_CLIM_PRECOND_LU_1
      data CFG_INIT_CLIM_PRECOND_LU_1: type=tLOG, init-value=CONST_tLOG_0:0  # Configuration en sortie d'usine du paramètre \CLIM_PRECOND_LU_1 au menu perso
    SR_CFG_INIT_CLIM_PRECOND_LU_2
      data CFG_INIT_CLIM_PRECOND_LU_2: type=tLOG, init-value=CONST_tLOG_0:0  # Configuration en sortie d'usine du paramètre \CLIM_PRECOND_LU_2 au menu perso
    SR_CFG_INIT_CLIM_PRECOND_LU_3
      data CFG_INIT_CLIM_PRECOND_LU_3: type=tLOG, init-value=CONST_tLOG_0:0  # Configuration en sortie d'usine du paramètre \CLIM_PRECOND_LU_3 au menu perso
    SR_CFG_INIT_CLIM_PRECOND_LU_4
      data CFG_INIT_CLIM_PRECOND_LU_4: type=tLOG, init-value=CONST_tLOG_0:0  # Configuration en sortie d'usine du paramètre \CLIM_PRECOND_LU_4 au menu perso
    SR_CFG_INIT_CLIM_PRECOND_MA_1
      data CFG_INIT_CLIM_PRECOND_MA_1: type=tLOG, init-value=CONST_tLOG_0:0  # Configuration en sortie d'usine du paramètre \CLIM_PRECOND_MA_1 au menu perso
    SR_CFG_INIT_CLIM_PRECOND_MA_2
      data CFG_INIT_CLIM_PRECOND_MA_2: type=tLOG, init-value=CONST_tLOG_0:0  # Configuration en sortie d'usine du paramètre \CLIM_PRECOND_MA_2 au menu perso
    SR_CFG_INIT_CLIM_PRECOND_MA_3
      data CFG_INIT_CLIM_PRECOND_MA_3: type=tLOG, init-value=CONST_tLOG_0:0  # Configuration en sortie d'usine du paramètre \CLIM_PRECOND_MA_3 au menu perso
    SR_CFG_INIT_CLIM_PRECOND_MA_4
      data CFG_INIT_CLIM_PRECOND_MA_4: type=tLOG, init-value=CONST_tLOG_0:0  # Configuration en sortie d'usine du paramètre \CLIM_PRECOND_MA_4 au menu perso
    SR_CFG_INIT_CLIM_PRECOND_ME_1
      data CFG_INIT_CLIM_PRECOND_ME_1: type=tLOG, init-value=CONST_tLOG_0:0  # Configuration en sortie d'usine du paramètre \CLIM_PRECOND_ME_1 au menu perso
    SR_CFG_INIT_CLIM_PRECOND_ME_2
      data CFG_INIT_CLIM_PRECOND_ME_2: type=tLOG, init-value=CONST_tLOG_0:0  # Configuration en sortie d'usine du paramètre \CLIM_PRECOND_ME_2 au menu perso
    SR_CFG_INIT_CLIM_PRECOND_ME_3
      data CFG_INIT_CLIM_PRECOND_ME_3: type=tLOG, init-value=CONST_tLOG_0:0  # Configuration en sortie d'usine du paramètre \CLIM_PRECOND_ME_3 au menu perso
    SR_CFG_INIT_CLIM_PRECOND_ME_4
      data CFG_INIT_CLIM_PRECOND_ME_4: type=tLOG, init-value=CONST_tLOG_0:0  # Configuration en sortie d'usine du paramètre \CLIM_PRECOND_ME_4 au menu perso
    SR_CFG_INIT_CLIM_PRECOND_ON_1
      data CFG_INIT_CLIM_PRECOND_ON_1: type=tLOG, init-value=CONST_tLOG_0:0  # Configuration en sortie d'usine du paramètre \CLIM_PRECOND_ON_1 au menu perso
    SR_CFG_INIT_CLIM_PRECOND_ON_2
      data CFG_INIT_CLIM_PRECOND_ON_2: type=tLOG, init-value=CONST_tLOG_0:0  # Configuration en sortie d'usine du paramètre \CLIM_PRECOND_ON_2 au menu perso
    SR_CFG_INIT_CLIM_PRECOND_ON_3
      data CFG_INIT_CLIM_PRECOND_ON_3: type=tLOG, init-value=CONST_tLOG_0:0  # Configuration en sortie d'usine du paramètre \CLIM_PRECOND_ON_3 au menu perso
    SR_CFG_INIT_CLIM_PRECOND_ON_4
      data CFG_INIT_CLIM_PRECOND_ON_4: type=tLOG, init-value=CONST_tLOG_0:0  # Configuration en sortie d'usine du paramètre \CLIM_PRECOND_ON_4 au menu perso
    SR_CFG_INIT_CLIM_PRECOND_SA_1
      data CFG_INIT_CLIM_PRECOND_SA_1: type=tLOG, init-value=CONST_tLOG_0:0  # Configuration en sortie d'usine du paramètre \CLIM_PRECOND_SA_1 au menu perso
    SR_CFG_INIT_CLIM_PRECOND_SA_2
      data CFG_INIT_CLIM_PRECOND_SA_2: type=tLOG, init-value=CONST_tLOG_0:0  # Configuration en sortie d'usine du paramètre \CLIM_PRECOND_SA_2 au menu perso
    SR_CFG_INIT_CLIM_PRECOND_SA_3
      data CFG_INIT_CLIM_PRECOND_SA_3: type=tLOG, init-value=CONST_tLOG_0:0  # Configuration en sortie d'usine du paramètre \CLIM_PRECOND_SA_3 au menu perso
    SR_CFG_INIT_CLIM_PRECOND_SA_4
      data CFG_INIT_CLIM_PRECOND_SA_4: type=tLOG, init-value=CONST_tLOG_0:0  # Configuration en sortie d'usine du paramètre \CLIM_PRECOND_SA_4 au menu perso
    SR_CFG_INIT_CLIM_PRECOND_VE_1
      data CFG_INIT_CLIM_PRECOND_VE_1: type=tLOG, init-value=CONST_tLOG_0:0  # Configuration en sortie d'usine du paramètre \CLIM_PRECOND_VE_1 au menu perso
    SR_CFG_INIT_CLIM_PRECOND_VE_2
      data CFG_INIT_CLIM_PRECOND_VE_2: type=tLOG, init-value=CONST_tLOG_0:0  # Configuration en sortie d'usine du paramètre \CLIM_PRECOND_VE_2 au menu perso
    SR_CFG_INIT_CLIM_PRECOND_VE_3
      data CFG_INIT_CLIM_PRECOND_VE_3: type=tLOG, init-value=CONST_tLOG_0:0  # Configuration en sortie d'usine du paramètre \CLIM_PRECOND_VE_3 au menu perso
    SR_CFG_INIT_CLIM_PRECOND_VE_4
      data CFG_INIT_CLIM_PRECOND_VE_4: type=tLOG, init-value=CONST_tLOG_0:0  # Configuration en sortie d'usine du paramètre \CLIM_PRECOND_VE_4 au menu perso
    SR_CFG_INIT_CMDM_DAE
      data CFG_INIT_CMDM_DAE: type=tLOG, init-value=CONST_tLOG_1:1  # Valeur du paramétrage en sortie d'usine menu CMDM_DAE ENUM 0 "Fonction inactive" ENUM 1 "Fonction active"
    SR_CFG_INIT_CMDM_DAE_4WD
      data CFG_INIT_CMDM_DAE_4WD: type=tLOG, init-value=CONST_tLOG_1:1  # Valeur du paramétrage en sortie d'usine menu CMDM_DAE_4WD ENUM 0 "Fonction inactive" ENUM 1 "Fonction active"
    SR_CFG_INIT_DAAACTIVATION
      data CFG_INIT_DAAACTIVATION: type=tLOG, init-value=CONST_tLOG_1:1  # Valeur du paramétrage en sortie d'usine menu DAA ENUM 0 "Fonction inactive" ENUM 1 "Fonction active"
    SR_CFG_INIT_DSG
      data CFG_INIT_DSG: type=tLOG, init-value=CONST_tLOG_0:0  # Menu de reinitialisation de la DSG indirecte ENUM 0 "Fonction inactive" ENUM 1 "Fonction active"
    SR_CFG_INIT_ECL_ACCOMP
      data CFG_INIT_ECL_ACCOMP: type=tLOG, init-value=CONST_tLOG_0:0  # Valeur d'init de l'ecl accomp ENUM 0 "Désactiver" ENUM 1 "Activer"
    SR_CFG_INIT_ECL_ADAPT
      data CFG_INIT_ECL_ADAPT: type=tLOG, init-value=CONST_tLOG_1:1  # Valeur d'init de l'ecl adaptatif ENUM 0 "Désactiver" ENUM 1 "Activer"
    SR_CFG_INIT_ECL_AMBI
      data CFG_INIT_ECL_AMBI: type=tLOG, init-value=CONST_tLOG_1:1  # Valeur d'init de l'ecl ambiance ENUM 0 "Désactiver" ENUM 1 "Activer"
    SR_CFG_INIT_ECL_AMBI_NIV
      data CFG_INIT_ECL_AMBI_NIV: type=t_CFG_INIT_ECL_AMBI_NIV, init-value=6  # Niveau de l'éclairage d'ambiance en sortie d'usine ENUM 0 "Niveau_0" ENUM 1 "Niveau_1" ENUM 2 "Niveau_2" ENUM 3 "Niveau_3" ENUM 4 "Niveau_4" ENUM 5 "Niveau_5" ENUM 6 "Niveau_6"
    SR_CFG_INIT_ECL_AUTO
      data CFG_INIT_ECL_AUTO: type=tLOG, init-value=CONST_tLOG_0:0  # Valeur d'init de l'ecl auto ENUM 0 "Désactiver" ENUM 1 "Activer"
    SR_CFG_INIT_ECL_AUTOROUTE
      data CFG_INIT_ECL_AUTOROUTE: type=tLOG, init-value=CONST_tLOG_1:1  # Valeur d'init de l'ecl autoroute ENUM 0 "Désactiver" ENUM 1 "Activer"
    SR_CFG_INIT_ECL_DECONDA
      data CFG_INIT_ECL_DECONDA: type=tLOG, init-value=CONST_tLOG_0:0  # Valeur d'init de l'ecl deconda ENUM 0 "Désactiver" ENUM 1 "Activer"
    SR_CFG_INIT_ECL_FEUX_DIURNES
      data CFG_INIT_ECL_FEUX_DIURNES: type=tLOG, init-value=CONST_tLOG_0:0  # Valeur d'init de l'ecl feux diurnes ENUM 0 "Désactiver" ENUM 1 "Activer"
    SR_CFG_INIT_ECLI_PPC_ANIM
      data CFG_INIT_ECLI_PPC_ANIM: type=tBYTE, init-value=CONST_tBYTE_1:1  # Valeur du paramétrage en sortie d'usine menu xxx
    SR_CFG_INIT_ECLI_PPC_BLOC1
      data CFG_INIT_ECLI_PPC_BLOC1: type=tLOG, init-value=CONST_tLOG_1:1  # Valeur du paramétrage en sortie d'usine menu xxx ENUM 0 "Fonction inactive" ENUM 1 "Fonction active"
    SR_CFG_INIT_ECLI_PPC_COL1
      data CFG_INIT_ECLI_PPC_COL1: type=tBYTE, init-value=CONST_tBYTE_1:1  # Valeur du paramétrage en sortie d'usine menu xxx
    SR_CFG_INIT_ECLX_AFS
      data CFG_INIT_ECLX_AFS: type=tLOG, init-value=CONST_tLOG_0:0  # Valeur du paramétrage en sortie d'usine menu AFS ENUM 0 "Fonction inactive" ENUM 1 "Fonction active"
    SR_CFG_INIT_ECLX_ARS
      data CFG_INIT_ECLX_ARS: type=tLOG, init-value=CONST_tLOG_0:0  # Valeur du paramétrage en sortie d'usine menu ARS ENUM 0 "Fonction inactive" ENUM 1 "Fonction active"
    SR_CFG_INIT_ECLX_ECL_CAFR
      data CFG_INIT_ECLX_ECL_CAFR: type=tLOG, init-value=CONST_tLOG_1:1  # Valeur du paramétrage en sortie d'usine menu CAFR ENUM 0 "Fonction inactive" ENUM 1 "Fonction active"
    SR_CFG_INIT_ESSUIE_VIT_MAR
      data CFG_INIT_ESSUIE_VIT_MAR: type=tLOG, init-value=CONST_tLOG_0:0  # Valeur d'init de l'essuie vitre MAR ENUM 0 "Désactiver" ENUM 1 "Activer"
    SR_CFG_INIT_FARC
      data CFG_INIT_FARC: type=tLOG, init-value=CONST_tLOG_0:0  # Valeur usine de l'état du menu FARC ENUM 0 "Fonction inactive" ENUM 1 "Fonction active"
    SR_CFG_INIT_FSE_AUTO
      data CFG_INIT_FSE_AUTO: type=tLOG, init-value=CONST_tLOG_1:1  # Valeur d'init du FSE auto ENUM 0 "Désactiver" ENUM 1 "Activer"
    SR_CFG_INIT_GAV_AMLA
      data CFG_INIT_GAV_AMLA: type=tLOG, init-value=CONST_tLOG_0:0  # Valeur d'Init de la fonction GAV
    SR_CFG_INIT_HARMONIE_SON
      data CFG_INIT_HARMONIE_SON: type=t_CFG_INIT_HARMONIE_SON, init-value=0  # Valeur d'init des sons polyphoniques ENUM 0 "Harmonie 1" ENUM 1 "Harmonie 2" ENUM 2 "Harmonie 3" ENUM 3 "Harmonie 4"
    SR_CFG_INIT_ILV
      data CFG_INIT_ILV: type=tLOG, init-value=CONST_tLOG_1:1  # Valeur du paramétrage en sortie d'usine menu ILV ENUM 0 "Fonction inactive" ENUM 1 "Fonction active"
    SR_CFG_INIT_ILV_ETSR
      data CFG_INIT_ILV_ETSR: type=tLOG, init-value=CONST_tLOG_1:1  # Valeur du paramétrage en sortie d'usine menu xxx ENUM 0 "Fonction inactive" ENUM 1 "Fonction active"
    SR_CFG_INIT_IMA
      data CFG_INIT_IMA: type=tLOG, init-value=CONST_tLOG_1:1  # Valeur d'init du menu Indexation Marche Arrière ENUM 0 "Fonction inactive" ENUM 1 "Fonction active"
    SR_CFG_INIT_INV_ADSD
      data CFG_INIT_INV_ADSD: type=tLOG, init-value=CONST_tLOG_1:1  # Valeur du paramétrage en sortie d'usine menu INVIO_ADSD ENUM 0 "Fonction inactive" ENUM 1 "Fonction active"
    SR_CFG_INIT_LANGUE_VHL
      data CFG_INIT_LANGUE_VHL: type=t_CFG_INIT_LANGUE_VHL, init-value=0  # Valeur d'init de la langue vehicule
    SR_CFG_INIT_MENU_HC_END
      data CFG_INIT_MENU_HC_END: type=t_CFG_INIT_MENU_HC_END, init-value=420  # Programmation de 0 à 1439 minutes
    SR_CFG_INIT_MENU_HC_START
      data CFG_INIT_MENU_HC_START: type=t_CFG_INIT_MENU_HC_START, init-value=1380  # Programmation de 0 à 1439 minutes
    SR_CFG_INIT_MENU_PRG_PEM_DI
      data CFG_INIT_MENU_PRG_PEM_DI: type=t_CFG_INIT_MENU_PRG_PEM_DI, init-value=480  # Programmation de 0 à 1439 minutes
    SR_CFG_INIT_MENU_PRG_PEM_JE
      data CFG_INIT_MENU_PRG_PEM_JE: type=t_CFG_INIT_MENU_PRG_PEM_JE, init-value=480  # Programmation de 0 à 1439 minutes
    SR_CFG_INIT_MENU_PRG_PEM_LU
      data CFG_INIT_MENU_PRG_PEM_LU: type=t_CFG_INIT_MENU_PRG_PEM_LU, init-value=480  # Programmation de 0 à 1439 minutes
    SR_CFG_INIT_MENU_PRG_PEM_MA
      data CFG_INIT_MENU_PRG_PEM_MA: type=t_CFG_INIT_MENU_PRG_PEM_MA, init-value=480  # Programmation de 0 à 1430 minutes
    SR_CFG_INIT_MENU_PRG_PEM_ME
      data CFG_INIT_MENU_PRG_PEM_ME: type=t_CFG_INIT_MENU_PRG_PEM_ME, init-value=480  # Programmation de 0 à 1439 minutes
    SR_CFG_INIT_MENU_PRG_PEM_SA
      data CFG_INIT_MENU_PRG_PEM_SA: type=t_CFG_INIT_MENU_PRG_PEM_SA, init-value=480  # Programmationd de 0 à 1439 minutes
    SR_CFG_INIT_MENU_PRG_PEM_VE
      data CFG_INIT_MENU_PRG_PEM_VE: type=t_CFG_INIT_MENU_PRG_PEM_VE, init-value=480  # Programmation de 0 à 1439 minutes
    SR_CFG_INIT_MENU_SEL_HC
      data CFG_INIT_MENU_SEL_HC: type=tLOG, init-value=CONST_tLOG_1:1  # 0 : Fonction inactive 1 : Fonction active ENUM 0 "Fonction inactive" ENUM 1 "Fonction active"
    SR_CFG_INIT_MENU_SEL_PRG_PEM_DI
      data CFG_INIT_MENU_SEL_PRG_PEM_DI: type=tLOG, init-value=CONST_tLOG_1:1  # 0 : Fonction inactive 1 : Fonction active ENUM 0 "Fonction inactive" ENUM 1 "Fonction active"
    SR_CFG_INIT_MENU_SEL_PRG_PEM_JE
      data CFG_INIT_MENU_SEL_PRG_PEM_JE: type=tLOG, init-value=CONST_tLOG_1:1  # 0 : Fonction inactive 1 : Fonction active ENUM 0 "Fonction inactive" ENUM 1 "Fonction active"
    SR_CFG_INIT_MENU_SEL_PRG_PEM_LU
      data CFG_INIT_MENU_SEL_PRG_PEM_LU: type=tLOG, init-value=CONST_tLOG_1:1  # 0 : Fonction inactive 1 : Fonction active ENUM 0 "Fonction inactive" ENUM 1 "Fonction active"
    SR_CFG_INIT_MENU_SEL_PRG_PEM_MA
      data CFG_INIT_MENU_SEL_PRG_PEM_MA: type=tLOG, init-value=CONST_tLOG_1:1  # 0 : Fonction inactive 1 : Fonction active ENUM 0 "Fonction inactive" ENUM 1 "Fonction active"
    SR_CFG_INIT_MENU_SEL_PRG_PEM_ME
      data CFG_INIT_MENU_SEL_PRG_PEM_ME: type=tLOG, init-value=CONST_tLOG_1:1  # 0 : Fonction inactive 1 : Fonction active ENUM 0 "Fonction inactive" ENUM 1 "Fonction active"
    SR_CFG_INIT_MENU_SEL_PRG_PEM_SA
      data CFG_INIT_MENU_SEL_PRG_PEM_SA: type=tLOG, init-value=CONST_tLOG_1:1  # 0 : Fonction inactive 1 : Fonction active ENUM 0 "Fonction inactive" ENUM 1 "Fonction active"
    SR_CFG_INIT_MENU_SEL_PRG_PEM_VE
      data CFG_INIT_MENU_SEL_PRG_PEM_VE: type=tLOG, init-value=CONST_tLOG_1:1  # 0 : Fonction inactive 1 : Fonction active ENUM 0 "Fonction inactive" ENUM 1 "Fonction active"
    SR_CFG_INIT_MOTOR_VOLET
      data CFG_INIT_MOTOR_VOLET: type=tLOG, init-value=CONST_tLOG_0:0  # Valeur d'init motorisation du volet ENUM 0 "Désactiver" ENUM 1 "Activer"
    SR_CFG_INIT_PRESENCE_ARC
      data CFG_INIT_PRESENCE_ARC: type=tLOG, init-value=CONST_tLOG_1:1  # Configuration en sortie d'usine du paramètre \Présence de la fonction ARC\ au menu perso ENUM 0 "Fonction inactive" ENUM 1 "Fonction active"
    SR_CFG_INIT_PRV_MODE
      data CFG_INIT_PRV_MODE: type=t_CFG_INIT_PRV_MODE, init-value=0  # Valeur du paramétrage en sortie d'usine menu PRIVACY_MODE ENUM 0 "Full_private" ENUM 1 "Geoloc_private" ENUM 2 "No_private"
    SR_CFG_INIT_RESERVE_ZEV
      data CFG_INIT_RESERVE_ZEV: type=t_CFG_INIT_RESERVE_ZEV, init-value=2  # 0 : 5km 1 : 10km 2 : 15km 3 : non utilisé ENUM 0 "5km" ENUM 1 "10km" ENUM 2 "15km" ENUM 3 "Non utilise"
    SR_CFG_INIT_RTAB
      data CFG_INIT_RTAB: type=tLOG, init-value=CONST_tLOG_1:1  # Valeur du paramétrage en sortie d'usine ENUM 0 "Fonction inactive" ENUM 1 "Fonction active"
    SR_CFG_INIT_RTAB_ENERGY_REC
      data CFG_INIT_RTAB_ENERGY_REC: type=tBYTE, init-value=CONST_tBYTE_0:0  # Configuration en sortie d'usine du paramètre \RTAB_ENERGY_RECOVER au menu perso
    SR_CFG_INIT_RTAB_RECHARGE
      data CFG_INIT_RTAB_RECHARGE: type=tLOG, init-value=CONST_tLOG_0:0  # Valeur d'init Recharge Batterie
    SR_CFG_INIT_RTAB_RECHARGE_H_DEB
      data CFG_INIT_RTAB_RECHARGE_H_DEB: type=tDWORD, init-value=CONST_tDWORD_0:0  # Configuration en sortie d'usine du paramètre \RECHARGE_H_DEBUT au menu perso
    SR_CFG_INIT_RTAB_TYPE_REC
      data CFG_INIT_RTAB_TYPE_REC: type=tLOG, init-value=CONST_tLOG_0:0  # Valeur du paramétrage en sortie d'usine menu RTAB
    SR_CFG_INIT_SAM
      data CFG_INIT_SAM: type=tLOG, init-value=CONST_tLOG_1:1  # Valeur d'init de la SAM ENUM 0 "Désactiver" ENUM 1 "Activer"
    SR_CFG_INIT_SELECTIVITE_CAB_ZC
      data CFG_INIT_SELECTIVITE_CAB_ZC: type=tLOG, init-value=CONST_tLOG_0:0  # Valeur d'init de la sélectivité cabine ENUM 0 "Désactiver" ENUM 1 "Activer"
    SR_CFG_INIT_SELECTIVITE_COND
      data CFG_INIT_SELECTIVITE_COND: type=tLOG, init-value=CONST_tLOG_0:0  # Valeur d'init de la sélectivité conducteur ENUM 0 "Désactiver" ENUM 1 "Activer"
    SR_CFG_INIT_SELECTIVITE_OUV_AR
      data CFG_INIT_SELECTIVITE_OUV_AR: type=tLOG, init-value=CONST_tLOG_0:0  # Valeur d'init de la sélectivité ouvrant arriere ENUM 0 "Désactiver" ENUM 1 "Activer"
    SR_CFG_INIT_SEL_RESERVE_ZEV
      data CFG_INIT_SEL_RESERVE_ZEV: type=tLOG, init-value=CONST_tLOG_1:1  # 0 : Fonction inactive 1 : Fonction active ENUM 0 "Fonction inactive" ENUM 1 "Fonction active"
    SR_CFG_INIT_SENS_ARC_NIV
      data CFG_INIT_SENS_ARC_NIV: type=t_CFG_INIT_SENS_ARC_NIV, init-value=2  # Configuration en sortie d'usine du paramètre \Sensibilité ARC\ au menu perso ENUM 1 "1" ENUM 2 "2" ENUM 3 "3"
    SR_CFG_INIT_TCFG
      data CFG_INIT_TCFG: type=t_CFG_INIT_TCFG, init-value=4  # Valeur d'init de la TCFG ENUM 0 "Eclairage plafonnier" ENUM 1 "Black Panel" ENUM 2 "Acces JDA" ENUM 3 "Personnalisation CMB" ENUM 4 "Colorisation CMB" ENUM 5 "Check manuel" ENUM 6 "Non Utilise" ENUM 7 "Non Utilise" ENUM 8 "Non Utilise" ENUM 9 "Non Utilise" ENUM 10 "Non Utilise" ENUM 11 "Non Utilise" ENUM 12 "Non Utilise" ENUM 13 "Non Utilise" ENUM 14 "Non Utilise" ENUM 15 "Non Utilise"
    SR_CFG_INIT_TEMPO_ACCOMP
      data CFG_INIT_TEMPO_ACCOMP: type=t_CFG_INIT_TEMPO_ACCOMP, init-value=1  # Valeur d'init de la tempo d'ecl accomp ENUM 0 "15 s" ENUM 1 "30 s" ENUM 2 "60 s" ENUM 3 "Non Utilisé"
    SR_CFG_INIT_TEMPO_DECONDA
      data CFG_INIT_TEMPO_DECONDA: type=t_CFG_INIT_TEMPO_DECONDA, init-value=1  # Valeur d'init de la tempo d'ecl deconda ENUM 0 "15 s" ENUM 1 "30 s" ENUM 2 "60 s" ENUM 3 "Non Utilisé"
    SR_CFG_INIT_UNITE_CONSO
      data CFG_INIT_UNITE_CONSO: type=tLOG, init-value=CONST_tLOG_0:0  # Valeur d'init de l'unite de conso ENUM 0 "Volume pour 100 unites de distance" ENUM 1 "Distance par unite de volume"
    SR_CFG_INIT_UNITE_DISTANCE
      data CFG_INIT_UNITE_DISTANCE: type=tLOG, init-value=CONST_tLOG_0:0  # Valeur d'init de l'unite de distance ENUM 0 "km" ENUM 1 "miles"
    SR_CFG_INIT_UNITE_TEMP
      data CFG_INIT_UNITE_TEMP: type=tLOG, init-value=CONST_tLOG_0:0  # Valeur d'init de l'unite de temperature ENUM 0 "àC" ENUM 1 "àF"
    SR_CFG_INIT_UNITE_VOLUME
      data CFG_INIT_UNITE_VOLUME: type=tLOG, init-value=CONST_tLOG_0:0  # Valeur d'init de l'unite de volume ENUM 0 "Litre" ENUM 1 "Gallon"
    SR_CFG_INIT_VAM_ECS_MODE
      data CFG_INIT_VAM_ECS_MODE: type=tLOG, init-value=CONST_tLOG_1:1  # Valeur du paramétrage en sortie d'usine menu ECS Mode ENUM 0 "Fonction inactive" ENUM 1 "Fonction active"
    SR_CFG_INIT_VITESSE_1
      data CFG_INIT_VITESSE_1: type=tBYTE, init-value=CONST_tBYTE_50:50  # Valeur d'init de la vitesse butee XVV 1
    SR_CFG_INIT_VITESSE_2
      data CFG_INIT_VITESSE_2: type=tBYTE, init-value=CONST_tBYTE_70:70  # Valeur d'init de la vitesse butee XVV 2
    SR_CFG_INIT_VITESSE_3
      data CFG_INIT_VITESSE_3: type=tBYTE, init-value=CONST_tBYTE_90:90  # Valeur d'init de la vitesse butee XVV 3
    SR_CFG_INIT_VITESSE_4
      data CFG_INIT_VITESSE_4: type=tBYTE, init-value=CONST_tBYTE_110:110  # Valeur d'init de la vitesse butee XVV 4
    SR_CFG_INIT_VITESSE_5
      data CFG_INIT_VITESSE_5: type=tBYTE, init-value=CONST_tBYTE_130:130  # Valeur d'init de la vitesse butee XVV 5
    SR_CFG_INIT_VIT_LVV_1
      data CFG_INIT_VIT_LVV_1: type=tBYTE, init-value=CONST_tBYTE_50:50  # Configuration en sortie d'usine du paramètre \Vitesse LVV 1\ au menu perso
    SR_CFG_INIT_VIT_LVV_1_Miles
      data CFG_INIT_VIT_LVV_1_Miles: type=tBYTE, init-value=CONST_tBYTE_32:32  # Configuration en sortie d'usine du paramètre \Vitesse LVV 1\ au menu perso
    SR_CFG_INIT_VIT_LVV_2
      data CFG_INIT_VIT_LVV_2: type=tBYTE, init-value=CONST_tBYTE_70:70  # Configuration en sortie d'usine du paramètre \Vitesse LVV 2\ au menu perso
    SR_CFG_INIT_VIT_LVV_2_Miles
      data CFG_INIT_VIT_LVV_2_Miles: type=tBYTE, init-value=CONST_tBYTE_48:48  # Configuration en sortie d'usine du paramètre \Vitesse LVV 2\ au menu perso
    SR_CFG_INIT_VIT_LVV_3
      data CFG_INIT_VIT_LVV_3: type=tBYTE, init-value=CONST_tBYTE_80:80  # Configuration en sortie d'usine du paramètre \Vitesse LVV 3\ au menu perso
    SR_CFG_INIT_VIT_LVV_3_Miles
      data CFG_INIT_VIT_LVV_3_Miles: type=tBYTE, init-value=CONST_tBYTE_64:64  # Configuration en sortie d'usine du paramètre \Vitesse LVV 3\ au menu perso
    SR_CFG_INIT_VIT_LVV_4
      data CFG_INIT_VIT_LVV_4: type=tBYTE, init-value=CONST_tBYTE_90:90  # Configuration en sortie d'usine du paramètre \Vitesse LVV 4\ au menu perso
    SR_CFG_INIT_VIT_LVV_4_Miles
      data CFG_INIT_VIT_LVV_4_Miles: type=tBYTE, init-value=CONST_tBYTE_80:80  # Configuration en sortie d'usine du paramètre \Vitesse LVV 4\ au menu perso
    SR_CFG_INIT_VIT_LVV_5
      data CFG_INIT_VIT_LVV_5: type=tBYTE, init-value=CONST_tBYTE_110:110  # Configuration en sortie d'usine du paramètre \Vitesse LVV 5\ au menu perso
    SR_CFG_INIT_VIT_LVV_5_Miles
      data CFG_INIT_VIT_LVV_5_Miles: type=tBYTE, init-value=CONST_tBYTE_96:96  # Configuration en sortie d'usine du paramètre \Vitesse LVV 5\ au menu perso
    SR_CFG_INIT_VIT_LVV_6
      data CFG_INIT_VIT_LVV_6: type=tBYTE, init-value=CONST_tBYTE_130:130  # Configuration en sortie d'usine du paramètre \Vitesse LVV 6\ au menu perso
    SR_CFG_INIT_VIT_LVV_6_Miles
      data CFG_INIT_VIT_LVV_6_Miles: type=tBYTE, init-value=CONST_tBYTE_112:112  # Configuration en sortie d'usine du paramètre \Vitesse LVV 6\ au menu perso
    SR_CFG_INIT_VIT_RVV_1
      data CFG_INIT_VIT_RVV_1: type=tBYTE, init-value=CONST_tBYTE_50:50  # Configuration en sortie d'usine du paramètre \Vitesse RVV 1\ au menu perso
    SR_CFG_INIT_VIT_RVV_1_Miles
      data CFG_INIT_VIT_RVV_1_Miles: type=tBYTE, init-value=CONST_tBYTE_48:48  # Configuration en sortie d'usine du paramètre \Vitesse RVV 1\ au menu perso
    SR_CFG_INIT_VIT_RVV_2
      data CFG_INIT_VIT_RVV_2: type=tBYTE, init-value=CONST_tBYTE_70:70  # Configuration en sortie d'usine du paramètre \Vitesse RVV 2\ au menu perso
    SR_CFG_INIT_VIT_RVV_2_Miles
      data CFG_INIT_VIT_RVV_2_Miles: type=tBYTE, init-value=CONST_tBYTE_64:64  # Configuration en sortie d'usine du paramètre \Vitesse RVV 2\ au menu perso
    SR_CFG_INIT_VIT_RVV_3
      data CFG_INIT_VIT_RVV_3: type=tBYTE, init-value=CONST_tBYTE_80:80  # Configuration en sortie d'usine du paramètre \Vitesse RVV 3\ au menu perso
    SR_CFG_INIT_VIT_RVV_3_Miles
      data CFG_INIT_VIT_RVV_3_Miles: type=tBYTE, init-value=CONST_tBYTE_80:80  # Configuration en sortie d'usine du paramètre \Vitesse RVV 3\ au menu perso
    SR_CFG_INIT_VIT_RVV_4
      data CFG_INIT_VIT_RVV_4: type=tBYTE, init-value=CONST_tBYTE_90:90  # Configuration en sortie d'usine du paramètre \Vitesse RVV 4\ au menu perso
    SR_CFG_INIT_VIT_RVV_4_Miles
      data CFG_INIT_VIT_RVV_4_Miles: type=tBYTE, init-value=CONST_tBYTE_96:96  # Configuration en sortie d'usine du paramètre \Vitesse RVV 4\ au menu perso
    SR_CFG_INIT_VIT_RVV_5
      data CFG_INIT_VIT_RVV_5: type=tBYTE, init-value=CONST_tBYTE_110:110  # Configuration en sortie d'usine du paramètre \Vitesse RVV 5\ au menu perso
    SR_CFG_INIT_VIT_RVV_5_Miles
      data CFG_INIT_VIT_RVV_5_Miles: type=tBYTE, init-value=CONST_tBYTE_112:112  # Configuration en sortie d'usine du paramètre \Vitesse RVV 5\ au menu perso
    SR_CFG_INIT_VIT_RVV_6
      data CFG_INIT_VIT_RVV_6: type=tBYTE, init-value=CONST_tBYTE_130:130  # Configuration en sortie d'usine du paramètre \Vitesse RVV 6\ au menu perso
    SR_CFG_INIT_VIT_RVV_6_Miles
      data CFG_INIT_VIT_RVV_6_Miles: type=tBYTE, init-value=CONST_tBYTE_129:129  # Configuration en sortie d'usine du paramètre \Vitesse RVV 6\ au menu perso
    SR_CFG_INIT_VTOR_IRV
      data CFG_INIT_VTOR_IRV: type=tLOG, init-value=CONST_tLOG_0:0  # Valeur du paramétrage en sortie d'usine menu VTOR_IRV ENUM 0 "Fonction inactive" ENUM 1 "Fonction active"
    SR_CFG_MECATRONIC_HEADLAMP
      data CFG_MECATRONIC_HEADLAMP: type=tLOG, init-value=CONST_tLOG_0:0  # Option des projecteurs innovants
    SR_CFG_OPTION_MENU_FSE
      data CFG_OPTION_MENU_FSE: type=tLOG, init-value=CONST_tLOG_1:1  # Indique si l'item 'Mode de serrage du FSE' doit être affiché au menu de personnalisation ENUM 0 "Menu absent" ENUM 1 "Menu présent"
    SR_CFG_PRESENCE_AFS
      data CFG_PRESENCE_AFS: type=tLOG, init-value=CONST_tLOG_0:0  # Présence dAFS ENUM 0 "Absence de l'organe" ENUM 1 "Presence de l'organe"
    SR_CFG_PRESENCE_ARC
      data CFG_PRESENCE_ARC: type=t_cARC_0, init-value=CONST_t_cARC_0_1:1  # Indique si le véhicule est équipé de la fonction ARC (Alerter des Risques de Collision) ENUM 0 "ARC absent" cARC_absent ENUM 1 "ARC présent" cARC_present ENUM 2 "ARC 2" cARC_2_present ENUM 3 "ARC 3" cARC_3_present
    SR_CFG_PRESENCE_FARC
      data CFG_PRESENCE_FARC: type=t_cFARC_0, init-value=CONST_t_cFARC_0_0:0  # Indique si le véhicule est équipé de la option FARC (Frein Automatique sur Risque de Collision) ENUM 0 "FARC absent" cFARC_absent ENUM 1 "FARC présent" cFARC_present ENUM 2 "FARC urbain présent" cFARC_U_present ENUM 3 "FARC 2" cFARC_2_present ENUM 4 "FARC 3" cFARC_3_present
    SR_CFG_PRESENCE_MENU_PERSO
      data CFG_PRESENCE_MENU_PERSO: type=tBYTE, init-value=CONST_tBYTE_0:0  # Présence et type de menu de personnalisation ENUM 0 "Menu absent" ENUM 1 "Menu présent"
    SR_CFG_PRESENCE_TO
      data CFG_PRESENCE_TO: type=t_CFG_PRESENCE_TO, init-value=CONST_t_CFG_PRESENCE_TO_0:0  # Indique le nombre de TO présent(s) dans le véhicule 0: Absence de TO 1: Présence d'un TO 2: Présence de deux TO 3: Présence de trois TO ENUM 0 "Absence de TO" ENUM 1 "Présence d'un TO" ENUM 2 "Présence de deux TO" ENUM 3 "Présence de trois TO"
    SR_CFG_PRESENCE_TOUCHE_CONFIG
      data CFG_PRESENCE_TOUCHE_CONFIG: type=tLOG, init-value=CONST_tLOG_0:0  # Indique la présence de la touche de configuration pour le menu perso ENUM 0 "Touche de configuration absente" ENUM 1 "Touche de configuration présente"
    SR_CFG_TYPE_AAS
      data CFG_TYPE_AAS: type=t_cAAS, init-value=CONST_t_cAAS_0:0  # Définit la présence de l'Aide Au Stationnement (AAS) avant et arrière, ainsi que de la Mesure de Place Disponible (MPD), de l'Aide Visuel au Recul (AVR), du Stationnement automatique (CityPark) et de la Vision latérale Japon (VLJ). Définit également les calculateurs/capteurs associés. Champ de bits : 0 -> fonction absente 1 -> fonction présente CHPB_NUL "aucune fonction AAS présente" cAAS_Absent CHPB 0 "Présence de l'AAS arrière" cAAS_DOPAR CHPB 1 "Présence de l'AAS avant" cAAS_DOPAV CHPB 2 "Présence de la MPD par le calculteur AAS" cAAS_MPDparAAS CHPB 3 "Présence de la MPD par le calculteur SAM" cAAS_MPDparSAM CHPB 4 "Présence de l'AVR" cAAS_AVR CHPB 5 "Présence de la fonction CityPark" cAAS_CityPark CHPB 6 "Présence de la fonction CityPark, option AMSP" cAAS_CityPark_AMSP CHPB 7 "Présence de la fonction VLJ" cAAS_VLJ
    SR_CFG_TYPE_ACTIVATION_AFS
      data CFG_TYPE_ACTIVATION_AFS: type=tLOG, init-value=CONST_tLOG_0:0  # Permet de distinguer si on utilise le flux AFS (pour BYOM) ou AUTOROUTE (NAC/RCC)
    SR_CFG_TYPE_FSE
      data CFG_TYPE_FSE: type=t_cTypeFSE, init-value=CONST_t_cTypeFSE_0:0  # Indique si la sous fonction Freinage par FSE est disponible, et si oui la provenance des informations utilisée pour cette sous fonction. FSE: Frein Secondaire Electrique (ou Frein de Stationnement Electrique) ENUM 0 "Pas de FSE" cTypeFSE_Absent ENUM 1 "FSE par ESP sans étriers motorisés" cTypeFSE_ParESP ENUM 2 "FSE par FSE sans étriers motorisés" cTypeFSE_ParFSE ENUM 3 "FSE par ESP avec étriers motorisés" cTypeFSE_ParESP_EtriersMotorises
    SR_CFG_TYPE_FUNCTIONAL_ABSD
      data CFG_TYPE_FUNCTIONAL_ABSD: type=t_cTYPE_FUNCTIONAL_ABSD, init-value=CONST_t_cTYPE_FUNCTIONAL_ABSD_0:0  # Défini le type d'activation/désactivation de la fonction BSD (solution PSA ou EuroNCap) ENUM 0 "cTYPE_FUNCTIONAL_ABSD_EURONCAP" ENUM 1 "cTYPE_FUNCTIONAL_ABSD_PSA"
    SR_CFG_TYPE_REGLAGE_SELECTIVITE
      data CFG_TYPE_REGLAGE_SELECTIVITE: type=t_cGAV_Selectivite, init-value=CONST_t_cGAV_Selectivite_0:0  # Type de reglage de la selectivitéActivabilité de la fonction de sélectivité des portes (aucun réglage ou viaréglage le par menu de personnaliation ou push) ENUM 0 "Sélectivité non activable" cGAV_SelectiviteNonActivable ENUM 1 "Sélectivité activable par menu de personnalisaton" cGAV_SelectiviteActivableParMenu ENUM 2 "Sélectivité activable par push de deverouillage cabine Zone de charge" cGAV_SelectiviteActivableParPush
    SR_CFG_TYPE_SELECTIVITE
      data CFG_TYPE_SELECTIVITE: type=t_cTypeSelect, init-value=CONST_t_cTypeSelect_0:0  # Type de la sélectivite sur les serrures portes: 0: pas de sélectivité 1: sélectivité conducteur 2: sélectivité avant arrière ENUM 0 "aucune sélectivité" cTypeSelect_Aucune ENUM 1 "sélectivité porte conducteur" cTypeSelect_Conducteur ENUM 2 "sélectivité avant / arrière" cTypeSelect_AvantArriere
    SR_CFG_TYPE_SELECTIVITE_OUV_AR
      data CFG_TYPE_SELECTIVITE_OUV_AR: type=t_cTypeSelectOuvAR, init-value=CONST_t_cTypeSelectOuvAR_0:0  # Type de la sélectivite au plip sur l'ouvrant arrière 0: Absence de sélectivité de l'ouvrant arrière au plip 1: Présence de sélectivité de l'ouvrant arrière par éjection au plip de celui-ci sans déverrouillage global du véhicule 2: Présence de sélectivité de l'ouvrant arrière par déverrouillage au plip de celui-ci sans déverrouillage global du véhicule ENUM 0 "Absence de sélectivité de l'ouvrant arrière au plip" cTypeSelectOuvAR_Absente ENUM 1 "Présence de sélectivité de l'ouvrant arrière par éjection au plip de celui-ci sans déverrouillage global du véhicule" cTypeSelectOuvAR_EjectionSelect ENUM 2 "Présence de sélectivité de l'ouvrant arrière par déverrouillage au plip de celui-ci sans déverrouillage global du véhicule" cTypeSelectOuvAR_DeverrSelect
    SR_T28_APPUI_LONG_TOUCHE_CONF
      data T28_APPUI_LONG_TOUCHE_CONF: type=tBYTE, init-value=CONST_tBYTE_2:2  # Temporisation de detection d'un appui long sur la touche configurable Unité : s
    SR_T28_MAINTIEN_DONNEES_TOUCHE
      data T28_MAINTIEN_DONNEES_TOUCHE: type=t_T28_MAINTIEN_DONNEES_TOUCHE, init-value=CONST_t_T28_MAINTIEN_DONNEES_TOUCHE_500:500  # Durée de maintien des données levées suite détection appui touche configurable Unité : ms
package /Pack_sw_Types
  93 x impl type, all with category=VALUE:
    t_: base-type=uint8, compu {0x0=GAZ, 0x1=EssenceForcedGaz, 0x2=GazEssenceCommutation, 0x3=EssenceFocedWaitGazCondition, 0x4=GazForcedEssenceTankVide, 0x5=EssenceGazCommutation, 0x6=EssenceForcedGazTankVide, 0x7=Essence}
    tBinaire: base-type=uint8, compu {0=cFaux, 1=cVrai}
    t_C26_ALT_FR_DISTANCE_SEED: base-type=uint8
    t_C26_ALT_FR_FUEL_USED_SEED: base-type=uint8
    t_C26_DISTANCE_MINI_HY: base-type=uint16
    t_C26_FILTER_GM: base-type=uint16
    t_C26_MAXDIST_GM: base-type=uint8
    t_C26_MAXFUEL_GM: base-type=uint8
    t_C26_RANGE_SCALEGPL: base-type=uint16
    t_cCANLS: base-type=uint8, compu {0x00=cCANLS_VEILLE, 0x01=cCANLS_NORMAL, 0x02=cCANLS_MISE_EN_VEILLE, 0x03=cCANLS_REVEIL, 0x04=cCANLS_COMOFF}
    t_cEtatHY: base-type=uint8, compu {0=cEtatHY_Indetermine, 1=cEtatHY_Inactive, 2=cEtatHY_ActiveArret, 3=cEtatHY_ActiveTraction, 4=cEtatHY_ActivePropulsion, 5=cEtatHY_ActiveHybride}
    t_cGEE_1: base-type=uint8, compu {0x00=cGEE_TI_Nominal, 0x01=cGEE_TI_Degrade, 0x02=cGEE_TI_DispoDem, 0x03=cGEE_Demarrage, 0x04=cGEE_Redemarrage, 0x05=cGEE_TA_Nominal, 0x06=cGEE_TA_Degrade, 0x07=cGEE_TA_Secu, 0x08=cGEE_TA_Urgence, 0xFE=cGEE_TI_Indisponible, 0xFF=cGEE_TI_Invalide}
    t_cGM_HY: base-type=uint8, compu {0x0=cGM_HYIndetermine, 0x1=cGM_HYInactive, 0x2=cGM_HYActiveArret, 0x3=cGM_HYActiveTraction, 0x4=cGM_HYActivePropulsion, 0x5=cGM_HYActiveHybride, 0x6=cGM_HY_MAX}
    t_cIHM: base-type=uint8, compu {0=cIHM_without, 1=cIHM_currentAutonomy, 2=cIHM_totalAutonomy}
    t_cModeFonctMotGAZ: base-type=uint8, compu {0x00=cModeFonctMotGAZ_GAZ, 0x01=cModeFonctMotGAZ_GAZ_HS, 0x02=cModeFonctMotGAZ_CommutGAZ_Essence, 0x03=cModeFonctMotGAZ_AttenteGAZ, 0x04=cModeFonctMotGAZ_EssenceVide, 0x05=cModeFonctMotGAZ_CommutEssence_GAZ, 0x06=cModeFonctMotGAZ_GAZVide, 0x07=cModeFonctMotGAZ_Essence}
    t_cSDF_Defaut: base-type=uint8, compu {0x69=cSDF_DefautAbsent, 0x96=cSDF_DefautPresent}
    t_cSDF_Mesure: base-type=uint8, compu {0x69=cSDF_MesureNonRealisee, 0x96=cSDF_MesureRealisee}
    t_cTCT: base-type=uint8, compu {0x00=cTCT_MTH, 0x01=cTCT_HY, 0x02=cTCT_ELEC}
    t_cVitv: base-type=uint16, compu {0x5=cVitvIndispo, 0xA=cVitvDispo, 0xFFFF=cVitvInvalide, 0=cVitv_Incoherent, 1=cVitv_Coherent, 0xB=cVitv_cOK}
    t_e_0: base-type=uint8, compu {0x0=cMode_Essence, 0x1=cMode_GPL, 0x2=cBasculement_en_cours, 0x3=cInvalideEssenceGPL}
    t_GM_GMP: base-type=uint8, compu {0x00=GM_GMPInit, 0x01=GM_GMPCoupe, 0x02=GM_GMPEnDemarrage, 0x04=GM_GMPTournant, 0x08=GM_GMPArrete, 0x10=GM_GMPEnRedemarrage, 0x20=GM_GMPTournantHybride, 0x40=GM_GMPTournantElecPur, 0x80=GM_GMPEnPreparation}
    t_H: base-type=uint8, compu {0=cPHASE_1, 1=cPHASE_2, 2=cHY_E35, 3=cHY4_PREMIUM, 4=cPHEV}
    t_SEV: base-type=uint8, compu {0x69=SEV_Arret, 0x96=SEV_Contact, 0x3C=SEV_Demarreur}
    t_T26_TEMPO_HISTO_HY: base-type=uint16
    t_T26_TEMPO_HISTO_ZOOM{1..4}: base-type=uint8
    t_VAL_MEDAILLE: base-type=uint8
    IoHwAb_uint8: base-type=uint8
    t_C27_ECART_MAJ_HORLOGE: base-type=uint8
    t_cAlarm: base-type=uint8, compu {0x69=cAlarm_Inactive, 0x3C=cAlarm_Expire, 0x96=cAlarm_EnCours}
    t_cAnnee: base-type=uint16, compu {0x7D7=cAnnee_Min, 0x84D=cAnnee_Max, 0x84E=cAnnee_Indisponible, 0x84F=cAnnee_Invalide}
    t_cAnneeAff: base-type=uint8, compu {0x00=cAnneeAff_Min, 0x7D=cAnneeAff_Max, 0x7E=cAnneeAff_Indisponible, 0x7F=cAnneeAff_Invalide}
    t_cCANIS: base-type=uint8, compu {0x00=cCANIS_OFF, 0x01=cCANIS_TRANSITOIRE, 0x02=cCANIS_PARTIEL, 0x03=cCANIS_PRINCIPAL, 0x04=cCANIS_PRINCIPAL_DEGRADE}
    t_cCANISPartialWakeUp: base-type=uint32, compu {0x00000001=cCANISPartialWakeUp_AnticipationADC, 0x00000002=cCANISPartialWakeUp_PrepaDemMot, 0x00000008=cCANISPartialWakeUp_AffichageEtatFSE, 0x00000004=cCANISPartialWakeUp_MesNivHuileDeBSI, 0x00000010=cCANISPartialWakeUp_FonctionEasyMoveParFSE, 0x00000020=cCANISPartialWakeUp_ChargeUCAP, 0x00000040=cCANISPartialWakeUp_EtatBV, 0x00000080=cCANISPartialWakeUp_PrepaGEP, 0x00000100=cCANISPartialWakeUp_EtatFSE, 0x00000200=cCANISPartialWakeUp_ReveilPostVentilMoteur, 0x00000400=cCANISPartialWakeUp_VitesseVhlParBSI, 0x00000800=cCANISPartialWakeUp_RevPowerLatchHY, 0x00001000=cCANISPartialWakeUp_CorrectionHauteurPneumatique, 0x00002000=cCANISPartialWakeUp_FctManuellesCAAR, 0x00004000=cCANISPartialWakeUp_PrechauffageFlexStart, 0x0008000=cCANISPartialWakeUp_ChargeBatterieBT, 0x00008000=cCANISPartialWakeUp_OverLoadVhlIndicator, 0x00010000=cCANISPartialWakeUp_MecatronicHeadlamp, 0x00020000=cCANISPartialWakeUp_ProgrammedCharging, 0x00040000=cCANISPartialWakeUp_PostDrive, 0x00080000=cCANISPartialWakeUp_PreDrive, 0x00100000=cCANISPartialWakeUp_FuelFlapOpening, 0x00200000=cCANISPartialWakeUp_EBBAssist, 0x00400000=cCANISPartialWakeUp_PrecondELEC, 0x00800000=cCANISPartialWakeUp_PrecondTherm, 0x01000000=cCANISPartialWakeUp_MEAPCoolingBesoinsHS, 0x02000000=cCANISPartialWakeUp_StateInfoWakeup, 0x04000000=cCANISPartialWakeUp_CCECoolingWakeup, 0x08000000=cCANISPartialWakeUp_HoldDiscontactor, 0x10000000=cCANISPartialWakeUp_BattChargPrRMS}
    t_cCptRAZ: base-type=uint8, compu {0x00=cCptRAZ_Min, 0xFD=cCptRAZ_Max, 0xFE=cCptRAZ_Indisponible, 0xFF=cCptRAZ_Invalide}
    t_cCptVhl: base-type=uint32, compu {0x00000000=cCptVhl_Min, 0xFFFFFFFD=cCptVhl_Max, 0xFFFFFFFE=cCptVhl_Indisponible, 0xFFFFFFFF=cCptVhl_Invalide}
    t_cCSEV: base-type=uint8, compu {0=cCSEV_Montage, 1=cCSEV_Usine, 2=cCSEV_Controle, 3=cCSEV_Stockage, 4=cCSEV_Client, 5=cCSEV_ShowRoom, 6=cCSEV_APV}
    t_cEtatProgRev: base-type=uint8, compu {0x3C=cEtatProgRev_ReveilNonProg, 0x5A=cEtatProgRev_ReveilProg, 0x69=cEtatProgRev_ReveilDemande, 0x96=cEtatProgRev_Indisponible, 0xC3=cEtatProgRev_Invalide}
    t_cHeure: base-type=uint8, compu {0x00=cHeure_Min, 0x17=cHeure_Max, 0x1E=cHeure_Indisponible, 0x1F=cHeure_Invalide}
    t_cHProgPrecondTherm: base-type=uint16, compu {0x0000=cHProgPrecondTherm_Min, 0x059F=cHProgPrecondTherm_Max, 0xFFFE=cHProgPrecondTherm_Aucun}
    t_cJour: base-type=uint8, compu {0x01=cJour_Min, 0x1F=cJour_Max, 0x3E=cJour_Indisponible, 0x3F=cJour_Invalide}
    t_cJourSemaine: base-type=uint8, compu {0x0=cJourSemaine_Samedi, 0x1=cJourSemaine_Dimanche, 0x2=cJourSemaine_Lundi, 0x3=cJourSemaine_Mardi, 0x4=cJourSemaine_Mercredi, 0x5=cJourSemaine_Jeudi, 0x6=cJourSemaine_Vendredi, 0xE=cJourSemaine_Indisponible, 0xF=cJourSemaine_Invalide}
    t_cMinute: base-type=uint8, compu {0x00=cMinute_Min, 0x3B=cMinute_Max, 0x3E=cMinute_Indisponible, 0x3F=cMinute_Invalide}
    t_cMois: base-type=uint8, compu {0x01=cMois_Min, 0x0C=cMois_Max, 0x0E=cMois_Indisponible, 0x0F=cMois_Invalide}
    t_cTypeAffichHor: base-type=uint8, compu {0=cTypeAffichHor_12H, 1=cTypeAffichHor_24H}
    TS_AlarmIdType: base-type=uint8
    TS_DayType: base-type=uint8
    TS_HourType: base-type=uint8
    TS_MinuteType: base-type=uint8
    TS_MonthType: base-type=uint8
    TS_RelMinutesType: base-type=uint16
    TS_SecondType: base-type=uint8
    TS_TimeCounterType: base-type=uint32
    TS_YearType: base-type=uint16
    t_C28_VAL_CONS_VIT_LVV_MIN: base-type=uint8
    t_C28_VAL_CONS_VIT_LVV_MIN_MILES: base-type=uint8
    t_C28_VAL_CONS_VIT_RVV_MIN: base-type=uint8
    t_C28_VAL_CONS_VIT_RVV_MIN_MILES: base-type=uint8
    t_cAAS: base-type=uint8, compu {0x00=cAAS_Absent, 0x01=cAAS_DOPAR, 0x02=cAAS_DOPAV, 0x04=cAAS_MPDparAAS, 0x08=cAAS_MPDparSAM, 0x10=cAAS_AVR, 0x20=cAAS_CityPark, 0x40=cAAS_CityPark_AMSP, 0x80=cAAS_VLJ}
    t_cAccomp: base-type=uint8, compu {0=cAccomp_Desactive, 1=cAccomp_15s, 2=cAccomp_30s, 3=cAccomp_60s}
    t_cARC_0: base-type=uint8, compu {0=cARC_absent, 1=cARC_present, 2=cARC_2_present, 3=cARC_3_present}
    t_cDAE: base-type=uint8, compu {0=cDAE_SPORT, 1=cDAE_NORMAL}
    t_cDeconda: base-type=uint8, compu {0=cDeconda_Desactive, 1=cDeconda_15s, 2=cDeconda30s, 3=cDeconda_60s}
    t_cFARC_0: base-type=uint8, compu {0=cFARC_absent, 1=cFARC_present, 2=cFARC_U_present, 3=cFARC_2_present, 4=cFARC_3_present}
    t_CFG_INIT_ECL_AMBI_NIV: base-type=uint8
    t_CFG_INIT_HARMONIE_SON: base-type=uint8
    t_CFG_INIT_LANGUE_VHL: base-type=uint8
    t_CFG_INIT_MENU_HC_END: base-type=uint16
    t_CFG_INIT_MENU_HC_START: base-type=uint16
    t_CFG_INIT_MENU_PRG_PEM_DI: base-type=uint16
    t_CFG_INIT_MENU_PRG_PEM_JE: base-type=uint16
    t_CFG_INIT_MENU_PRG_PEM_LU: base-type=uint16
    t_CFG_INIT_MENU_PRG_PEM_MA: base-type=uint16
    t_CFG_INIT_MENU_PRG_PEM_ME: base-type=uint16
    t_CFG_INIT_MENU_PRG_PEM_SA: base-type=uint16
    t_CFG_INIT_MENU_PRG_PEM_VE: base-type=uint16
    t_CFG_INIT_PRV_MODE: base-type=uint8
    t_CFG_INIT_RESERVE_ZEV: base-type=uint8
    t_CFG_INIT_SENS_ARC_NIV: base-type=uint8
    t_CFG_INIT_TCFG: base-type=uint8
    t_CFG_INIT_TEMPO_ACCOMP: base-type=uint8
    t_CFG_INIT_TEMPO_DECONDA: base-type=uint8
    t_CFG_PRESENCE_TO: base-type=uint8
    t_cFTCG: base-type=uint8, compu {0=cFTCG_Plafonnier, 1=cFTCG_BlackPanel, 2=cFTCG_AccesJDA, 3=cFTCG_PersoCMB, 4=cFTCG_ColorisationCMB, 5=cFTCG_CheckAlertes}
    t_cGAV_Selectivite: base-type=uint8, compu {0=cGAV_SelectiviteNonActivable, 1=cGAV_SelectiviteActivableParMenu, 2=cGAV_SelectiviteActivableParPush}
    t_cTypeFSE: base-type=uint8, compu {0=cTypeFSE_Absent, 1=cTypeFSE_ParESP, 2=cTypeFSE_ParFSE, 3=cTypeFSE_ParESP_EtriersMotorises}
    t_cTYPE_FUNCTIONAL_ABSD: base-type=uint8, compu {1=cTYPE_FUNCTIONAL_ABSD_PSA, 0=cTYPE_FUNCTIONAL_ABSD_EURONCAP}
    t_cTypeSelect: base-type=uint8, compu {0=cTypeSelect_Aucune, 1=cTypeSelect_Conducteur, 2=cTypeSelect_AvantArriere}
    t_cTypeSelectOuvAR: base-type=uint8, compu {0=cTypeSelectOuvAR_Absente, 1=cTypeSelectOuvAR_EjectionSelect, 2=cTypeSelectOuvAR_DeverrSelect}
    t_SurvGestToucheConfig: base-type=uint8, compu {0=cAttenteAppui, 1=cKelTypeDappui, 2=cUnAppuiCourt, 3=cUnAppuiLong, 4=cUnAppuiDefaut}
    t_T28_MAINTIEN_DONNEES_TOUCHE: base-type=uint16
package /RootP_NetworkDesc
  system VSM_System: system-version=4.0.3
    root-software-compositions:
      root sw composition prototype RootCompositionVSM: software-composition=Compo_VSM
package /RootP_Composition
  composition sw component type Compo_VSM
    6 x component:
      Instance_ASWC_A{26..28}: type=ASWC_A{26..28}
      SWC_CyclicCounter: type=SWC_CyclicCounter
      SWC_IoHwAbs: type=SWC_IoHwAbs
      SWC_ModifyEcho: type=SWC_ModifyEcho
